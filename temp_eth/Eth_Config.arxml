AUTOSAR XML (schema 4-4-0)
package /Eth
  module config Eth: implementation-config-variant=VARIANT-POST-BUILD
    CommonPublishedInformation:
      ArReleaseMajorVersion = 4
      ArReleaseMinorVersion = 4
      ArReleaseRevisionVersion = 0
      ModuleId = 88
      SwMajorVersion = 1
      SwMinorVersion = 2
      SwPatchVersion = 0
      VendorId = 175
    EthConfigSet: index=0
      EthCtrlConfig_0 (EthCtrlConfig):
        index = 0
        EthCtrlEnableLoopback = 0
        EthCtrlEnableMii = 1
        EthCtrlEnableRxInterrupt = 0
        EthCtrlEnableTxInterrupt = 0
        EthCtrlIdx = 0
        EthCtrlMacLayerSpeed = ETH_MAC_LAYER_SPEED_100M
        EthCtrlMacLayerSubType = REDUCED
        EthCtrlMacLayerType = ETH_MAC_LAYER_TYPE_XMII
        EthCtrlPhyAddress = 00:DE:AD:00:00:02
        EthOpMode = FULLDUPLEX
        EthSkewRxClockDelay = 0
        EthSkewTxClockDelay = 0
        EthCtrlConfigEgress: index=0, EthCtrlConfigEgressLastSchedulerRef=
          EthCtrlConfigDMAArbitration_0 (EthCtrlConfigDMAArbitration): EthCtrlConfigDMAArbitrationAlgorithm=ETH_DMA_ARBITRATION_FIXED_PRIORITY
          EthCtrlConfigEgressFifo_0 (EthCtrlConfigEgressFifo):
            index = 0
            EthCtrlConfigEgressFifoBufLenByte = 256
            EthCtrlConfigEgressFifoBufTotal = 4
            EthCtrlConfigEgressFifoIdx = 0
            EthCtrlConfigEgressFifoPriorityAssignment = {0..6}
          EthCtrlConfigEgressFifo_1 (EthCtrlConfigEgressFifo):
            index = 1
            EthCtrlConfigEgressFifoBufLenByte = 256
            EthCtrlConfigEgressFifoBufTotal = 5
            EthCtrlConfigEgressFifoIdx = 1
            EthCtrlConfigEgressFifoPriorityAssignment = 7
          EthCtrlConfigScheduler_0 (EthCtrlConfigScheduler): index=0, EthCtrlConfigSchedulerAlgorithm=ETH_SCHEDULER_STRICT_PRIORITY
            EthCtrlConfigSchedulerPredecessor_0 (EthCtrlConfigSchedulerPredecessor): index=0, EthCtrlConfigSchedulerPredecessorOrder=0, EthCtrlConfigSchedulerPredecessorRef=EthCtrlConfigEgressFifo_0
            EthCtrlConfigSchedulerPredecessor_1 (EthCtrlConfigSchedulerPredecessor): index=1, EthCtrlConfigSchedulerPredecessorOrder=1, EthCtrlConfigSchedulerPredecessorRef=EthCtrlConfigShaper_0
          EthCtrlConfigShaper_0 (EthCtrlConfigShaper):
            index = 0
            EthCtrlConfigShaperHiCredit = 0
            EthCtrlConfigShaperIdleSlope = 0
            EthCtrlConfigShaperLoCredit = 0
            EthCtrlConfigShaperPredecessorFifoRef = EthCtrlConfigEgressFifo_1
        EthCtrlConfigIngress: index=0, EthCtrlConfigIngressUntaggedPktsFifoRef=EthCtrlConfigIngressFifo_0
          EthCtrlConfigIngressFifo_0 (EthCtrlConfigIngressFifo): index=0, EthCtrlConfigIngressFifoBufLenByte=256, EthCtrlConfigIngressFifoBufTotal=4, EthCtrlConfigIngressFifoIdx=0
    EthGeneral:
      EthDevErrorDetect = 1
      EthGetDropCountApi = 1
      EthGetEtherStatsApi = 1
      EthGetTxErrorCounterValuesApi = 0
      EthGetTxStatsApi = 0
      EthGlobalTimeSupport = 1
      EthIndex = 0
      EthMainFunctionPeriod = 0.005
      EthMaxCtrlsSupported = 1
      EthSafetyErrorDetect = 1
      EthVersionInfoApi = 1
      EthCtrlOffloading: EthCtrlEnableOffloadChecksumICMP=1, EthCtrlEnableOffloadChecksumIPv4=1, EthCtrlEnableOffloadChecksumTCP=1, EthCtrlEnableOffloadChecksumUDP=1
