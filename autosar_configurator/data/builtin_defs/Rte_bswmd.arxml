AUTOSAR XML (schema 4-2-2)
package /AUTOSAR/EcucDefs
  module definition Rte: variants pre-compile  # AUTOSAR Classic R4.2.2 minimal built-in Rte / SchM ECUC Module Definition
    container RteGeneration [0..1]  # Global RTE and SchM generation switches
      boolean RteEnableMultiCore [0..1]: default-value=false
      boolean RteEnableMemoryProtection [0..1]: default-value=false
      boolean RteDevErrorDetect [0..1]: default-value=false
      boolean RteDevErrorDetectUninit [0..1]: default-value=false
      boolean RteDisableRteInitMemory [0..1]: default-value=false
      boolean RteVfbTraceEnabled [0..1]: default-value=false
      enumeration RteGenerationMode [0..1]: {COMPATIBILITY_MODE, VENDOR_MODE}, default-value=COMPATIBILITY_MODE
      enumeration RteOptimizationMode [0..1]: {RUNTIME, MEMORY, NONE}, default-value=RUNTIME
    container RteBswGeneral [0..1]  # General BSW Scheduler configuration switches
      boolean RteSchMVersionInfoApi [0..1]: default-value=false
    container RteBswModuleInstance [0..*]  # Configuration of a BSW module instance handled by SchM
      foreign reference RteBswModuleConfigurationRef [0..1]: destination-type=ECUC-MODULE-CONFIGURATION-VALUES
      foreign reference RteBswImplementationRef [0..1]: destination-type=BSW-IMPLEMENTATION
      container RteBswExclusiveAreaImpl [0..*]  # ExclusiveArea protection mechanism configuration for a BSW module instance
        enumeration RteExclusiveAreaImplMechanism [0..1]: {ALL_INTERRUPT_BLOCKING, OS_INTERRUPT_BLOCKING, OS_RESOURCE, OS_SPINLOCK, COOPERATIVE_RUNNABLE_PLACEMENT, NONE, CUSTOM}, default-value=ALL_INTERRUPT_BLOCKING
        boolean RteExclusiveAreaGenerateFunction [0..1]: default-value=false
        foreign reference RteBswExclusiveAreaRef [0..1]: destination-type=EXCLUSIVE-AREA
        reference RteBswExclusiveAreaOsResourceRef [0..1]: destination=OsResource
        reference RteBswExclusiveAreaOsSpinlockRef [0..1]: destination=OsSpinlock
      container RteBswEventToTaskMapping [0..*]  # Mapping of BSW schedulable entity events to OS tasks
        integer RteBswPositionInTask [0..1]: 0..65535
        boolean RteBswImmediateRestart [0..1]: default-value=false
        foreign reference RteBswEventRef [0..1]: destination-type=BSW-EVENT
        reference RteBswMappedToTaskRef [0..1]: destination=OsTask
        reference RteBswUsedOsEventRef [0..1]: destination=OsEvent
        reference RteBswUsedOsAlarmRef [0..1]: destination=OsAlarm
        reference RteBswUsedOsSchTblExpiryPointRef [0..1]: destination=OsScheduleTableExpiryPoint
    container RteOsInteraction [0..1]  # OS task activation and schedule table interaction settings
      container RteUsedOsActivation [0..*]  # Links an activated OS task to its OS alarm or schedule table trigger
        float RteExpectedTickDuration [0..1]: 0.0..
        float RteExpectedActivationOffset [0..1]: 0.0..
        reference RteActivationOsTaskRef [0..1]: destination=OsTask
        reference RteActivationOsAlarmRef [0..1]: destination=OsAlarm
        reference RteActivationOsSchTblRef [0..1]: destination=OsScheduleTable
    container RteSwComponentInstance [0..*]  # Configuration of an SWC instance mapped to OS tasks
      container RteEventToTaskMapping [0..*]  # Mapping of an SWC event to an OS task
        integer RtePositionInTask [0..1]: 0..65535
        boolean RteImmediateRestart [0..1]: default-value=false
        foreign reference RteEventRef [0..1]: destination-type=RTE-EVENT
        reference RteMappedToTaskRef [0..1]: destination=OsTask
