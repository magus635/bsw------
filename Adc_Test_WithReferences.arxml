AUTOSAR XML (schema 4.0)
package /Config
  module config Adc
    AdcGeneral: AdcDevErrorDetect=1, AdcDeInitApi=1, AdcEnableStartStopGroupApi=1
    AdcConfigSet: AdcPrescale=14, AdcResolution=BITS_12
      AdcHwUnit_0 (AdcHwUnit): AdcHwUnitId=SARADC0, AdcPrescale=14, AdcClockRef=McuClockReferencePoint_ADC
        AdcChannel_0 (AdcChannel): AdcChannelId=0, AdcChannelResolution=BITS_12
        AdcChannel_1 (AdcChannel): AdcChannelId=1, AdcChannelResolution=BITS_10
      AdcHwUnit_1 (AdcHwUnit): AdcHwUnitId=SARADC1, AdcPrescale=20, AdcClockRef=McuClockReferencePoint_ADC
      AdcGroup_0 (AdcGroup): AdcGroupId=0, AdcGroupDefinition=AdcChannel_0
