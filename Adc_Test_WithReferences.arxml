AUTOSAR XML (schema 4-4-0)
package /Adc_Config
  module config Adc: implementation-config-variant=VARIANT-PRE-COMPILE
    AdcGeneral: AdcDevErrorDetect=true, AdcDeInitApi=true, AdcEnableStartStopGroupApi=true
    AdcConfigSet: AdcPrescale=14, AdcResolution=BITS_12, AdcClockRef=McuClockReferencePoint_ADC
      AdcHwUnit_0 (AdcHwUnit): AdcPrescale=14, AdcHwUnitId=SARADC0, AdcClockRef=McuClockReferencePoint_ADC
        AdcChannel_0 (AdcChannel): AdcChannelId=false, AdcChannelResolution=BITS_12
        AdcChannel_1 (AdcChannel): AdcChannelId=true, AdcChannelResolution=BITS_10
      AdcHwUnit_1 (AdcHwUnit): AdcPrescale=20, AdcHwUnitId=SARADC1, AdcClockRef=McuClockReferencePoint_ADC
      AdcGroup_0 (AdcGroup): AdcGroupId=false, AdcGroupDefinition=AdcChannel_0
