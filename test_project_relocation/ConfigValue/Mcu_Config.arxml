AUTOSAR XML (schema 4-4-0)
package /Mcu_Config
  module config Mcu: implementation-config-variant=VARIANT-PRE-COMPILE
    McuClockConfig_0 (McuClockConfig): McuClockFrequency=80000000, McuClockSourceType=MCU_CLOCK_PLL
      McuClockSource_0 (McuClockSource): McuClockFrequency=160000000, McuClockSourceType=MCU_CLOCK_PLL
