AUTOSAR XML (schema 4-4-0)
package /Port_Config
  module config Port: implementation-config-variant=VARIANT-PRE-COMPILE
    PortPin_0 (PortPin): PortPinId=10, PortPinMode=PORT_PIN_MODE_GPIO, PortPinDirection=PORT_PIN_IN, PortPinInitialMode=PORT_PIN_MODE_GPIO
