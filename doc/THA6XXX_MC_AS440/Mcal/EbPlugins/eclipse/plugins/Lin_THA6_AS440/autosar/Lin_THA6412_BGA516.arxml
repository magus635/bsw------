AUTOSAR XML (schema 00046)
package /THA6_AS440_FuSa
  ecuc definition collection Lin_EcuParameterDefinition: module=Lin
  module definition Lin [0..*]: post-build-variant-support=true, refined-module-def=Lin, variants post-build  # Configuration of the Lin (LIN driver) module.
    container LinDemEventParameterRefs [0..1]: multiplicity set at pre-compile, requires-index=true  # Container for the references to DemEventParameter elements which shall be invoked using the API Dem_ReportErrorStatus API in case the corresponding error occurs. The EventId is taken from the referenced DemEventParameter's DemEventId value. The standardized errors are provided in the container and can be extended by vendor specific error references.
      reference LIN_E_TIMEOUT [0..1]: multiplicity set at pre-compile, set at pre-compile, requires-symbolic-name-value=true, destination=DemEventParameter  # Reference to the DemEventParameter which shall be issued when the error "Timeout caused by hardware error" has occured.
    container LinClockSet: requires-index=true  # This container contains All LIN hardware unit baudrate clock setting.
      reference LinSysClockRef: origin=ChipowerTech, set at pre-compile, destination=McuClockReferencePoint  # Reference to the LIN clock source configuration, which is set in the MCU driver configuration. Note This is used to replace 'LinClockRef'
    container LinGeneral  # This container contains the parameters related to each LIN Driver Unit.
      integer LinIndex: 0..255, set at pre-compile, default-value=0  # Specifies the InstanceId of this module instance. If only one instance is present it shall have the Id 0.
      integer LinTimeoutDuration: 0..65535, set at pre-compile, default-value=1000  # Specifies the maximum number of loops for blocking function until a timeout is raised in short term wait loops
      boolean LinDevErrorDetect: set at pre-compile, default-value=false  # Switches the Default Error Tracer (Det) detection and notification ON or OFF. true: enabled (ON). false: disabled (OFF).
      boolean LinVersionInfoApi: set at pre-compile, default-value=false  # Switches the Lin_GetVersionInfo function ON or OFF.
      boolean LinInterruptEnable: origin=ChipowerTech, set at pre-compile, default-value=true  # Specify LIN operation in interrupt enabled or interrupt disabled mode. true: Interrupt mode Enabled; false: Interrupt mode Disabled
      reference LinEcucPartitionRef [0..*]: scope=ECU, multiplicity set at pre-compile, post-build-variant-multiplicity=true, post-build-variant-value=true, set at pre-compile, destination=EcucPartition  # Maps the Lin driver to zero or multiple ECUC partitions to make the modules API available in this partition. The Lin driver will operate as an independent instance in each of the partitions.
    container LinGlobalConfig  # This container contains the global configuration parameter of the Lin driver.
      container LinChannel [1..24]: multiplicity set at pre-compile, requires-index=true  # This container contains the configuration (parameters) of the LIN Controller(s).
        integer LinChannelId: 0..65535, set at pre-compile, symbolic-name-value=true, default-value=0  # Identifies the LIN channel. Replaces LIN_CHANNEL_INDEX_NAME from the LIN SWS.
        enumeration LinHwUnit: {ASI0, ASI1, ASI2, ASI3, ASI4, ASI5, ASI6, ASI7, ASI8, ASI9, ASI10, ASI11, ASI12, ASI13, ASI14, ASI15, ASI16, ASI17, ASI18, ASI19, ASI20, ASI21, ASI22, ASI23}, origin=ChipowerTech, set at pre-compile, default-value=ASI0  # This parameter selects the hardware unit used to tranfer lin data.
        integer LinChannelBaudRate: 1000..20000, post-build-variant-value=true, set at post-build, default-value=19200  # Specifies the baud rate of the LIN channel
        enumeration LinFrameBreakFieldLength: {LIN_BREAKLEN_10BIT, LIN_BREAKLEN_11BIT, LIN_BREAKLEN_12BIT, LIN_BREAKLEN_13BIT, LIN_BREAKLEN_14BIT, LIN_BREAKLEN_15BIT, LIN_BREAKLEN_16BIT, LIN_BREAKLEN_17BIT, LIN_BREAKLEN_18BIT, LIN_BREAKLEN_19BIT, LIN_BREAKLEN_20BIT, LIN_BREAKLEN_21BIT, LIN_BREAKLEN_22BIT, LIN_BREAKLEN_23BIT, LIN_BREAKLEN_36BIT, LIN_BREAKLEN_50BIT}, origin=ChipowerTech, post-build-variant-value=true, set at post-build, default-value=LIN_BREAKLEN_13BIT  # configuration Lin frame break field length.
        boolean LinChannelWakeupSupport: set at pre-compile, default-value=false  # Specifies if the LIN hardware channel supports wake up functionality
        enumeration LinNodeType: {MASTER, SLAVE}, set at pre-compile, default-value=MASTER  # Specifies the LIN node type of this channel.
        reference LinClockRef: post-build-variant-value=true, set at post-build, destination=McuClockReferencePoint  # Reference to the LIN clock source configuration, which is set in the MCU driver configuration. Note This parameter is not used, replaced by 'LinClockSet/LinSysClockRef'
        reference LinChannelEcuMWakeupSource [0..1]: multiplicity set at pre-compile, set at pre-compile, requires-symbolic-name-value=true, destination=EcuMWakeupSource  # This parameter contains a reference to the Wakeup Source for this controller as defined in the ECU State Manager.
        reference LinChannelEcucPartitionRef [0..1]: scope=ECU, multiplicity set at pre-compile, post-build-variant-multiplicity=true, post-build-variant-value=true, set at pre-compile, destination=EcucPartition  # Maps one single Lin channel to zero or one ECUC partitions. The ECUC partition referenced is a subset of the ECUC partitions where the Lin driver is mapped to.
    container CommonPublishedInformation  # Common container, aggregated by all modules. It contains published information about vendor and versions.
      integer ArReleaseMajorVersion: 0..255, origin=ChipowerTech, set at published-information, default-value=4  # Major version number of AUTOSAR specification on which the appropriate implementation is based on.
      integer ArReleaseMinorVersion: 0..255, origin=ChipowerTech, set at published-information, default-value=4  # Minor version number of AUTOSAR specification on which the appropriate implementation is based on.
      integer ArReleaseRevisionVersion: 0..255, origin=ChipowerTech, set at published-information, default-value=0  # Revision version number of AUTOSAR specification on which the appropriate implementation is based on.
      integer ModuleId: 0..255, origin=ChipowerTech, set at published-information, default-value=82  # Module ID of this module from Module List.
      integer SwMajorVersion: 0..255, origin=ChipowerTech, set at published-information, default-value=1  # Major version number of the vendor specific implementation of the module. The numbering is vendor specific.
      integer SwMinorVersion: 0..255, origin=ChipowerTech, set at published-information, default-value=2  # Minor version number of the vendor specific implementation of the module. The numbering is vendor specific.
      integer SwPatchVersion: 0..255, origin=ChipowerTech, set at published-information, default-value=0  # Patch level version number of the vendor specific implementation of the module. The numbering is vendor specific.
      integer VendorId: 175..175, origin=ChipowerTech, set at published-information, default-value=175  # Vendor ID of the dedicated implementation of this module according to the AUTOSAR vendor list.
