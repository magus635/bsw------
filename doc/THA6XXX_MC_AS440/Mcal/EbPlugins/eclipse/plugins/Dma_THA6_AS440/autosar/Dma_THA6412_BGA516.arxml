AUTOSAR XML (schema 00046)
package /THA6_AS440_FuSa
  ecuc definition collection Dma_EcuParameterDefinition: module=Dma
  module definition Dma [0..*]: post-build-variant-support=true, variants post-build  # Configuration of the Dma (Dma driver) module.
    container DmaGeneral  # General configuration (parameters) of the Dma Driver software module.
      boolean DmaDevErrorDetect: origin=ChipowerTech, set at pre-compile, default-value=false  # Switches the Default Error Tracer (Det) detection and notification ON or OFF.
      boolean DmaSafetyErrorDetect: origin=ChipowerTech, set at pre-compile, default-value=true  # Switches the Safety Error detection ON or OFF.
      boolean DmaDeInitApi: origin=ChipowerTech, set at pre-compile, default-value=false  # Adds / removes the service Dma_DeInit() from the code. Note true: Dma_DeInit() can be used. false: Dma_DeInit() can not be used.
      boolean DmaSuspendResumeApi: origin=ChipowerTech, set at pre-compile, default-value=false  # Adds / removes the service Dma_ChannelPause(), Dma_ChannelResume() from the code. Note true: Dma_ChannelSuspend(), Dma_ChannelResume() can be used. false: Dma_ChannelSuspend(), Dma_ChannelResume() can not be used. Caution The Suspend and Resume API is not supported on the THA6206 Subderivative.
      boolean DmaCancelApi: origin=ChipowerTech, set at pre-compile, default-value=false  # Adds / removes the service Dma_ChannelCancel() from the code. Note true: Dma_ChannelCancel() can be used. false: Dma_ChannelCancel() can not be used.
      boolean DmaRemainingTransferApi: origin=ChipowerTech, set at pre-compile, default-value=false  # Adds / removes the service Dma_GetChannelRemainTransfer() from the code. Note true: Dma_GetChannelRemainTransfer() can be used. false: Dma_GetChannelRemainTransfer() can not be used.
      boolean DmaVersionInfoApi: origin=ChipowerTech, set at pre-compile, default-value=false  # Adds / removes the service Dma_GetVersionInfo() from the code.
      boolean DmaDoubleBufferSoftwareSwitchApi: origin=ChipowerTech, set at pre-compile, default-value=false  # Adds / removes the service Dma_ChannelDoubleBufferSwitch() from the code. Note This parameter is available only if the parameter DmaDoubleBufferEnable is set to true.
      boolean DmaTransferUpdateApi: origin=ChipowerTech, set at pre-compile, default-value=false  # Adds / removes the service Dma_ChannelUpdate() from the code and Enable/Disable the multiple transfer configuration. true: Multiple transfer configuration can be configured in DmaChannel/DmaChTransferConfig, and API Dma_ChannelUpdate() can be used. false: Only one transfer configuration valid in DmaChannel/DmaChTransferConfig, and API Dma_ChannelUpdate() can not be used.
      boolean DmaShadowingUpdateApi: origin=ChipowerTech, set at pre-compile, default-value=false  # Adds / removes the service Dma_ChannelShadowingUpdate() from the code and Enable/Disable the multiple shadowing operation configuration. true: Multiple shadowing operation configuration can be configured in DmaChannel/DmaChShadowConfig, and API Dma_ChannelShadowingUpdate() can be used. false: Only one shadowing operation configuration valid in DmaChannel/DmaChShadowConfig, and API Dma_ChannelShadowingUpdate() can not be used. Note At least one channel needs to have shadowing operation enabled, that is DmaChannel/*/DmaChannelShadowOperationEnable = true. This parameter is available only if the parameter DmaShadowingOperationEnable is set to true.
      boolean DmaTransferUpdateManualApi: origin=ChipowerTech, set at pre-compile, default-value=false  # Adds / removes the service Dma_ChannelUpdateManual() from the code and Enable/Disable the multiple shadowing operation configuration. true: Multiple shadowing operation configuration can be configured in DmaChannel/DmaChShadowConfig, and API Dma_ChannelUpdateManual() can be used. false: Only one shadowing operation configuration valid in DmaChannel/DmaChShadowConfig, and API Dma_ChannelUpdateManual() can not be used.
      boolean DmaLinkedListEnable: origin=ChipowerTech, set at pre-compile, default-value=false  # Enables / disables the linked list feature.
      boolean DmaContinuousModeEnable: origin=ChipowerTech, set at pre-compile, default-value=false  # Enables / Disables the continuous mode(refill mode).
      boolean DmaDoubleBufferEnable: origin=ChipowerTech, set at pre-compile, default-value=false  # Enables / Disabled the double buffer feature.
      boolean DmaShadowingOperationEnable: origin=ChipowerTech, set at pre-compile, default-value=false  # Enables / Disables the shadowing operation feature.
      boolean DmaCircularBufferEnable: origin=ChipowerTech, set at pre-compile, default-value=false  # Enables / Disables the circular buffer feature.
      boolean DmaPatternEnable: origin=ChipowerTech, set at pre-compile, default-value=false  # Enables / Disables the pattern match feature.
      boolean DmaDaisyChainEnable: origin=ChipowerTech, set at pre-compile, default-value=false  # Enables / Disables the daisy chain feature.
    container DmaConfigSet  # This container contains the configuration parameters and sub containers of the AUTOSAR CDD Dma driver..
      string DmaUserHeaderFile [0..*]: multiplicity set at post-build, origin=ChipowerTech, post-build-variant-multiplicity=true, post-build-variant-value=true, requires-index=true, set at post-build  # Header file name which will be included by the Dma. The value of this parameter shall be used as h-char-sequence or q-char-sequence according to ISO C90 section 6.10.2 "source file inclusion". The parameter value MUST NOT represent a path, since ISO C90 does not specify how such a path is treated (i.e., this is implementation defined (and additionally depends on the operating system and the underlying file system)).
      container DmaChannel [1..128]: multiplicity set at pre-compile, requires-index=true  # This container contains the configuration (parameters) of the Dma channels.
        integer DmaChannelId: 0..65535, origin=ChipowerTech, set at pre-compile, symbolic-name-value=true, default-value=1  # Logical identifies for each channel.
        enumeration DmaChannelHwUnitAllocation: {DMA0, DMA1, DMA2, DMA3}, origin=ChipowerTech, set at pre-compile, default-value=DMA0  # Select the DMA hardware unit used for each channel.
        integer DmaPhyChannel: 0..254, origin=ChipowerTech, set at pre-compile, default-value=0  # Specifies the DMA physical channel for each channel.
        boolean DmaChannelLinkedListEnable [0..1]: multiplicity set at post-build, origin=ChipowerTech, post-build-variant-multiplicity=true, post-build-variant-value=true, set at post-build, default-value=false  # Enables / Disables the linked list feature for each channel. Note This parameter is only valid when DmaLinkedListEnable = true.
        boolean DmaChannelContinuousEnable [0..1]: multiplicity set at post-build, origin=ChipowerTech, post-build-variant-multiplicity=true, post-build-variant-value=true, set at post-build, default-value=true  # Enables / Disables the refill mode for each channel, meaning this channel will be automatically refill the configuration parameters after the transfer is completed. Note this parameter is invalid if the parameter DmaChannelDoubleBufferEnable or DmaChannelShadowOperationEnable is set to true due to double buffering and shadowing operation always work in refill mode This parameter is available only if the parameter DmaContinuousModeEnable is set to true.
        boolean DmaChannelDoubleBufferEnable [0..1]: multiplicity set at post-build, origin=ChipowerTech, post-build-variant-multiplicity=true, post-build-variant-value=true, set at post-build, default-value=false  # Enables / Disables the double buffer feature for each channel. Note This parameter is available only if the parameter DmaDoubleBufferEnable is set to true.
        boolean DmaChannelShadowOperationEnable [0..1]: multiplicity set at post-build, origin=ChipowerTech, post-build-variant-multiplicity=true, post-build-variant-value=true, set at post-build, default-value=false  # Enables / Disables the Shadowing buffer feature for each channel. Note This parameter is available only if the parameter DmaShadowingOperationEnable is set to true.
        boolean DmaChannelCircularBufferEnable [0..1]: multiplicity set at post-build, origin=ChipowerTech, post-build-variant-multiplicity=true, post-build-variant-value=true, set at post-build, default-value=false  # Enables / Disables the circular buffer feature for each channel. Note This parameter is available only if the parameter DmaCircularBufferEnable is set to true.
        boolean DmaChannelPatternEnable [0..1]: multiplicity set at post-build, origin=ChipowerTech, post-build-variant-multiplicity=true, post-build-variant-value=true, set at post-build, default-value=false  # Enables / Disables the pattern match feature for each channel. Note This parameter is available only if the parameter DmaPatternEnable is set to true.
        boolean DmaChannelInterruptEnable: origin=ChipowerTech, set at pre-compile, default-value=false  # Enables / Disables the interrupt feature for each channel.
        enumeration DmaChTransferConfigFlowControl: {DMA_M2M, DMA_M2P, DMA_P2M, DMA_P2P, DPER_P2P, PER_M2P, PER_P2M, SPER_P2P}, origin=ChipowerTech, post-build-variant-value=true, set at post-build, default-value=DMA_M2M  # Channel transfer flow control type. DMA_M2M: DMA flow control with memory to memory DMA_M2P: DMA flow control with memory to peripheral DMA_P2M: DMA flow control with peripheral to memory DMA_P2P: DMA flow control with peripheral to peripheral DPER_P2P: Destination peripheral flow control with peripheral to peripheral PER_M2P: Peripheral flow control with memory to peripheral PER_P2M: Peripheral flow control with peripheral to memory SPER_P2P: Source peripheral flow control with peripheral to peripheral.
        enumeration DmaChannelSourceRequestSelect [0..1]: {DMA_REQUEST0_GTM, DMA_REQUEST1_GTM, DMA_REQUEST2_GTM, DMA_REQUEST3_GTM, DMA_REQUEST4_GTM, DMA_REQUEST5_GTM, DMA_REQUEST6_GTM, DMA_REQUEST7_GTM, DMA_REQUEST8_QSPI, DMA_REQUEST9_GLOBAL_REQUEST, DMA_REQUEST10_GLOBAL_REQUEST, DMA_REQUEST11_GLOBAL_REQUEST, DMA_REQUEST12_GLOBAL_REQUEST, DMA_REQUEST13_GLOBAL_REQUEST, DMA_REQUEST14_GLOBAL_REQUEST, DMA_REQUEST15_GLOBAL_REQUEST, DMA_REQUEST16_GLOBAL_REQUEST, DMA_REQUEST17_GLOBAL_REQUEST, DMA_REQUEST18_GLOBAL_REQUEST, DMA_REQUEST19_GLOBAL_REQUEST, DMA_REQUEST20_GLOBAL_REQUEST, DMA_REQUEST21_GLOBAL_REQUEST, DMA_REQUEST22_GLOBAL_REQUEST, DMA_REQUEST23_GLOBAL_REQUEST, DMA_REQUEST24_GLOBAL_REQUEST, DMA_REQUEST25_GLOBAL_REQUEST, DMA_REQUEST34_GLOBAL_REQUEST, DMA_REQUEST35_GLOBAL_REQUEST, DMA_REQUEST36_GLOBAL_REQUEST, DMA_REQUEST0_DSADC0, DMA_REQUEST1_DSADC1, DMA_REQUEST2_DSADC2, DMA_REQUEST3_DSADC3, DMA_REQUEST4_FC0, DMA_REQUEST5_FC1, DMA_REQUEST6_SARADC0_RESULT0, DMA_REQUEST7_SARADC0_RESULT1, DMA_REQUEST8_SARADC0_RESULT2, DMA_REQUEST9_SARADC0_RESULT3, DMA_REQUEST10_SARADC0_RESULT4, DMA_REQUEST11_SARADC0_RESULT5, DMA_REQUEST12_SARADC0_RESULT6, DMA_REQUEST13_SARADC0_RESULT7, DMA_REQUEST14_SARADC0_RESULT8, DMA_REQUEST15_SARADC0_RESULT9, DMA_REQUEST16_SARADC0_RESULT10, DMA_REQUEST17_SARADC0_RESULT11, DMA_REQUEST18_SARADC0_RESULT12, DMA_REQUEST19_SARADC0_RESULT13, DMA_REQUEST20_SARADC0_RESULT14, DMA_REQUEST21_SARADC0_RESULT15, DMA_REQUEST22_SARADC_GLOBAL_RESULT, DMA_REQUEST23_SARADC1_RESULT0, DMA_REQUEST24_SARADC1_RESULT1, DMA_REQUEST25_SARADC1_RESULT2, DMA_REQUEST26_SARADC1_RESULT3, DMA_REQUEST27_SARADC1_RESULT4, DMA_REQUEST28_SARADC1_RESULT5, DMA_REQUEST29_SARADC1_RESULT6, DMA_REQUEST30_SARADC1_RESULT7, DMA_REQUEST31_SARADC1_RESULT8, DMA_REQUEST32_SARADC1_RESULT9, DMA_REQUEST33_SARADC1_RESULT10, DMA_REQUEST34_SARADC1_RESULT11, DMA_REQUEST35_SARADC1_RESULT12, DMA_REQUEST36_SARADC1_RESULT13, DMA_REQUEST37_SARADC1_RESULT14, DMA_REQUEST38_SARADC1_RESULT15, DMA_REQUEST39_SARADC2_RESULT0, DMA_REQUEST40_SARADC2_RESULT1, DMA_REQUEST41_SARADC2_RESULT2, DMA_REQUEST42_SARADC2_RESULT3, DMA_REQUEST43_SARADC2_RESULT4, DMA_REQUEST44_SARADC2_RESULT5, DMA_REQUEST45_SARADC2_RESULT6, DMA_REQUEST46_SARADC2_RESULT7, DMA_REQUEST47_SARADC2_RESULT8, DMA_REQUEST48_SARADC2_RESULT9, DMA_REQUEST49_SARADC2_RESULT10, DMA_REQUEST50_SARADC2_RESULT11, DMA_REQUEST51_SARADC2_RESULT12, DMA_REQUEST52_SARADC2_RESULT13, DMA_REQUEST53_SARADC2_RESULT14, DMA_REQUEST54_SARADC2_RESULT15, DMA_REQUEST55_SARADC3_RESULT0, DMA_REQUEST56_SARADC3_RESULT1, DMA_REQUEST57_SARADC3_RESULT2, DMA_REQUEST58_SARADC3_RESULT3, DMA_REQUEST59_SARADC3_RESULT4, DMA_REQUEST60_SARADC3_RESULT5, DMA_REQUEST61_SARADC3_RESULT6, DMA_REQUEST62_SARADC3_RESULT7, DMA_REQUEST63_SARADC3_RESULT8, DMA_REQUEST64_SARADC3_RESULT9, DMA_REQUEST65_SARADC3_RESULT10, DMA_REQUEST66_SARADC3_RESULT11, DMA_REQUEST67_SARADC3_RESULT12, DMA_REQUEST68_SARADC3_RESULT13, DMA_REQUEST69_SARADC3_RESULT14, DMA_REQUEST70_SARADC3_RESULT15, DMA_REQUEST71_SARADC8_RESULT0, DMA_REQUEST72_SARADC8_RESULT1, DMA_REQUEST73_SARADC8_RESULT2, DMA_REQUEST74_SARADC8_RESULT3, DMA_REQUEST75_SARADC8_RESULT4, DMA_REQUEST76_SARADC8_RESULT5, DMA_REQUEST77_SARADC8_RESULT6, DMA_REQUEST78_SARADC8_RESULT7, DMA_REQUEST79_SARADC8_RESULT8, DMA_REQUEST80_SARADC8_RESULT9, DMA_REQUEST81_SARADC8_RESULT10, DMA_REQUEST82_SARADC8_RESULT11, DMA_REQUEST83_SARADC8_RESULT12, DMA_REQUEST84_SARADC8_RESULT13, DMA_REQUEST85_SARADC8_RESULT14, DMA_REQUEST86_SARADC8_RESULT15, DMA_REQUEST87_SARADC9_RESULT0, DMA_REQUEST88_SARADC9_RESULT1, DMA_REQUEST89_SARADC9_RESULT2, DMA_REQUEST90_SARADC9_RESULT3, DMA_REQUEST91_SARADC9_RESULT4, DMA_REQUEST92_SARADC9_RESULT5, DMA_REQUEST93_SARADC9_RESULT6, DMA_REQUEST94_SARADC9_RESULT7, DMA_REQUEST95_SARADC9_RESULT8, DMA_REQUEST96_SARADC9_RESULT9, DMA_REQUEST97_SARADC9_RESULT10, DMA_REQUEST98_SARADC9_RESULT11, DMA_REQUEST99_SARADC9_RESULT12, DMA_REQUEST100_SARADC9_RESULT13, DMA_REQUEST101_SARADC9_RESULT14, DMA_REQUEST102_SARADC9_RESULT15, DMA_REQUEST103_GLOBAL_REQUEST, DMA_REQUEST104_GLOBAL_REQUEST, DMA_REQUEST105_GLOBAL_REQUEST, DMA_REQUEST106_GLOBAL_REQUEST, DMA_REQUEST107_GLOBAL_REQUEST, DMA_REQUEST108_GLOBAL_REQUEST, DMA_REQUEST109_GLOBAL_REQUEST, DMA_REQUEST110_GLOBAL_REQUEST, DMA_REQUEST111_SARADC4_RESULT0, DMA_REQUEST112_SARADC4_RESULT1, DMA_REQUEST113_SARADC4_RESULT2, DMA_REQUEST114_SARADC4_RESULT3, DMA_REQUEST115_SARADC4_RESULT4, DMA_REQUEST116_SARADC4_RESULT5, DMA_REQUEST117_SARADC4_RESULT6, DMA_REQUEST118_SARADC4_RESULT7, DMA_REQUEST119_SARADC4_RESULT8, DMA_REQUEST120_SARADC4_RESULT9, DMA_REQUEST121_SARADC4_RESULT10, DMA_REQUEST122_SARADC4_RESULT11, DMA_REQUEST123_SARADC4_RESULT12, DMA_REQUEST124_SARADC4_RESULT13, DMA_REQUEST125_SARADC4_RESULT14, DMA_REQUEST126_SARADC4_RESULT15, DMA_REQUEST127_SARADC5_RESULT0, DMA_REQUEST128_SARADC5_RESULT1, DMA_REQUEST129_SARADC5_RESULT2, DMA_REQUEST130_SARADC5_RESULT3, DMA_REQUEST131_SARADC5_RESULT4, DMA_REQUEST132_SARADC5_RESULT5, DMA_REQUEST133_SARADC5_RESULT6, DMA_REQUEST134_SARADC5_RESULT7, DMA_REQUEST135_SARADC5_RESULT8, DMA_REQUEST136_SARADC5_RESULT9, DMA_REQUEST137_SARADC5_RESULT10, DMA_REQUEST138_SARADC5_RESULT11, DMA_REQUEST139_SARADC5_RESULT12, DMA_REQUEST140_SARADC5_RESULT13, DMA_REQUEST141_SARADC5_RESULT14, DMA_REQUEST142_SARADC5_RESULT15, DMA_REQUEST143_SARADC6_RESULT0, DMA_REQUEST144_SARADC6_RESULT1, DMA_REQUEST145_SARADC6_RESULT2, DMA_REQUEST146_SARADC6_RESULT3, DMA_REQUEST147_SARADC6_RESULT4, DMA_REQUEST148_SARADC6_RESULT5, DMA_REQUEST149_SARADC6_RESULT6, DMA_REQUEST150_SARADC6_RESULT7, DMA_REQUEST151_SARADC6_RESULT8, DMA_REQUEST152_SARADC6_RESULT9, DMA_REQUEST153_SARADC6_RESULT10, DMA_REQUEST154_SARADC6_RESULT11, DMA_REQUEST155_SARADC6_RESULT12, DMA_REQUEST156_SARADC6_RESULT13, DMA_REQUEST157_SARADC6_RESULT14, DMA_REQUEST158_SARADC6_RESULT15, DMA_REQUEST159_SARADC7_RESULT0, DMA_REQUEST160_SARADC7_RESULT1, DMA_REQUEST161_SARADC7_RESULT2, DMA_REQUEST162_SARADC7_RESULT3, DMA_REQUEST163_SARADC7_RESULT4, DMA_REQUEST164_SARADC7_RESULT5, DMA_REQUEST165_SARADC7_RESULT6, DMA_REQUEST166_SARADC7_RESULT7, DMA_REQUEST167_SARADC7_RESULT8, DMA_REQUEST168_SARADC7_RESULT9, DMA_REQUEST169_SARADC7_RESULT10, DMA_REQUEST170_SARADC7_RESULT11, DMA_REQUEST171_SARADC7_RESULT12, DMA_REQUEST172_SARADC7_RESULT13, DMA_REQUEST173_SARADC7_RESULT14, DMA_REQUEST174_SARADC7_RESULT15, DMA_REQUEST175_SARADC10_RESULT0, DMA_REQUEST176_SARADC10_RESULT1, DMA_REQUEST177_SARADC10_RESULT2, DMA_REQUEST178_SARADC10_RESULT3, DMA_REQUEST179_SARADC10_RESULT4, DMA_REQUEST180_SARADC10_RESULT5, DMA_REQUEST181_SARADC10_RESULT6, DMA_REQUEST182_SARADC10_RESULT7, DMA_REQUEST183_SARADC10_RESULT8, DMA_REQUEST184_SARADC10_RESULT9, DMA_REQUEST185_SARADC10_RESULT10, DMA_REQUEST186_SARADC10_RESULT11, DMA_REQUEST187_SARADC10_RESULT12, DMA_REQUEST188_SARADC10_RESULT13, DMA_REQUEST189_SARADC10_RESULT14, DMA_REQUEST190_SARADC10_RESULT15, DMA_REQUEST191_SARADC11_RESULT0, DMA_REQUEST192_SARADC11_RESULT1, DMA_REQUEST193_SARADC11_RESULT2, DMA_REQUEST194_SARADC11_RESULT3, DMA_REQUEST195_SARADC11_RESULT4, DMA_REQUEST196_SARADC11_RESULT5, DMA_REQUEST197_SARADC11_RESULT6, DMA_REQUEST198_SARADC11_RESULT7, DMA_REQUEST199_SARADC11_RESULT8, DMA_REQUEST200_SARADC11_RESULT9, DMA_REQUEST201_SARADC11_RESULT10, DMA_REQUEST202_SARADC11_RESULT11, DMA_REQUEST203_SARADC11_RESULT12, DMA_REQUEST204_SARADC11_RESULT13, DMA_REQUEST205_SARADC11_RESULT14, DMA_REQUEST206_SARADC11_RESULT15, DMA_REQUEST207_PSI5_CH0_DATA_TX, DMA_REQUEST208_PSI5_CH0_CTRL_TX, DMA_REQUEST209_PSI5_CH0_DATA_RX, DMA_REQUEST210_PSI5_CH0_CTRL_RX, DMA_REQUEST211_PSI5_CH1_DATA_TX, DMA_REQUEST212_PSI5_CH1_CTRL_TX, DMA_REQUEST213_PSI5_CH1_DATA_RX, DMA_REQUEST214_PSI5_CH1_CTRL_RX, DMA_REQUEST215_PSI5_CH2_DATA_TX, DMA_REQUEST216_PSI5_CH2_CTRL_TX, DMA_REQUEST217_PSI5_CH2_DATA_RX, DMA_REQUEST218_PSI5_CH2_CTRL_RX, DMA_REQUEST219_PSI5_CH3_DATA_TX, DMA_REQUEST220_PSI5_CH3_CTRL_TX, DMA_REQUEST221_PSI5_CH3_DATA_RX, DMA_REQUEST222_PSI5_CH3_CTRL_RX, DMA_REQUEST223_DSADC4, DMA_REQUEST224_DSADC5, DMA_REQUEST225_DSADC6, DMA_REQUEST226_DSADC7, DMA_REQUEST227_DSADC8, DMA_REQUEST228_DSADC9, DMA_REQUEST229_FC2, DMA_REQUEST230_FC3, DMA_REQUEST0_ESPI0_TX, DMA_REQUEST1_ESPI0_RX, DMA_REQUEST2_ESPI1_TX, DMA_REQUEST3_ESPI1_RX, DMA_REQUEST4_ESPI2_TX, DMA_REQUEST5_ESPI2_RX, DMA_REQUEST6_ESPI5_TX, DMA_REQUEST7_ESPI5_RX, DMA_REQUEST8_ESPI6_TX, DMA_REQUEST9_ESPI6_RX, DMA_REQUEST10_ESPI7_TX, DMA_REQUEST11_ESPI7_RX, DMA_REQUEST12_ESPI8_TX, DMA_REQUEST13_ESPI8_RX, DMA_REQUEST14_CAN00_TX_FIFO, DMA_REQUEST15_CAN00_RX_FIFO0, DMA_REQUEST16_CAN00_RX_FIFO1, DMA_REQUEST17_CAN00_TX_EVENT, DMA_REQUEST18_CAN01_TX_FIFO, DMA_REQUEST19_CAN01_RX_FIFO0, DMA_REQUEST20_CAN01_RX_FIFO1, DMA_REQUEST21_CAN01_TX_EVENT, DMA_REQUEST22_CAN02_TX_FIFO, DMA_REQUEST23_CAN02_RX_FIFO0, DMA_REQUEST24_CAN02_RX_FIFO1, DMA_REQUEST25_CAN02_TX_EVENT, DMA_REQUEST26_GLOBAL_REQUEST, DMA_REQUEST27_GLOBAL_REQUEST, DMA_REQUEST28_GLOBAL_REQUEST, DMA_REQUEST29_GLOBAL_REQUEST, DMA_REQUEST30_GLOBAL_REQUEST, DMA_REQUEST31_GLOBAL_REQUEST, DMA_REQUEST32_GLOBAL_REQUEST, DMA_REQUEST33_GLOBAL_REQUEST, DMA_REQUEST34_CAN22_TX_FIFO, DMA_REQUEST35_CAN22_RX_FIFO0, DMA_REQUEST36_CAN22_RX_FIFO1, DMA_REQUEST37_CAN22_TX_EVENT, DMA_REQUEST38_MSC1_DOWNSTREAM_DATA_TX, DMA_REQUEST39_MSC1_DOWNSTREAM_CMD_TX, DMA_REQUEST40_MSC1_DOWNSTREAM_PT, DMA_REQUEST41_MSC1_UPSTREAM_DATA_RX, DMA_REQUEST42_MSC2_DOWNSTREAM_DATA_TX, DMA_REQUEST43_MSC2_DOWNSTREAM_CMD_TX, DMA_REQUEST44_MSC2_DOWNSTREAM_PT, DMA_REQUEST45_MSC2_UPSTREAM_DATA_RX, DMA_REQUEST46_ECRC_CH0_RESULT, DMA_REQUEST47_ECRC_CH1_RESULT, DMA_REQUEST48_ECRC_CH2_RESULT, DMA_REQUEST49_ECRC_CH3_RESULT, DMA_REQUEST50_ECRC_CH4_RESULT, DMA_REQUEST51_ECRC_CH5_RESULT, DMA_REQUEST52_ECRC_CH6_RESULT, DMA_REQUEST53_ECRC_CH7_RESULT, DMA_REQUEST54_CAN20_TX_FIFO, DMA_REQUEST55_CAN20_RX_FIFO0, DMA_REQUEST56_CAN20_RX_FIFO1, DMA_REQUEST57_CAN20_TX_EVENT, DMA_REQUEST58_CAN21_TX_FIFO, DMA_REQUEST59_CAN21_RX_FIFO0, DMA_REQUEST60_CAN21_RX_FIFO1, DMA_REQUEST61_CAN21_TX_EVENT, DMA_REQUEST0_ASI0_LIN_UART_TX, DMA_REQUEST1_ASI0_LIN_UART_RX, DMA_REQUEST2_ASI1_LIN_UART_TX, DMA_REQUEST3_ASI1_LIN_UART_RX, DMA_REQUEST4_ASI2_LIN_UART_TX, DMA_REQUEST5_ASI2_LIN_UART_RX, DMA_REQUEST6_ASI3_LIN_UART_TX, DMA_REQUEST7_ASI3_LIN_UART_RX, DMA_REQUEST8_ASI4_LIN_UART_TX, DMA_REQUEST9_ASI4_LIN_UART_RX, DMA_REQUEST10_ASI5_LIN_UART_TX, DMA_REQUEST11_ASI5_LIN_UART_RX, DMA_REQUEST12_ASI6_LIN_UART_TX, DMA_REQUEST13_ASI6_LIN_UART_RX, DMA_REQUEST14_ASI7_LIN_UART_TX, DMA_REQUEST15_ASI7_LIN_UART_RX, DMA_REQUEST16_ESPI3_TX, DMA_REQUEST17_ESPI3_RX, DMA_REQUEST18_ESPI4_TX, DMA_REQUEST19_ESPI4_RX, DMA_REQUEST20_I2C0_TX_RX, DMA_REQUEST21_MSC0_DOWNSTREAM_DATA_TX, DMA_REQUEST22_MSC0_DOWNSTREAM_CMD_TX, DMA_REQUEST23_MSC0_DOWNSTREAM_PT, DMA_REQUEST24_MSC0_UPSTREAM_DATA_RX, DMA_REQUEST25_CAN10_TX_FIFO, DMA_REQUEST26_CAN10_RX_FIFO0, DMA_REQUEST27_CAN10_RX_FIFO1, DMA_REQUEST28_CAN10_TX_EVENT, DMA_REQUEST29_CAN11_TX_FIFO, DMA_REQUEST30_CAN11_RX_FIFO0, DMA_REQUEST31_CAN11_RX_FIFO1, DMA_REQUEST32_CAN11_TX_EVENT, DMA_REQUEST33_CAN12_TX_FIFO, DMA_REQUEST34_CAN12_RX_FIFO0, DMA_REQUEST35_CAN12_RX_FIFO1, DMA_REQUEST36_CAN12_TX_EVENT, DMA_REQUEST37_GLOBAL_REQUEST, DMA_REQUEST38_GLOBAL_REQUEST, DMA_REQUEST39_GLOBAL_REQUEST, DMA_REQUEST40_GLOBAL_REQUEST, DMA_REQUEST41_GLOBAL_REQUEST, DMA_REQUEST42_GLOBAL_REQUEST, DMA_REQUEST43_GLOBAL_REQUEST, DMA_REQUEST44_GLOBAL_REQUEST, DMA_REQUEST45_ASI12_LIN_UART_TX, DMA_REQUEST46_ASI12_LIN_UART_RX, DMA_REQUEST47_ASI13_LIN_UART_TX, DMA_REQUEST48_ASI13_LIN_UART_RX, DMA_REQUEST49_ASI14_LIN_UART_TX, DMA_REQUEST50_ASI14_LIN_UART_RX, DMA_REQUEST51_ASI15_LIN_UART_TX, DMA_REQUEST52_ASI15_LIN_UART_RX, DMA_REQUEST53_ASI16_LIN_UART_TX, DMA_REQUEST54_ASI16_LIN_UART_RX, DMA_REQUEST55_ASI17_LIN_UART_TX, DMA_REQUEST56_ASI17_LIN_UART_RX, DMA_REQUEST57_ASI18_LIN_UART_TX, DMA_REQUEST58_ASI18_LIN_UART_RX, DMA_REQUEST59_ASI19_LIN_UART_TX, DMA_REQUEST60_ASI19_LIN_UART_RX, DMA_REQUEST61_ASI20_LIN_UART_TX, DMA_REQUEST62_ASI20_LIN_UART_RX, DMA_REQUEST63_ASI21_LIN_UART_TX, DMA_REQUEST64_ASI21_LIN_UART_RX, DMA_REQUEST65_ASI22_LIN_UART_TX, DMA_REQUEST66_ASI22_LIN_UART_RX, DMA_REQUEST67_ASI23_LIN_UART_TX, DMA_REQUEST68_ASI23_LIN_UART_RX, DMA_REQUEST69_I2C1_TX_RX, DMA_REQUEST70_CAN30_TX_FIFO, DMA_REQUEST71_CAN30_RX_FIFO0, DMA_REQUEST72_CAN30_RX_FIFO1, DMA_REQUEST73_CAN30_TX_EVENT, DMA_REQUEST74_CAN31_TX_FIFO, DMA_REQUEST75_CAN31_RX_FIFO0, DMA_REQUEST76_CAN31_RX_FIFO1, DMA_REQUEST77_CAN31_TX_EVENT, DMA_REQUEST78_CAN32_TX_FIFO, DMA_REQUEST79_CAN32_RX_FIFO0, DMA_REQUEST80_CAN32_RX_FIFO1, DMA_REQUEST81_CAN32_TX_EVENT, DMA_REQUEST82_ASI8_LIN_UART_TX, DMA_REQUEST83_ASI8_LIN_UART_RX, DMA_REQUEST84_ASI9_LIN_UART_TX, DMA_REQUEST85_ASI9_LIN_UART_RX, DMA_REQUEST86_ASI10_LIN_UART_TX, DMA_REQUEST87_ASI10_LIN_UART_RX, DMA_REQUEST88_ASI11_LIN_UART_TX, DMA_REQUEST89_ASI11_LIN_UART_RX}, multiplicity set at post-build, origin=ChipowerTech, post-build-variant-multiplicity=true, post-build-variant-value=true, set at post-build, default-value=DMA_REQUEST0_GTM  # Select the DMA channel source request. Note This parameter is available only if the parameter DmaChTransferConfigFlowControl is set to P2M(peripheral to memory) or P2P(peripheral to peripheral).
        enumeration DmaChannelSourceGlobalRequestMUX [0..1]: {DMA_REQUEST0_GTM, DMA_REQUEST1_GTM, DMA_REQUEST2_GTM, DMA_REQUEST3_GTM, DMA_REQUEST4_GTM, DMA_REQUEST5_GTM, DMA_REQUEST6_GTM, DMA_REQUEST7_GTM, DMA_REQUEST8_QSPI, DMA_REQUEST9_DSADC0, DMA_REQUEST10_DSADC1, DMA_REQUEST11_DSADC2, DMA_REQUEST12_DSADC3, DMA_REQUEST13_FC0, DMA_REQUEST14_FC1, DMA_REQUEST15_SARADC0_RESULT0, DMA_REQUEST16_SARADC0_RESULT1, DMA_REQUEST17_SARADC0_RESULT2, DMA_REQUEST18_SARADC0_RESULT3, DMA_REQUEST19_SARADC0_RESULT4, DMA_REQUEST20_SARADC0_RESULT5, DMA_REQUEST21_SARADC0_RESULT6, DMA_REQUEST22_SARADC0_RESULT7, DMA_REQUEST23_SARADC0_RESULT8, DMA_REQUEST24_SARADC0_RESULT9, DMA_REQUEST25_SARADC0_RESULT10, DMA_REQUEST26_SARADC0_RESULT11, DMA_REQUEST27_SARADC0_RESULT12, DMA_REQUEST28_SARADC0_RESULT13, DMA_REQUEST29_SARADC0_RESULT14, DMA_REQUEST30_SARADC0_RESULT15, DMA_REQUEST31_SARADC_GLOBAL_RESULT, DMA_REQUEST32_SARADC1_RESULT0, DMA_REQUEST33_SARADC1_RESULT1, DMA_REQUEST34_SARADC1_RESULT2, DMA_REQUEST35_SARADC1_RESULT3, DMA_REQUEST36_SARADC1_RESULT4, DMA_REQUEST37_SARADC1_RESULT5, DMA_REQUEST38_SARADC1_RESULT6, DMA_REQUEST39_SARADC1_RESULT7, DMA_REQUEST40_SARADC1_RESULT8, DMA_REQUEST41_SARADC1_RESULT9, DMA_REQUEST42_SARADC1_RESULT10, DMA_REQUEST43_SARADC1_RESULT11, DMA_REQUEST44_SARADC1_RESULT12, DMA_REQUEST45_SARADC1_RESULT13, DMA_REQUEST46_SARADC1_RESULT14, DMA_REQUEST47_SARADC1_RESULT15, DMA_REQUEST48_SARADC2_RESULT0, DMA_REQUEST49_SARADC2_RESULT1, DMA_REQUEST50_SARADC2_RESULT2, DMA_REQUEST51_SARADC2_RESULT3, DMA_REQUEST52_SARADC2_RESULT4, DMA_REQUEST53_SARADC2_RESULT5, DMA_REQUEST54_SARADC2_RESULT6, DMA_REQUEST55_SARADC2_RESULT7, DMA_REQUEST56_SARADC2_RESULT8, DMA_REQUEST57_SARADC2_RESULT9, DMA_REQUEST58_SARADC2_RESULT10, DMA_REQUEST59_SARADC2_RESULT11, DMA_REQUEST60_SARADC2_RESULT12, DMA_REQUEST61_SARADC2_RESULT13, DMA_REQUEST62_SARADC2_RESULT14, DMA_REQUEST63_SARADC2_RESULT15, DMA_REQUEST64_SARADC3_RESULT0, DMA_REQUEST65_SARADC3_RESULT1, DMA_REQUEST66_SARADC3_RESULT2, DMA_REQUEST67_SARADC3_RESULT3, DMA_REQUEST68_SARADC3_RESULT4, DMA_REQUEST69_SARADC3_RESULT5, DMA_REQUEST70_SARADC3_RESULT6, DMA_REQUEST71_SARADC3_RESULT7, DMA_REQUEST72_SARADC3_RESULT8, DMA_REQUEST73_SARADC3_RESULT9, DMA_REQUEST74_SARADC3_RESULT10, DMA_REQUEST75_SARADC3_RESULT11, DMA_REQUEST76_SARADC3_RESULT12, DMA_REQUEST77_SARADC3_RESULT13, DMA_REQUEST78_SARADC3_RESULT14, DMA_REQUEST79_SARADC3_RESULT15, DMA_REQUEST80_SARADC8_RESULT0, DMA_REQUEST81_SARADC8_RESULT1, DMA_REQUEST82_SARADC8_RESULT2, DMA_REQUEST83_SARADC8_RESULT3, DMA_REQUEST84_SARADC8_RESULT4, DMA_REQUEST85_SARADC8_RESULT5, DMA_REQUEST86_SARADC8_RESULT6, DMA_REQUEST87_SARADC8_RESULT7, DMA_REQUEST88_SARADC8_RESULT8, DMA_REQUEST89_SARADC8_RESULT9, DMA_REQUEST90_SARADC8_RESULT10, DMA_REQUEST91_SARADC8_RESULT11, DMA_REQUEST92_SARADC8_RESULT12, DMA_REQUEST93_SARADC8_RESULT13, DMA_REQUEST94_SARADC8_RESULT14, DMA_REQUEST95_SARADC8_RESULT15, DMA_REQUEST96_SARADC9_RESULT0, DMA_REQUEST97_SARADC9_RESULT1, DMA_REQUEST98_SARADC9_RESULT2, DMA_REQUEST99_SARADC9_RESULT3, DMA_REQUEST100_SARADC9_RESULT4, DMA_REQUEST101_SARADC9_RESULT5, DMA_REQUEST102_SARADC9_RESULT6, DMA_REQUEST103_SARADC9_RESULT7, DMA_REQUEST104_SARADC9_RESULT8, DMA_REQUEST105_SARADC9_RESULT9, DMA_REQUEST106_SARADC9_RESULT10, DMA_REQUEST107_SARADC9_RESULT11, DMA_REQUEST108_SARADC9_RESULT12, DMA_REQUEST109_SARADC9_RESULT13, DMA_REQUEST110_SARADC9_RESULT14, DMA_REQUEST111_SARADC9_RESULT15, DMA_REQUEST112_ESPI0_TX, DMA_REQUEST113_ESPI0_RX, DMA_REQUEST114_ESPI1_TX, DMA_REQUEST115_ESPI1_RX, DMA_REQUEST116_ESPI2_TX, DMA_REQUEST117_ESPI2_RX, DMA_REQUEST118_ESPI5_TX, DMA_REQUEST119_ESPI5_RX, DMA_REQUEST120_ESPI6_TX, DMA_REQUEST121_ESPI6_RX, DMA_REQUEST122_ESPI7_TX, DMA_REQUEST123_ESPI7_RX, DMA_REQUEST124_ESPI8_TX, DMA_REQUEST125_ESPI8_RX, DMA_REQUEST126_CAN00_TX_FIFO, DMA_REQUEST127_CAN00_RX_FIFO0, DMA_REQUEST128_CAN00_RX_FIFO1, DMA_REQUEST129_CAN00_TX_EVENT, DMA_REQUEST130_CAN01_TX_FIFO, DMA_REQUEST131_CAN01_RX_FIFO0, DMA_REQUEST132_CAN01_RX_FIFO1, DMA_REQUEST133_CAN01_TX_EVENT, DMA_REQUEST134_CAN02_TX_FIFO, DMA_REQUEST135_CAN02_RX_FIFO0, DMA_REQUEST136_CAN02_RX_FIFO1, DMA_REQUEST137_CAN02_TX_EVENT, DMA_REQUEST138_ASI0_LIN_UART_TX, DMA_REQUEST139_ASI0_LIN_UART_RX, DMA_REQUEST140_ASI1_LIN_UART_TX, DMA_REQUEST141_ASI1_LIN_UART_RX, DMA_REQUEST142_ASI2_LIN_UART_TX, DMA_REQUEST143_ASI2_LIN_UART_RX, DMA_REQUEST144_ASI3_LIN_UART_TX, DMA_REQUEST145_ASI3_LIN_UART_RX, DMA_REQUEST146_ASI4_LIN_UART_TX, DMA_REQUEST147_ASI4_LIN_UART_RX, DMA_REQUEST148_ASI5_LIN_UART_TX, DMA_REQUEST149_ASI5_LIN_UART_RX, DMA_REQUEST150_ASI6_LIN_UART_TX, DMA_REQUEST151_ASI6_LIN_UART_RX, DMA_REQUEST152_ASI7_LIN_UART_TX, DMA_REQUEST153_ASI7_LIN_UART_RX, DMA_REQUEST154_ESPI3_TX, DMA_REQUEST155_ESPI3_RX, DMA_REQUEST156_ESPI4_TX, DMA_REQUEST157_ESPI4_RX, DMA_REQUEST158_I2C0_TX_RX, DMA_REQUEST159_MSC0_DOWNSTREAM_DATA_TX, DMA_REQUEST160_MSC0_DOWNSTREAM_CMD_TX, DMA_REQUEST161_MSC0_DOWNSTREAM_PT, DMA_REQUEST162_MSC0_UPSTREAM_DATA_RX, DMA_REQUEST163_CAN10_TX_FIFO, DMA_REQUEST164_CAN10_RX_FIFO0, DMA_REQUEST165_CAN10_RX_FIFO1, DMA_REQUEST166_CAN10_TX_EVENT, DMA_REQUEST167_CAN11_TX_FIFO, DMA_REQUEST168_CAN11_RX_FIFO0, DMA_REQUEST169_CAN11_RX_FIFO1, DMA_REQUEST170_CAN11_TX_EVENT, DMA_REQUEST171_CAN12_TX_FIFO, DMA_REQUEST172_CAN12_RX_FIFO0, DMA_REQUEST173_CAN12_RX_FIFO1, DMA_REQUEST174_CAN12_TX_EVENT, DMA_REQUEST175_DSADC4, DMA_REQUEST176_DSADC5, DMA_REQUEST177_DSADC6, DMA_REQUEST178_DSADC7, DMA_REQUEST179_DSADC8, DMA_REQUEST180_DSADC9, DMA_REQUEST181_FC2, DMA_REQUEST182_FC3, DMA_REQUEST183_SARADC4_RESULT0, DMA_REQUEST184_SARADC4_RESULT1, DMA_REQUEST185_SARADC4_RESULT2, DMA_REQUEST186_SARADC4_RESULT3, DMA_REQUEST187_SARADC4_RESULT4, DMA_REQUEST188_SARADC4_RESULT5, DMA_REQUEST189_SARADC4_RESULT6, DMA_REQUEST190_SARADC4_RESULT7, DMA_REQUEST191_SARADC4_RESULT8, DMA_REQUEST192_SARADC4_RESULT9, DMA_REQUEST193_SARADC4_RESULT10, DMA_REQUEST194_SARADC4_RESULT11, DMA_REQUEST195_SARADC4_RESULT12, DMA_REQUEST196_SARADC4_RESULT13, DMA_REQUEST197_SARADC4_RESULT14, DMA_REQUEST198_SARADC4_RESULT15, DMA_REQUEST199_SARADC5_RESULT0, DMA_REQUEST200_SARADC5_RESULT1, DMA_REQUEST201_SARADC5_RESULT2, DMA_REQUEST202_SARADC5_RESULT3, DMA_REQUEST203_SARADC5_RESULT4, DMA_REQUEST204_SARADC5_RESULT5, DMA_REQUEST205_SARADC5_RESULT6, DMA_REQUEST206_SARADC5_RESULT7, DMA_REQUEST207_SARADC5_RESULT8, DMA_REQUEST208_SARADC5_RESULT9, DMA_REQUEST209_SARADC5_RESULT10, DMA_REQUEST210_SARADC5_RESULT11, DMA_REQUEST211_SARADC5_RESULT12, DMA_REQUEST212_SARADC5_RESULT13, DMA_REQUEST213_SARADC5_RESULT14, DMA_REQUEST214_SARADC5_RESULT15, DMA_REQUEST215_SARADC6_RESULT0, DMA_REQUEST216_SARADC6_RESULT1, DMA_REQUEST217_SARADC6_RESULT2, DMA_REQUEST218_SARADC6_RESULT3, DMA_REQUEST219_SARADC6_RESULT4, DMA_REQUEST220_SARADC6_RESULT5, DMA_REQUEST221_SARADC6_RESULT6, DMA_REQUEST222_SARADC6_RESULT7, DMA_REQUEST223_SARADC6_RESULT8, DMA_REQUEST224_SARADC6_RESULT9, DMA_REQUEST225_SARADC6_RESULT10, DMA_REQUEST226_SARADC6_RESULT11, DMA_REQUEST227_SARADC6_RESULT12, DMA_REQUEST228_SARADC6_RESULT13, DMA_REQUEST229_SARADC6_RESULT14, DMA_REQUEST230_SARADC6_RESULT15, DMA_REQUEST231_SARADC7_RESULT0, DMA_REQUEST232_SARADC7_RESULT1, DMA_REQUEST233_SARADC7_RESULT2, DMA_REQUEST234_SARADC7_RESULT3, DMA_REQUEST235_SARADC7_RESULT4, DMA_REQUEST236_SARADC7_RESULT5, DMA_REQUEST237_SARADC7_RESULT6, DMA_REQUEST238_SARADC7_RESULT7, DMA_REQUEST239_SARADC7_RESULT8, DMA_REQUEST240_SARADC7_RESULT9, DMA_REQUEST241_SARADC7_RESULT10, DMA_REQUEST242_SARADC7_RESULT11, DMA_REQUEST243_SARADC7_RESULT12, DMA_REQUEST244_SARADC7_RESULT13, DMA_REQUEST245_SARADC7_RESULT14, DMA_REQUEST246_SARADC7_RESULT15, DMA_REQUEST247_SARADC10_RESULT0, DMA_REQUEST248_SARADC10_RESULT1, DMA_REQUEST249_SARADC10_RESULT2, DMA_REQUEST250_SARADC10_RESULT3, DMA_REQUEST251_SARADC10_RESULT4, DMA_REQUEST252_SARADC10_RESULT5, DMA_REQUEST253_SARADC10_RESULT6, DMA_REQUEST254_SARADC10_RESULT7, DMA_REQUEST255_SARADC10_RESULT8, DMA_REQUEST256_SARADC10_RESULT9, DMA_REQUEST257_SARADC10_RESULT10, DMA_REQUEST258_SARADC10_RESULT11, DMA_REQUEST259_SARADC10_RESULT12, DMA_REQUEST260_SARADC10_RESULT13, DMA_REQUEST261_SARADC10_RESULT14, DMA_REQUEST262_SARADC10_RESULT15, DMA_REQUEST263_SARADC11_RESULT0, DMA_REQUEST264_SARADC11_RESULT1, DMA_REQUEST265_SARADC11_RESULT2, DMA_REQUEST266_SARADC11_RESULT3, DMA_REQUEST267_SARADC11_RESULT4, DMA_REQUEST268_SARADC11_RESULT5, DMA_REQUEST269_SARADC11_RESULT6, DMA_REQUEST270_SARADC11_RESULT7, DMA_REQUEST271_SARADC11_RESULT8, DMA_REQUEST272_SARADC11_RESULT9, DMA_REQUEST273_SARADC11_RESULT10, DMA_REQUEST274_SARADC11_RESULT11, DMA_REQUEST275_SARADC11_RESULT12, DMA_REQUEST276_SARADC11_RESULT13, DMA_REQUEST277_SARADC11_RESULT14, DMA_REQUEST278_SARADC11_RESULT15, DMA_REQUEST279_PSI5_CH0_DATA_TX, DMA_REQUEST280_PSI5_CH0_CTRL_TX, DMA_REQUEST281_PSI5_CH0_DATA_RX, DMA_REQUEST282_PSI5_CH0_CTRL_RX, DMA_REQUEST283_PSI5_CH1_DATA_TX, DMA_REQUEST284_PSI5_CH1_CTRL_TX, DMA_REQUEST285_PSI5_CH1_DATA_RX, DMA_REQUEST286_PSI5_CH1_CTRL_RX, DMA_REQUEST287_PSI5_CH2_DATA_TX, DMA_REQUEST288_PSI5_CH2_CTRL_TX, DMA_REQUEST289_PSI5_CH2_DATA_RX, DMA_REQUEST290_PSI5_CH2_CTRL_RX, DMA_REQUEST291_PSI5_CH3_DATA_TX, DMA_REQUEST292_PSI5_CH3_CTRL_TX, DMA_REQUEST293_PSI5_CH3_DATA_RX, DMA_REQUEST294_PSI5_CH3_CTRL_RX, DMA_REQUEST295_CAN20_TX_FIFO, DMA_REQUEST296_CAN20_RX_FIFO0, DMA_REQUEST297_CAN20_RX_FIFO1, DMA_REQUEST298_CAN20_TX_EVENT, DMA_REQUEST299_CAN21_TX_FIFO, DMA_REQUEST300_CAN21_RX_FIFO0, DMA_REQUEST301_CAN21_RX_FIFO1, DMA_REQUEST302_CAN21_TX_EVENT, DMA_REQUEST303_CAN22_TX_FIFO, DMA_REQUEST304_CAN22_RX_FIFO0, DMA_REQUEST305_CAN22_RX_FIFO1, DMA_REQUEST306_CAN22_TX_EVENT, DMA_REQUEST307_MSC1_DOWNSTREAM_DATA_TX, DMA_REQUEST308_MSC1_DOWNSTREAM_CMD_TX, DMA_REQUEST309_MSC1_DOWNSTREAM_PT, DMA_REQUEST310_MSC1_UPSTREAM_DATA_RX, DMA_REQUEST311_MSC2_DOWNSTREAM_DATA_TX, DMA_REQUEST312_MSC2_DOWNSTREAM_CMD_TX, DMA_REQUEST313_MSC2_DOWNSTREAM_PT, DMA_REQUEST314_MSC2_UPSTREAM_DATA_RX, DMA_REQUEST315_ECRC_CH0_RESULT, DMA_REQUEST316_ECRC_CH1_RESULT, DMA_REQUEST317_ECRC_CH2_RESULT, DMA_REQUEST318_ECRC_CH3_RESULT, DMA_REQUEST319_ECRC_CH4_RESULT, DMA_REQUEST320_ECRC_CH5_RESULT, DMA_REQUEST321_ECRC_CH6_RESULT, DMA_REQUEST322_ECRC_CH7_RESULT, DMA_REQUEST323_ASI8_LIN_UART_TX, DMA_REQUEST324_ASI8_LIN_UART_RX, DMA_REQUEST325_ASI9_LIN_UART_TX, DMA_REQUEST326_ASI9_LIN_UART_RX, DMA_REQUEST327_ASI10_LIN_UART_TX, DMA_REQUEST328_ASI10_LIN_UART_RX, DMA_REQUEST329_ASI11_LIN_UART_TX, DMA_REQUEST330_ASI11_LIN_UART_RX, DMA_REQUEST331_ASI12_LIN_UART_TX, DMA_REQUEST332_ASI12_LIN_UART_RX, DMA_REQUEST333_ASI13_LIN_UART_TX, DMA_REQUEST334_ASI13_LIN_UART_RX, DMA_REQUEST335_ASI14_LIN_UART_TX, DMA_REQUEST336_ASI14_LIN_UART_RX, DMA_REQUEST337_ASI15_LIN_UART_TX, DMA_REQUEST338_ASI15_LIN_UART_RX, DMA_REQUEST339_ASI16_LIN_UART_TX, DMA_REQUEST340_ASI16_LIN_UART_RX, DMA_REQUEST341_ASI17_LIN_UART_TX, DMA_REQUEST342_ASI17_LIN_UART_RX, DMA_REQUEST343_ASI18_LIN_UART_TX, DMA_REQUEST344_ASI18_LIN_UART_RX, DMA_REQUEST345_ASI19_LIN_UART_TX, DMA_REQUEST346_ASI19_LIN_UART_RX, DMA_REQUEST347_ASI20_LIN_UART_TX, DMA_REQUEST348_ASI20_LIN_UART_RX, DMA_REQUEST349_ASI21_LIN_UART_TX, DMA_REQUEST350_ASI21_LIN_UART_RX, DMA_REQUEST351_ASI22_LIN_UART_TX, DMA_REQUEST352_ASI22_LIN_UART_RX, DMA_REQUEST353_ASI23_LIN_UART_TX, DMA_REQUEST354_ASI23_LIN_UART_RX, DMA_REQUEST355_I2C1_TX_RX, DMA_REQUEST356_CAN30_TX_FIFO, DMA_REQUEST357_CAN30_RX_FIFO0, DMA_REQUEST358_CAN30_RX_FIFO1, DMA_REQUEST359_CAN30_TX_EVENT, DMA_REQUEST360_CAN31_TX_FIFO, DMA_REQUEST361_CAN31_RX_FIFO0, DMA_REQUEST362_CAN31_RX_FIFO1, DMA_REQUEST363_CAN31_TX_EVENT, DMA_REQUEST364_CAN32_TX_FIFO, DMA_REQUEST365_CAN32_RX_FIFO0, DMA_REQUEST366_CAN32_RX_FIFO1, DMA_REQUEST367_CAN32_TX_EVENT}, multiplicity set at post-build, origin=ChipowerTech, post-build-variant-multiplicity=true, post-build-variant-value=true, set at post-build, default-value=DMA_REQUEST0_GTM  # Select the DMA channel global source request if DmaChannelSourceRequestSelect is set to GLOBAL_REQUEST. This parameter is available only if the parameter DmaChannel-SourceRequestSelect is set to GLOBAL_REQUEST
        enumeration DmaChannelDestinationRequestSelect [0..1]: {DMA_REQUEST0_GTM, DMA_REQUEST1_GTM, DMA_REQUEST2_GTM, DMA_REQUEST3_GTM, DMA_REQUEST4_GTM, DMA_REQUEST5_GTM, DMA_REQUEST6_GTM, DMA_REQUEST7_GTM, DMA_REQUEST8_QSPI, DMA_REQUEST9_GLOBAL_REQUEST, DMA_REQUEST10_GLOBAL_REQUEST, DMA_REQUEST11_GLOBAL_REQUEST, DMA_REQUEST12_GLOBAL_REQUEST, DMA_REQUEST13_GLOBAL_REQUEST, DMA_REQUEST14_GLOBAL_REQUEST, DMA_REQUEST15_GLOBAL_REQUEST, DMA_REQUEST16_GLOBAL_REQUEST, DMA_REQUEST17_GLOBAL_REQUEST, DMA_REQUEST18_GLOBAL_REQUEST, DMA_REQUEST19_GLOBAL_REQUEST, DMA_REQUEST20_GLOBAL_REQUEST, DMA_REQUEST21_GLOBAL_REQUEST, DMA_REQUEST22_GLOBAL_REQUEST, DMA_REQUEST23_GLOBAL_REQUEST, DMA_REQUEST24_GLOBAL_REQUEST, DMA_REQUEST25_GLOBAL_REQUEST, DMA_REQUEST34_GLOBAL_REQUEST, DMA_REQUEST35_GLOBAL_REQUEST, DMA_REQUEST36_GLOBAL_REQUEST, DMA_REQUEST0_DSADC0, DMA_REQUEST1_DSADC1, DMA_REQUEST2_DSADC2, DMA_REQUEST3_DSADC3, DMA_REQUEST4_FC0, DMA_REQUEST5_FC1, DMA_REQUEST6_SARADC0_RESULT0, DMA_REQUEST7_SARADC0_RESULT1, DMA_REQUEST8_SARADC0_RESULT2, DMA_REQUEST9_SARADC0_RESULT3, DMA_REQUEST10_SARADC0_RESULT4, DMA_REQUEST11_SARADC0_RESULT5, DMA_REQUEST12_SARADC0_RESULT6, DMA_REQUEST13_SARADC0_RESULT7, DMA_REQUEST14_SARADC0_RESULT8, DMA_REQUEST15_SARADC0_RESULT9, DMA_REQUEST16_SARADC0_RESULT10, DMA_REQUEST17_SARADC0_RESULT11, DMA_REQUEST18_SARADC0_RESULT12, DMA_REQUEST19_SARADC0_RESULT13, DMA_REQUEST20_SARADC0_RESULT14, DMA_REQUEST21_SARADC0_RESULT15, DMA_REQUEST22_SARADC_GLOBAL_RESULT, DMA_REQUEST23_SARADC1_RESULT0, DMA_REQUEST24_SARADC1_RESULT1, DMA_REQUEST25_SARADC1_RESULT2, DMA_REQUEST26_SARADC1_RESULT3, DMA_REQUEST27_SARADC1_RESULT4, DMA_REQUEST28_SARADC1_RESULT5, DMA_REQUEST29_SARADC1_RESULT6, DMA_REQUEST30_SARADC1_RESULT7, DMA_REQUEST31_SARADC1_RESULT8, DMA_REQUEST32_SARADC1_RESULT9, DMA_REQUEST33_SARADC1_RESULT10, DMA_REQUEST34_SARADC1_RESULT11, DMA_REQUEST35_SARADC1_RESULT12, DMA_REQUEST36_SARADC1_RESULT13, DMA_REQUEST37_SARADC1_RESULT14, DMA_REQUEST38_SARADC1_RESULT15, DMA_REQUEST39_SARADC2_RESULT0, DMA_REQUEST40_SARADC2_RESULT1, DMA_REQUEST41_SARADC2_RESULT2, DMA_REQUEST42_SARADC2_RESULT3, DMA_REQUEST43_SARADC2_RESULT4, DMA_REQUEST44_SARADC2_RESULT5, DMA_REQUEST45_SARADC2_RESULT6, DMA_REQUEST46_SARADC2_RESULT7, DMA_REQUEST47_SARADC2_RESULT8, DMA_REQUEST48_SARADC2_RESULT9, DMA_REQUEST49_SARADC2_RESULT10, DMA_REQUEST50_SARADC2_RESULT11, DMA_REQUEST51_SARADC2_RESULT12, DMA_REQUEST52_SARADC2_RESULT13, DMA_REQUEST53_SARADC2_RESULT14, DMA_REQUEST54_SARADC2_RESULT15, DMA_REQUEST55_SARADC3_RESULT0, DMA_REQUEST56_SARADC3_RESULT1, DMA_REQUEST57_SARADC3_RESULT2, DMA_REQUEST58_SARADC3_RESULT3, DMA_REQUEST59_SARADC3_RESULT4, DMA_REQUEST60_SARADC3_RESULT5, DMA_REQUEST61_SARADC3_RESULT6, DMA_REQUEST62_SARADC3_RESULT7, DMA_REQUEST63_SARADC3_RESULT8, DMA_REQUEST64_SARADC3_RESULT9, DMA_REQUEST65_SARADC3_RESULT10, DMA_REQUEST66_SARADC3_RESULT11, DMA_REQUEST67_SARADC3_RESULT12, DMA_REQUEST68_SARADC3_RESULT13, DMA_REQUEST69_SARADC3_RESULT14, DMA_REQUEST70_SARADC3_RESULT15, DMA_REQUEST71_SARADC8_RESULT0, DMA_REQUEST72_SARADC8_RESULT1, DMA_REQUEST73_SARADC8_RESULT2, DMA_REQUEST74_SARADC8_RESULT3, DMA_REQUEST75_SARADC8_RESULT4, DMA_REQUEST76_SARADC8_RESULT5, DMA_REQUEST77_SARADC8_RESULT6, DMA_REQUEST78_SARADC8_RESULT7, DMA_REQUEST79_SARADC8_RESULT8, DMA_REQUEST80_SARADC8_RESULT9, DMA_REQUEST81_SARADC8_RESULT10, DMA_REQUEST82_SARADC8_RESULT11, DMA_REQUEST83_SARADC8_RESULT12, DMA_REQUEST84_SARADC8_RESULT13, DMA_REQUEST85_SARADC8_RESULT14, DMA_REQUEST86_SARADC8_RESULT15, DMA_REQUEST87_SARADC9_RESULT0, DMA_REQUEST88_SARADC9_RESULT1, DMA_REQUEST89_SARADC9_RESULT2, DMA_REQUEST90_SARADC9_RESULT3, DMA_REQUEST91_SARADC9_RESULT4, DMA_REQUEST92_SARADC9_RESULT5, DMA_REQUEST93_SARADC9_RESULT6, DMA_REQUEST94_SARADC9_RESULT7, DMA_REQUEST95_SARADC9_RESULT8, DMA_REQUEST96_SARADC9_RESULT9, DMA_REQUEST97_SARADC9_RESULT10, DMA_REQUEST98_SARADC9_RESULT11, DMA_REQUEST99_SARADC9_RESULT12, DMA_REQUEST100_SARADC9_RESULT13, DMA_REQUEST101_SARADC9_RESULT14, DMA_REQUEST102_SARADC9_RESULT15, DMA_REQUEST103_GLOBAL_REQUEST, DMA_REQUEST104_GLOBAL_REQUEST, DMA_REQUEST105_GLOBAL_REQUEST, DMA_REQUEST106_GLOBAL_REQUEST, DMA_REQUEST107_GLOBAL_REQUEST, DMA_REQUEST108_GLOBAL_REQUEST, DMA_REQUEST109_GLOBAL_REQUEST, DMA_REQUEST110_GLOBAL_REQUEST, DMA_REQUEST111_SARADC4_RESULT0, DMA_REQUEST112_SARADC4_RESULT1, DMA_REQUEST113_SARADC4_RESULT2, DMA_REQUEST114_SARADC4_RESULT3, DMA_REQUEST115_SARADC4_RESULT4, DMA_REQUEST116_SARADC4_RESULT5, DMA_REQUEST117_SARADC4_RESULT6, DMA_REQUEST118_SARADC4_RESULT7, DMA_REQUEST119_SARADC4_RESULT8, DMA_REQUEST120_SARADC4_RESULT9, DMA_REQUEST121_SARADC4_RESULT10, DMA_REQUEST122_SARADC4_RESULT11, DMA_REQUEST123_SARADC4_RESULT12, DMA_REQUEST124_SARADC4_RESULT13, DMA_REQUEST125_SARADC4_RESULT14, DMA_REQUEST126_SARADC4_RESULT15, DMA_REQUEST127_SARADC5_RESULT0, DMA_REQUEST128_SARADC5_RESULT1, DMA_REQUEST129_SARADC5_RESULT2, DMA_REQUEST130_SARADC5_RESULT3, DMA_REQUEST131_SARADC5_RESULT4, DMA_REQUEST132_SARADC5_RESULT5, DMA_REQUEST133_SARADC5_RESULT6, DMA_REQUEST134_SARADC5_RESULT7, DMA_REQUEST135_SARADC5_RESULT8, DMA_REQUEST136_SARADC5_RESULT9, DMA_REQUEST137_SARADC5_RESULT10, DMA_REQUEST138_SARADC5_RESULT11, DMA_REQUEST139_SARADC5_RESULT12, DMA_REQUEST140_SARADC5_RESULT13, DMA_REQUEST141_SARADC5_RESULT14, DMA_REQUEST142_SARADC5_RESULT15, DMA_REQUEST143_SARADC6_RESULT0, DMA_REQUEST144_SARADC6_RESULT1, DMA_REQUEST145_SARADC6_RESULT2, DMA_REQUEST146_SARADC6_RESULT3, DMA_REQUEST147_SARADC6_RESULT4, DMA_REQUEST148_SARADC6_RESULT5, DMA_REQUEST149_SARADC6_RESULT6, DMA_REQUEST150_SARADC6_RESULT7, DMA_REQUEST151_SARADC6_RESULT8, DMA_REQUEST152_SARADC6_RESULT9, DMA_REQUEST153_SARADC6_RESULT10, DMA_REQUEST154_SARADC6_RESULT11, DMA_REQUEST155_SARADC6_RESULT12, DMA_REQUEST156_SARADC6_RESULT13, DMA_REQUEST157_SARADC6_RESULT14, DMA_REQUEST158_SARADC6_RESULT15, DMA_REQUEST159_SARADC7_RESULT0, DMA_REQUEST160_SARADC7_RESULT1, DMA_REQUEST161_SARADC7_RESULT2, DMA_REQUEST162_SARADC7_RESULT3, DMA_REQUEST163_SARADC7_RESULT4, DMA_REQUEST164_SARADC7_RESULT5, DMA_REQUEST165_SARADC7_RESULT6, DMA_REQUEST166_SARADC7_RESULT7, DMA_REQUEST167_SARADC7_RESULT8, DMA_REQUEST168_SARADC7_RESULT9, DMA_REQUEST169_SARADC7_RESULT10, DMA_REQUEST170_SARADC7_RESULT11, DMA_REQUEST171_SARADC7_RESULT12, DMA_REQUEST172_SARADC7_RESULT13, DMA_REQUEST173_SARADC7_RESULT14, DMA_REQUEST174_SARADC7_RESULT15, DMA_REQUEST175_SARADC10_RESULT0, DMA_REQUEST176_SARADC10_RESULT1, DMA_REQUEST177_SARADC10_RESULT2, DMA_REQUEST178_SARADC10_RESULT3, DMA_REQUEST179_SARADC10_RESULT4, DMA_REQUEST180_SARADC10_RESULT5, DMA_REQUEST181_SARADC10_RESULT6, DMA_REQUEST182_SARADC10_RESULT7, DMA_REQUEST183_SARADC10_RESULT8, DMA_REQUEST184_SARADC10_RESULT9, DMA_REQUEST185_SARADC10_RESULT10, DMA_REQUEST186_SARADC10_RESULT11, DMA_REQUEST187_SARADC10_RESULT12, DMA_REQUEST188_SARADC10_RESULT13, DMA_REQUEST189_SARADC10_RESULT14, DMA_REQUEST190_SARADC10_RESULT15, DMA_REQUEST191_SARADC11_RESULT0, DMA_REQUEST192_SARADC11_RESULT1, DMA_REQUEST193_SARADC11_RESULT2, DMA_REQUEST194_SARADC11_RESULT3, DMA_REQUEST195_SARADC11_RESULT4, DMA_REQUEST196_SARADC11_RESULT5, DMA_REQUEST197_SARADC11_RESULT6, DMA_REQUEST198_SARADC11_RESULT7, DMA_REQUEST199_SARADC11_RESULT8, DMA_REQUEST200_SARADC11_RESULT9, DMA_REQUEST201_SARADC11_RESULT10, DMA_REQUEST202_SARADC11_RESULT11, DMA_REQUEST203_SARADC11_RESULT12, DMA_REQUEST204_SARADC11_RESULT13, DMA_REQUEST205_SARADC11_RESULT14, DMA_REQUEST206_SARADC11_RESULT15, DMA_REQUEST207_PSI5_CH0_DATA_TX, DMA_REQUEST208_PSI5_CH0_CTRL_TX, DMA_REQUEST209_PSI5_CH0_DATA_RX, DMA_REQUEST210_PSI5_CH0_CTRL_RX, DMA_REQUEST211_PSI5_CH1_DATA_TX, DMA_REQUEST212_PSI5_CH1_CTRL_TX, DMA_REQUEST213_PSI5_CH1_DATA_RX, DMA_REQUEST214_PSI5_CH1_CTRL_RX, DMA_REQUEST215_PSI5_CH2_DATA_TX, DMA_REQUEST216_PSI5_CH2_CTRL_TX, DMA_REQUEST217_PSI5_CH2_DATA_RX, DMA_REQUEST218_PSI5_CH2_CTRL_RX, DMA_REQUEST219_PSI5_CH3_DATA_TX, DMA_REQUEST220_PSI5_CH3_CTRL_TX, DMA_REQUEST221_PSI5_CH3_DATA_RX, DMA_REQUEST222_PSI5_CH3_CTRL_RX, DMA_REQUEST223_DSADC4, DMA_REQUEST224_DSADC5, DMA_REQUEST225_DSADC6, DMA_REQUEST226_DSADC7, DMA_REQUEST227_DSADC8, DMA_REQUEST228_DSADC9, DMA_REQUEST229_FC2, DMA_REQUEST230_FC3, DMA_REQUEST0_ESPI0_TX, DMA_REQUEST1_ESPI0_RX, DMA_REQUEST2_ESPI1_TX, DMA_REQUEST3_ESPI1_RX, DMA_REQUEST4_ESPI2_TX, DMA_REQUEST5_ESPI2_RX, DMA_REQUEST6_ESPI5_TX, DMA_REQUEST7_ESPI5_RX, DMA_REQUEST8_ESPI6_TX, DMA_REQUEST9_ESPI6_RX, DMA_REQUEST10_ESPI7_TX, DMA_REQUEST11_ESPI7_RX, DMA_REQUEST12_ESPI8_TX, DMA_REQUEST13_ESPI8_RX, DMA_REQUEST14_CAN00_TX_FIFO, DMA_REQUEST15_CAN00_RX_FIFO0, DMA_REQUEST16_CAN00_RX_FIFO1, DMA_REQUEST17_CAN00_TX_EVENT, DMA_REQUEST18_CAN01_TX_FIFO, DMA_REQUEST19_CAN01_RX_FIFO0, DMA_REQUEST20_CAN01_RX_FIFO1, DMA_REQUEST21_CAN01_TX_EVENT, DMA_REQUEST22_CAN02_TX_FIFO, DMA_REQUEST23_CAN02_RX_FIFO0, DMA_REQUEST24_CAN02_RX_FIFO1, DMA_REQUEST25_CAN02_TX_EVENT, DMA_REQUEST26_GLOBAL_REQUEST, DMA_REQUEST27_GLOBAL_REQUEST, DMA_REQUEST28_GLOBAL_REQUEST, DMA_REQUEST29_GLOBAL_REQUEST, DMA_REQUEST30_GLOBAL_REQUEST, DMA_REQUEST31_GLOBAL_REQUEST, DMA_REQUEST32_GLOBAL_REQUEST, DMA_REQUEST33_GLOBAL_REQUEST, DMA_REQUEST34_CAN22_TX_FIFO, DMA_REQUEST35_CAN22_RX_FIFO0, DMA_REQUEST36_CAN22_RX_FIFO1, DMA_REQUEST37_CAN22_TX_EVENT, DMA_REQUEST38_MSC1_DOWNSTREAM_DATA_TX, DMA_REQUEST39_MSC1_DOWNSTREAM_CMD_TX, DMA_REQUEST40_MSC1_DOWNSTREAM_PT, DMA_REQUEST41_MSC1_UPSTREAM_DATA_RX, DMA_REQUEST42_MSC2_DOWNSTREAM_DATA_TX, DMA_REQUEST43_MSC2_DOWNSTREAM_CMD_TX, DMA_REQUEST44_MSC2_DOWNSTREAM_PT, DMA_REQUEST45_MSC2_UPSTREAM_DATA_RX, DMA_REQUEST46_ECRC_CH0_RESULT, DMA_REQUEST47_ECRC_CH1_RESULT, DMA_REQUEST48_ECRC_CH2_RESULT, DMA_REQUEST49_ECRC_CH3_RESULT, DMA_REQUEST50_ECRC_CH4_RESULT, DMA_REQUEST51_ECRC_CH5_RESULT, DMA_REQUEST52_ECRC_CH6_RESULT, DMA_REQUEST53_ECRC_CH7_RESULT, DMA_REQUEST54_CAN20_TX_FIFO, DMA_REQUEST55_CAN20_RX_FIFO0, DMA_REQUEST56_CAN20_RX_FIFO1, DMA_REQUEST57_CAN20_TX_EVENT, DMA_REQUEST58_CAN21_TX_FIFO, DMA_REQUEST59_CAN21_RX_FIFO0, DMA_REQUEST60_CAN21_RX_FIFO1, DMA_REQUEST61_CAN21_TX_EVENT, DMA_REQUEST0_ASI0_LIN_UART_TX, DMA_REQUEST1_ASI0_LIN_UART_RX, DMA_REQUEST2_ASI1_LIN_UART_TX, DMA_REQUEST3_ASI1_LIN_UART_RX, DMA_REQUEST4_ASI2_LIN_UART_TX, DMA_REQUEST5_ASI2_LIN_UART_RX, DMA_REQUEST6_ASI3_LIN_UART_TX, DMA_REQUEST7_ASI3_LIN_UART_RX, DMA_REQUEST8_ASI4_LIN_UART_TX, DMA_REQUEST9_ASI4_LIN_UART_RX, DMA_REQUEST10_ASI5_LIN_UART_TX, DMA_REQUEST11_ASI5_LIN_UART_RX, DMA_REQUEST12_ASI6_LIN_UART_TX, DMA_REQUEST13_ASI6_LIN_UART_RX, DMA_REQUEST14_ASI7_LIN_UART_TX, DMA_REQUEST15_ASI7_LIN_UART_RX, DMA_REQUEST16_ESPI3_TX, DMA_REQUEST17_ESPI3_RX, DMA_REQUEST18_ESPI4_TX, DMA_REQUEST19_ESPI4_RX, DMA_REQUEST20_I2C0_TX_RX, DMA_REQUEST21_MSC0_DOWNSTREAM_DATA_TX, DMA_REQUEST22_MSC0_DOWNSTREAM_CMD_TX, DMA_REQUEST23_MSC0_DOWNSTREAM_PT, DMA_REQUEST24_MSC0_UPSTREAM_DATA_RX, DMA_REQUEST25_CAN10_TX_FIFO, DMA_REQUEST26_CAN10_RX_FIFO0, DMA_REQUEST27_CAN10_RX_FIFO1, DMA_REQUEST28_CAN10_TX_EVENT, DMA_REQUEST29_CAN11_TX_FIFO, DMA_REQUEST30_CAN11_RX_FIFO0, DMA_REQUEST31_CAN11_RX_FIFO1, DMA_REQUEST32_CAN11_TX_EVENT, DMA_REQUEST33_CAN12_TX_FIFO, DMA_REQUEST34_CAN12_RX_FIFO0, DMA_REQUEST35_CAN12_RX_FIFO1, DMA_REQUEST36_CAN12_TX_EVENT, DMA_REQUEST37_GLOBAL_REQUEST, DMA_REQUEST38_GLOBAL_REQUEST, DMA_REQUEST39_GLOBAL_REQUEST, DMA_REQUEST40_GLOBAL_REQUEST, DMA_REQUEST41_GLOBAL_REQUEST, DMA_REQUEST42_GLOBAL_REQUEST, DMA_REQUEST43_GLOBAL_REQUEST, DMA_REQUEST44_GLOBAL_REQUEST, DMA_REQUEST45_ASI12_LIN_UART_TX, DMA_REQUEST46_ASI12_LIN_UART_RX, DMA_REQUEST47_ASI13_LIN_UART_TX, DMA_REQUEST48_ASI13_LIN_UART_RX, DMA_REQUEST49_ASI14_LIN_UART_TX, DMA_REQUEST50_ASI14_LIN_UART_RX, DMA_REQUEST51_ASI15_LIN_UART_TX, DMA_REQUEST52_ASI15_LIN_UART_RX, DMA_REQUEST53_ASI16_LIN_UART_TX, DMA_REQUEST54_ASI16_LIN_UART_RX, DMA_REQUEST55_ASI17_LIN_UART_TX, DMA_REQUEST56_ASI17_LIN_UART_RX, DMA_REQUEST57_ASI18_LIN_UART_TX, DMA_REQUEST58_ASI18_LIN_UART_RX, DMA_REQUEST59_ASI19_LIN_UART_TX, DMA_REQUEST60_ASI19_LIN_UART_RX, DMA_REQUEST61_ASI20_LIN_UART_TX, DMA_REQUEST62_ASI20_LIN_UART_RX, DMA_REQUEST63_ASI21_LIN_UART_TX, DMA_REQUEST64_ASI21_LIN_UART_RX, DMA_REQUEST65_ASI22_LIN_UART_TX, DMA_REQUEST66_ASI22_LIN_UART_RX, DMA_REQUEST67_ASI23_LIN_UART_TX, DMA_REQUEST68_ASI23_LIN_UART_RX, DMA_REQUEST69_I2C1_TX_RX, DMA_REQUEST70_CAN30_TX_FIFO, DMA_REQUEST71_CAN30_RX_FIFO0, DMA_REQUEST72_CAN30_RX_FIFO1, DMA_REQUEST73_CAN30_TX_EVENT, DMA_REQUEST74_CAN31_TX_FIFO, DMA_REQUEST75_CAN31_RX_FIFO0, DMA_REQUEST76_CAN31_RX_FIFO1, DMA_REQUEST77_CAN31_TX_EVENT, DMA_REQUEST78_CAN32_TX_FIFO, DMA_REQUEST79_CAN32_RX_FIFO0, DMA_REQUEST80_CAN32_RX_FIFO1, DMA_REQUEST81_CAN32_TX_EVENT, DMA_REQUEST82_ASI8_LIN_UART_TX, DMA_REQUEST83_ASI8_LIN_UART_RX, DMA_REQUEST84_ASI9_LIN_UART_TX, DMA_REQUEST85_ASI9_LIN_UART_RX, DMA_REQUEST86_ASI10_LIN_UART_TX, DMA_REQUEST87_ASI10_LIN_UART_RX, DMA_REQUEST88_ASI11_LIN_UART_TX, DMA_REQUEST89_ASI11_LIN_UART_RX}, multiplicity set at post-build, origin=ChipowerTech, post-build-variant-multiplicity=true, post-build-variant-value=true, set at post-build, default-value=DMA_REQUEST0_GTM  # Select the DMA channel destination request. Note This parameter is available only if the parameter DmaChTransferConfigFlowControl is set to M2P(peripheral to memory) or P2P(peripheral to peripheral).
        enumeration DmaChannelDestinationGlobalRequestMUX [0..1]: {DMA_REQUEST0_GTM, DMA_REQUEST1_GTM, DMA_REQUEST2_GTM, DMA_REQUEST3_GTM, DMA_REQUEST4_GTM, DMA_REQUEST5_GTM, DMA_REQUEST6_GTM, DMA_REQUEST7_GTM, DMA_REQUEST8_QSPI, DMA_REQUEST9_DSADC0, DMA_REQUEST10_DSADC1, DMA_REQUEST11_DSADC2, DMA_REQUEST12_DSADC3, DMA_REQUEST13_FC0, DMA_REQUEST14_FC1, DMA_REQUEST15_SARADC0_RESULT0, DMA_REQUEST16_SARADC0_RESULT1, DMA_REQUEST17_SARADC0_RESULT2, DMA_REQUEST18_SARADC0_RESULT3, DMA_REQUEST19_SARADC0_RESULT4, DMA_REQUEST20_SARADC0_RESULT5, DMA_REQUEST21_SARADC0_RESULT6, DMA_REQUEST22_SARADC0_RESULT7, DMA_REQUEST23_SARADC0_RESULT8, DMA_REQUEST24_SARADC0_RESULT9, DMA_REQUEST25_SARADC0_RESULT10, DMA_REQUEST26_SARADC0_RESULT11, DMA_REQUEST27_SARADC0_RESULT12, DMA_REQUEST28_SARADC0_RESULT13, DMA_REQUEST29_SARADC0_RESULT14, DMA_REQUEST30_SARADC0_RESULT15, DMA_REQUEST31_SARADC_GLOBAL_RESULT, DMA_REQUEST32_SARADC1_RESULT0, DMA_REQUEST33_SARADC1_RESULT1, DMA_REQUEST34_SARADC1_RESULT2, DMA_REQUEST35_SARADC1_RESULT3, DMA_REQUEST36_SARADC1_RESULT4, DMA_REQUEST37_SARADC1_RESULT5, DMA_REQUEST38_SARADC1_RESULT6, DMA_REQUEST39_SARADC1_RESULT7, DMA_REQUEST40_SARADC1_RESULT8, DMA_REQUEST41_SARADC1_RESULT9, DMA_REQUEST42_SARADC1_RESULT10, DMA_REQUEST43_SARADC1_RESULT11, DMA_REQUEST44_SARADC1_RESULT12, DMA_REQUEST45_SARADC1_RESULT13, DMA_REQUEST46_SARADC1_RESULT14, DMA_REQUEST47_SARADC1_RESULT15, DMA_REQUEST48_SARADC2_RESULT0, DMA_REQUEST49_SARADC2_RESULT1, DMA_REQUEST50_SARADC2_RESULT2, DMA_REQUEST51_SARADC2_RESULT3, DMA_REQUEST52_SARADC2_RESULT4, DMA_REQUEST53_SARADC2_RESULT5, DMA_REQUEST54_SARADC2_RESULT6, DMA_REQUEST55_SARADC2_RESULT7, DMA_REQUEST56_SARADC2_RESULT8, DMA_REQUEST57_SARADC2_RESULT9, DMA_REQUEST58_SARADC2_RESULT10, DMA_REQUEST59_SARADC2_RESULT11, DMA_REQUEST60_SARADC2_RESULT12, DMA_REQUEST61_SARADC2_RESULT13, DMA_REQUEST62_SARADC2_RESULT14, DMA_REQUEST63_SARADC2_RESULT15, DMA_REQUEST64_SARADC3_RESULT0, DMA_REQUEST65_SARADC3_RESULT1, DMA_REQUEST66_SARADC3_RESULT2, DMA_REQUEST67_SARADC3_RESULT3, DMA_REQUEST68_SARADC3_RESULT4, DMA_REQUEST69_SARADC3_RESULT5, DMA_REQUEST70_SARADC3_RESULT6, DMA_REQUEST71_SARADC3_RESULT7, DMA_REQUEST72_SARADC3_RESULT8, DMA_REQUEST73_SARADC3_RESULT9, DMA_REQUEST74_SARADC3_RESULT10, DMA_REQUEST75_SARADC3_RESULT11, DMA_REQUEST76_SARADC3_RESULT12, DMA_REQUEST77_SARADC3_RESULT13, DMA_REQUEST78_SARADC3_RESULT14, DMA_REQUEST79_SARADC3_RESULT15, DMA_REQUEST80_SARADC8_RESULT0, DMA_REQUEST81_SARADC8_RESULT1, DMA_REQUEST82_SARADC8_RESULT2, DMA_REQUEST83_SARADC8_RESULT3, DMA_REQUEST84_SARADC8_RESULT4, DMA_REQUEST85_SARADC8_RESULT5, DMA_REQUEST86_SARADC8_RESULT6, DMA_REQUEST87_SARADC8_RESULT7, DMA_REQUEST88_SARADC8_RESULT8, DMA_REQUEST89_SARADC8_RESULT9, DMA_REQUEST90_SARADC8_RESULT10, DMA_REQUEST91_SARADC8_RESULT11, DMA_REQUEST92_SARADC8_RESULT12, DMA_REQUEST93_SARADC8_RESULT13, DMA_REQUEST94_SARADC8_RESULT14, DMA_REQUEST95_SARADC8_RESULT15, DMA_REQUEST96_SARADC9_RESULT0, DMA_REQUEST97_SARADC9_RESULT1, DMA_REQUEST98_SARADC9_RESULT2, DMA_REQUEST99_SARADC9_RESULT3, DMA_REQUEST100_SARADC9_RESULT4, DMA_REQUEST101_SARADC9_RESULT5, DMA_REQUEST102_SARADC9_RESULT6, DMA_REQUEST103_SARADC9_RESULT7, DMA_REQUEST104_SARADC9_RESULT8, DMA_REQUEST105_SARADC9_RESULT9, DMA_REQUEST106_SARADC9_RESULT10, DMA_REQUEST107_SARADC9_RESULT11, DMA_REQUEST108_SARADC9_RESULT12, DMA_REQUEST109_SARADC9_RESULT13, DMA_REQUEST110_SARADC9_RESULT14, DMA_REQUEST111_SARADC9_RESULT15, DMA_REQUEST112_ESPI0_TX, DMA_REQUEST113_ESPI0_RX, DMA_REQUEST114_ESPI1_TX, DMA_REQUEST115_ESPI1_RX, DMA_REQUEST116_ESPI2_TX, DMA_REQUEST117_ESPI2_RX, DMA_REQUEST118_ESPI5_TX, DMA_REQUEST119_ESPI5_RX, DMA_REQUEST120_ESPI6_TX, DMA_REQUEST121_ESPI6_RX, DMA_REQUEST122_ESPI7_TX, DMA_REQUEST123_ESPI7_RX, DMA_REQUEST124_ESPI8_TX, DMA_REQUEST125_ESPI8_RX, DMA_REQUEST126_CAN00_TX_FIFO, DMA_REQUEST127_CAN00_RX_FIFO0, DMA_REQUEST128_CAN00_RX_FIFO1, DMA_REQUEST129_CAN00_TX_EVENT, DMA_REQUEST130_CAN01_TX_FIFO, DMA_REQUEST131_CAN01_RX_FIFO0, DMA_REQUEST132_CAN01_RX_FIFO1, DMA_REQUEST133_CAN01_TX_EVENT, DMA_REQUEST134_CAN02_TX_FIFO, DMA_REQUEST135_CAN02_RX_FIFO0, DMA_REQUEST136_CAN02_RX_FIFO1, DMA_REQUEST137_CAN02_TX_EVENT, DMA_REQUEST138_ASI0_LIN_UART_TX, DMA_REQUEST139_ASI0_LIN_UART_RX, DMA_REQUEST140_ASI1_LIN_UART_TX, DMA_REQUEST141_ASI1_LIN_UART_RX, DMA_REQUEST142_ASI2_LIN_UART_TX, DMA_REQUEST143_ASI2_LIN_UART_RX, DMA_REQUEST144_ASI3_LIN_UART_TX, DMA_REQUEST145_ASI3_LIN_UART_RX, DMA_REQUEST146_ASI4_LIN_UART_TX, DMA_REQUEST147_ASI4_LIN_UART_RX, DMA_REQUEST148_ASI5_LIN_UART_TX, DMA_REQUEST149_ASI5_LIN_UART_RX, DMA_REQUEST150_ASI6_LIN_UART_TX, DMA_REQUEST151_ASI6_LIN_UART_RX, DMA_REQUEST152_ASI7_LIN_UART_TX, DMA_REQUEST153_ASI7_LIN_UART_RX, DMA_REQUEST154_ESPI3_TX, DMA_REQUEST155_ESPI3_RX, DMA_REQUEST156_ESPI4_TX, DMA_REQUEST157_ESPI4_RX, DMA_REQUEST158_I2C0_TX_RX, DMA_REQUEST159_MSC0_DOWNSTREAM_DATA_TX, DMA_REQUEST160_MSC0_DOWNSTREAM_CMD_TX, DMA_REQUEST161_MSC0_DOWNSTREAM_PT, DMA_REQUEST162_MSC0_UPSTREAM_DATA_RX, DMA_REQUEST163_CAN10_TX_FIFO, DMA_REQUEST164_CAN10_RX_FIFO0, DMA_REQUEST165_CAN10_RX_FIFO1, DMA_REQUEST166_CAN10_TX_EVENT, DMA_REQUEST167_CAN11_TX_FIFO, DMA_REQUEST168_CAN11_RX_FIFO0, DMA_REQUEST169_CAN11_RX_FIFO1, DMA_REQUEST170_CAN11_TX_EVENT, DMA_REQUEST171_CAN12_TX_FIFO, DMA_REQUEST172_CAN12_RX_FIFO0, DMA_REQUEST173_CAN12_RX_FIFO1, DMA_REQUEST174_CAN12_TX_EVENT, DMA_REQUEST175_DSADC4, DMA_REQUEST176_DSADC5, DMA_REQUEST177_DSADC6, DMA_REQUEST178_DSADC7, DMA_REQUEST179_DSADC8, DMA_REQUEST180_DSADC9, DMA_REQUEST181_FC2, DMA_REQUEST182_FC3, DMA_REQUEST183_SARADC4_RESULT0, DMA_REQUEST184_SARADC4_RESULT1, DMA_REQUEST185_SARADC4_RESULT2, DMA_REQUEST186_SARADC4_RESULT3, DMA_REQUEST187_SARADC4_RESULT4, DMA_REQUEST188_SARADC4_RESULT5, DMA_REQUEST189_SARADC4_RESULT6, DMA_REQUEST190_SARADC4_RESULT7, DMA_REQUEST191_SARADC4_RESULT8, DMA_REQUEST192_SARADC4_RESULT9, DMA_REQUEST193_SARADC4_RESULT10, DMA_REQUEST194_SARADC4_RESULT11, DMA_REQUEST195_SARADC4_RESULT12, DMA_REQUEST196_SARADC4_RESULT13, DMA_REQUEST197_SARADC4_RESULT14, DMA_REQUEST198_SARADC4_RESULT15, DMA_REQUEST199_SARADC5_RESULT0, DMA_REQUEST200_SARADC5_RESULT1, DMA_REQUEST201_SARADC5_RESULT2, DMA_REQUEST202_SARADC5_RESULT3, DMA_REQUEST203_SARADC5_RESULT4, DMA_REQUEST204_SARADC5_RESULT5, DMA_REQUEST205_SARADC5_RESULT6, DMA_REQUEST206_SARADC5_RESULT7, DMA_REQUEST207_SARADC5_RESULT8, DMA_REQUEST208_SARADC5_RESULT9, DMA_REQUEST209_SARADC5_RESULT10, DMA_REQUEST210_SARADC5_RESULT11, DMA_REQUEST211_SARADC5_RESULT12, DMA_REQUEST212_SARADC5_RESULT13, DMA_REQUEST213_SARADC5_RESULT14, DMA_REQUEST214_SARADC5_RESULT15, DMA_REQUEST215_SARADC6_RESULT0, DMA_REQUEST216_SARADC6_RESULT1, DMA_REQUEST217_SARADC6_RESULT2, DMA_REQUEST218_SARADC6_RESULT3, DMA_REQUEST219_SARADC6_RESULT4, DMA_REQUEST220_SARADC6_RESULT5, DMA_REQUEST221_SARADC6_RESULT6, DMA_REQUEST222_SARADC6_RESULT7, DMA_REQUEST223_SARADC6_RESULT8, DMA_REQUEST224_SARADC6_RESULT9, DMA_REQUEST225_SARADC6_RESULT10, DMA_REQUEST226_SARADC6_RESULT11, DMA_REQUEST227_SARADC6_RESULT12, DMA_REQUEST228_SARADC6_RESULT13, DMA_REQUEST229_SARADC6_RESULT14, DMA_REQUEST230_SARADC6_RESULT15, DMA_REQUEST231_SARADC7_RESULT0, DMA_REQUEST232_SARADC7_RESULT1, DMA_REQUEST233_SARADC7_RESULT2, DMA_REQUEST234_SARADC7_RESULT3, DMA_REQUEST235_SARADC7_RESULT4, DMA_REQUEST236_SARADC7_RESULT5, DMA_REQUEST237_SARADC7_RESULT6, DMA_REQUEST238_SARADC7_RESULT7, DMA_REQUEST239_SARADC7_RESULT8, DMA_REQUEST240_SARADC7_RESULT9, DMA_REQUEST241_SARADC7_RESULT10, DMA_REQUEST242_SARADC7_RESULT11, DMA_REQUEST243_SARADC7_RESULT12, DMA_REQUEST244_SARADC7_RESULT13, DMA_REQUEST245_SARADC7_RESULT14, DMA_REQUEST246_SARADC7_RESULT15, DMA_REQUEST247_SARADC10_RESULT0, DMA_REQUEST248_SARADC10_RESULT1, DMA_REQUEST249_SARADC10_RESULT2, DMA_REQUEST250_SARADC10_RESULT3, DMA_REQUEST251_SARADC10_RESULT4, DMA_REQUEST252_SARADC10_RESULT5, DMA_REQUEST253_SARADC10_RESULT6, DMA_REQUEST254_SARADC10_RESULT7, DMA_REQUEST255_SARADC10_RESULT8, DMA_REQUEST256_SARADC10_RESULT9, DMA_REQUEST257_SARADC10_RESULT10, DMA_REQUEST258_SARADC10_RESULT11, DMA_REQUEST259_SARADC10_RESULT12, DMA_REQUEST260_SARADC10_RESULT13, DMA_REQUEST261_SARADC10_RESULT14, DMA_REQUEST262_SARADC10_RESULT15, DMA_REQUEST263_SARADC11_RESULT0, DMA_REQUEST264_SARADC11_RESULT1, DMA_REQUEST265_SARADC11_RESULT2, DMA_REQUEST266_SARADC11_RESULT3, DMA_REQUEST267_SARADC11_RESULT4, DMA_REQUEST268_SARADC11_RESULT5, DMA_REQUEST269_SARADC11_RESULT6, DMA_REQUEST270_SARADC11_RESULT7, DMA_REQUEST271_SARADC11_RESULT8, DMA_REQUEST272_SARADC11_RESULT9, DMA_REQUEST273_SARADC11_RESULT10, DMA_REQUEST274_SARADC11_RESULT11, DMA_REQUEST275_SARADC11_RESULT12, DMA_REQUEST276_SARADC11_RESULT13, DMA_REQUEST277_SARADC11_RESULT14, DMA_REQUEST278_SARADC11_RESULT15, DMA_REQUEST279_PSI5_CH0_DATA_TX, DMA_REQUEST280_PSI5_CH0_CTRL_TX, DMA_REQUEST281_PSI5_CH0_DATA_RX, DMA_REQUEST282_PSI5_CH0_CTRL_RX, DMA_REQUEST283_PSI5_CH1_DATA_TX, DMA_REQUEST284_PSI5_CH1_CTRL_TX, DMA_REQUEST285_PSI5_CH1_DATA_RX, DMA_REQUEST286_PSI5_CH1_CTRL_RX, DMA_REQUEST287_PSI5_CH2_DATA_TX, DMA_REQUEST288_PSI5_CH2_CTRL_TX, DMA_REQUEST289_PSI5_CH2_DATA_RX, DMA_REQUEST290_PSI5_CH2_CTRL_RX, DMA_REQUEST291_PSI5_CH3_DATA_TX, DMA_REQUEST292_PSI5_CH3_CTRL_TX, DMA_REQUEST293_PSI5_CH3_DATA_RX, DMA_REQUEST294_PSI5_CH3_CTRL_RX, DMA_REQUEST295_CAN20_TX_FIFO, DMA_REQUEST296_CAN20_RX_FIFO0, DMA_REQUEST297_CAN20_RX_FIFO1, DMA_REQUEST298_CAN20_TX_EVENT, DMA_REQUEST299_CAN21_TX_FIFO, DMA_REQUEST300_CAN21_RX_FIFO0, DMA_REQUEST301_CAN21_RX_FIFO1, DMA_REQUEST302_CAN21_TX_EVENT, DMA_REQUEST303_CAN22_TX_FIFO, DMA_REQUEST304_CAN22_RX_FIFO0, DMA_REQUEST305_CAN22_RX_FIFO1, DMA_REQUEST306_CAN22_TX_EVENT, DMA_REQUEST307_MSC1_DOWNSTREAM_DATA_TX, DMA_REQUEST308_MSC1_DOWNSTREAM_CMD_TX, DMA_REQUEST309_MSC1_DOWNSTREAM_PT, DMA_REQUEST310_MSC1_UPSTREAM_DATA_RX, DMA_REQUEST311_MSC2_DOWNSTREAM_DATA_TX, DMA_REQUEST312_MSC2_DOWNSTREAM_CMD_TX, DMA_REQUEST313_MSC2_DOWNSTREAM_PT, DMA_REQUEST314_MSC2_UPSTREAM_DATA_RX, DMA_REQUEST315_ECRC_CH0_RESULT, DMA_REQUEST316_ECRC_CH1_RESULT, DMA_REQUEST317_ECRC_CH2_RESULT, DMA_REQUEST318_ECRC_CH3_RESULT, DMA_REQUEST319_ECRC_CH4_RESULT, DMA_REQUEST320_ECRC_CH5_RESULT, DMA_REQUEST321_ECRC_CH6_RESULT, DMA_REQUEST322_ECRC_CH7_RESULT, DMA_REQUEST323_ASI8_LIN_UART_TX, DMA_REQUEST324_ASI8_LIN_UART_RX, DMA_REQUEST325_ASI9_LIN_UART_TX, DMA_REQUEST326_ASI9_LIN_UART_RX, DMA_REQUEST327_ASI10_LIN_UART_TX, DMA_REQUEST328_ASI10_LIN_UART_RX, DMA_REQUEST329_ASI11_LIN_UART_TX, DMA_REQUEST330_ASI11_LIN_UART_RX, DMA_REQUEST331_ASI12_LIN_UART_TX, DMA_REQUEST332_ASI12_LIN_UART_RX, DMA_REQUEST333_ASI13_LIN_UART_TX, DMA_REQUEST334_ASI13_LIN_UART_RX, DMA_REQUEST335_ASI14_LIN_UART_TX, DMA_REQUEST336_ASI14_LIN_UART_RX, DMA_REQUEST337_ASI15_LIN_UART_TX, DMA_REQUEST338_ASI15_LIN_UART_RX, DMA_REQUEST339_ASI16_LIN_UART_TX, DMA_REQUEST340_ASI16_LIN_UART_RX, DMA_REQUEST341_ASI17_LIN_UART_TX, DMA_REQUEST342_ASI17_LIN_UART_RX, DMA_REQUEST343_ASI18_LIN_UART_TX, DMA_REQUEST344_ASI18_LIN_UART_RX, DMA_REQUEST345_ASI19_LIN_UART_TX, DMA_REQUEST346_ASI19_LIN_UART_RX, DMA_REQUEST347_ASI20_LIN_UART_TX, DMA_REQUEST348_ASI20_LIN_UART_RX, DMA_REQUEST349_ASI21_LIN_UART_TX, DMA_REQUEST350_ASI21_LIN_UART_RX, DMA_REQUEST351_ASI22_LIN_UART_TX, DMA_REQUEST352_ASI22_LIN_UART_RX, DMA_REQUEST353_ASI23_LIN_UART_TX, DMA_REQUEST354_ASI23_LIN_UART_RX, DMA_REQUEST355_I2C1_TX_RX, DMA_REQUEST356_CAN30_TX_FIFO, DMA_REQUEST357_CAN30_RX_FIFO0, DMA_REQUEST358_CAN30_RX_FIFO1, DMA_REQUEST359_CAN30_TX_EVENT, DMA_REQUEST360_CAN31_TX_FIFO, DMA_REQUEST361_CAN31_RX_FIFO0, DMA_REQUEST362_CAN31_RX_FIFO1, DMA_REQUEST363_CAN31_TX_EVENT, DMA_REQUEST364_CAN32_TX_FIFO, DMA_REQUEST365_CAN32_RX_FIFO0, DMA_REQUEST366_CAN32_RX_FIFO1, DMA_REQUEST367_CAN32_TX_EVENT}, multiplicity set at post-build, origin=ChipowerTech, post-build-variant-multiplicity=true, post-build-variant-value=true, set at post-build, default-value=DMA_REQUEST0_GTM  # Select the DMA channel global destination request if DmaChannelSourceRequestSelect is set to GLOBAL_REQUEST. <h1>Note</h1> This parameter is available only if the parameter DmaChan-nelDestinationRequestSelect is set to GLOBAL_REQUEST.
        function name DmaChannelNotification [0..1]: multiplicity set at post-build, origin=ChipowerTech, post-build-variant-multiplicity=true, post-build-variant-value=true, set at post-build, default-value=NULL_PTR  # Callback function for each channel. Note This parameter is available only if the parameter DmaChannelInterruptEnable is set to true.
        container DmaChannelInterruptConfig  # This container contains the configuration parameters of the all interrupts in each channel.
          boolean DmaChannelTerminalCountInterruptEnable: origin=ChipowerTech, set at pre-compile, default-value=false  # Enables / Disables the terminal count interrupt (transfer completed) for each channel.
          boolean DmaChannelErrorInterruptEnable: origin=ChipowerTech, set at pre-compile, default-value=false  # Enables / Disables the bus error for this channel.
          boolean DmaChannelRemainCountInterruptEnable: origin=ChipowerTech, set at pre-compile, default-value=false  # Enables / Disables the remaining count threshold interrupt for this channel.
          boolean DmaChScbRollbackInterruptEnable [0..1]: multiplicity set at pre-compile, origin=ChipowerTech, set at pre-compile, default-value=false  # Enables / Disables the source circular buffer rollback interrupt for this channel. Note This parameter is available only when following conditions are met: 1. The parameter DmaChannelCircularBufferEnable is set to true. 2. The parameter DmaChannelInterruptEnable is set to true. 3. The parameter DmaCircularBufferEnable is set to true.
          boolean DmaChDcbRollbackInterruptEnable [0..1]: multiplicity set at pre-compile, origin=ChipowerTech, set at pre-compile, default-value=false  # Enables / Disables the destination circular buffer rollback interrupt for this channel. Note This parameter is available only when fallowing conditions are met: 1. The parameter DmaChannelCircularBufferEnable is set to true. 2. The parameter DmaChannelInterruptEnable is set to true. 3. The parameter DmaCircularBufferEnable is set to true.
          boolean DmaChPatternMatchedInterruptEnable [0..1]: multiplicity set at pre-compile, origin=ChipowerTech, set at pre-compile, default-value=false  # Enables / Disables the pattern matched interrupt for this channel. Note This parameter is available only when fallowing conditions are met: 1. The parameter DmaChannelPatternEnable is set to true. 2. The parameter DmaChannelInterruptEnable is set to true. 3. The parameter DmaPatternEnable is set to true.
        container DmaChTransferConfig [0..254]: multiplicity set at pre-compile, requires-index=true  # This container contains the configuration (parameters) of the transfer in current channel. Note - Only one transfer member can be configured if neither linked list feature(parameter DmaChannelLinkedListEnable is set to false) nor shadowing operation feature(parameter DmaChannelShadowOperationEnable for this channel is set to false) is enabled. - The first transfer member(parameter DmaTransferId is 0) is used as the default transfer after Dma is initialized, provided that either linked list feature(parameter DmaChannelLinkedListEnable is set to true) or shadowing operation feature(parameter DmaChannelShadowOperationEnable for this channel is set to false) is enabled.
          integer DmaTransferId: 0..254, origin=ChipowerTech, set at pre-compile, default-value=1  # Logical identifiers of each transfer in the each channel.
          string DmaTransferSourceAddress: origin=ChipowerTech, post-build-variant-value=true, set at post-build, default-value=NULL_PTR  # Source address of this channel transfer. Note The input address can be a number or the address of a variable. - If it is a number, the suffix U must be added, such as "0x8000000U". - If it is a variable, the address-of operator & must be used, such as "&SourceAddress". - If it is an array, the array head address can be written directly, such as "&SourceAddressArray[0]" or "SourceAddressArray".
          string DmaTransferDestinationAddress: origin=ChipowerTech, post-build-variant-value=true, set at post-build, default-value=NULL_PTR  # Destination address of this channel transfer. Note The input address can be a number or a variable address. - If it is a number, the suffix U must be added, such as "0x8000000U" - If it is a variable, the address-of operator & must be used, for example "&SourceAddress". - If it is an array, the array head address can be written directly, such as "&SourceAddressArray[0]" or "SourceAddressArray".
          enumeration DmaTransferSourceAddressMovement: {DMA_ADDRESS_NO_INCREASE, DMA_ADDRESS_INCREASE}, origin=ChipowerTech, post-build-variant-value=true, set at post-build, default-value=DMA_ADDRESS_NO_INCREASE  # Determines whether the source address after every move operation is to be increased or not changed.
          enumeration DmaTransferDestinationAddressMovement: {DMA_ADDRESS_NO_INCREASE, DMA_ADDRESS_INCREASE}, origin=ChipowerTech, post-build-variant-value=true, set at post-build, default-value=DMA_ADDRESS_NO_INCREASE  # Determines whether the destination address after every move operation is to be increased or not changed.
          enumeration DmaTransferSourceBurstNum: {DMA_BURST_SIZE_1, DMA_BURST_SIZE_4, DMA_BURST_SIZE_8, DMA_BURST_SIZE_16, DMA_BURST_SIZE_32, DMA_BURST_SIZE_64, DMA_BURST_SIZE_128, DMA_BURST_SIZE_256}, origin=ChipowerTech, post-build-variant-value=true, set at post-build, default-value=DMA_BURST_SIZE_1  # The size of the burst for each transfer from the source address.
          enumeration DmaTransferDestinationBurstNum: {DMA_BURST_SIZE_1, DMA_BURST_SIZE_4, DMA_BURST_SIZE_8, DMA_BURST_SIZE_16, DMA_BURST_SIZE_32, DMA_BURST_SIZE_64, DMA_BURST_SIZE_128, DMA_BURST_SIZE_256}, origin=ChipowerTech, post-build-variant-value=true, set at post-build, default-value=DMA_BURST_SIZE_1  # The size of the burst for each transfer from the destination address.
          enumeration DmaTransferDataWidth: {DMA_TRANSFER_DATA_8BIT, DMA_TRANSFER_DATA_16BIT, DMA_TRANSFER_DATA_32BIT, DMA_TRANSFER_DATA_64BIT, DMA_TRANSFER_DATA_128BIT}, origin=ChipowerTech, post-build-variant-value=true, set at post-build, default-value=DMA_TRANSFER_DATA_8BIT  # The data width for each transfer.
          integer DmaTransferSize: 1..4095, origin=ChipowerTech, post-build-variant-value=true, set at post-build, default-value=1  # The expected size of the data to be transferred.
          integer DmaTransferRemainingCountThr [0..1]: 0..4095, multiplicity set at post-build, origin=ChipowerTech, post-build-variant-multiplicity=true, post-build-variant-value=true, set at post-build, default-value=0  # Configure the remaining count threshold for this transfer, used to trigger the Remaining Count Reached Interrupt when transfer size is less than this parameter. Note 1. The remaining count must less than transfer size of the channel. 2. If this parameter is set to 0 then it indicates that it is not used. 3. This parameter is available only when the parameter DmaChannelRemainCountInterruptEnable is set to true.
          boolean DmaTransferLinkedListEnable [0..1]: multiplicity set at post-build, origin=ChipowerTech, post-build-variant-multiplicity=true, post-build-variant-value=true, set at post-build, default-value=false  # Enables / Disables the linked list for this transfer. Set this parameter to true if this transfer is the head of the linked list. Note This parameter is available only if the parameter DmaChannelLinkedListEnable is set to true.
          boolean DmaTransferDoubleBufferEnable [0..1]: multiplicity set at post-build, origin=ChipowerTech, post-build-variant-multiplicity=true, post-build-variant-value=true, set at post-build, default-value=false  # Enables / Disables the double buffer for this transfer. Note This parameter is available only if the parameter DmaChannelDoubleBufferEnable is set to true.
          boolean DmaTransferCircularBufferEnable [0..1]: multiplicity set at post-build, origin=ChipowerTech, post-build-variant-multiplicity=true, post-build-variant-value=true, set at post-build, default-value=false  # Enables / Disables the circular buffer for this transfer. Note This parameter is available only if the parameter DmaChannelCircularBufferEnable is set to true.
          boolean DmaTransferPatternEnable [0..1]: multiplicity set at post-build, origin=ChipowerTech, post-build-variant-multiplicity=true, post-build-variant-value=true, set at post-build, default-value=false  # Enables / Disables the pattern match for this transfer. Note This parameter is available only if the parameter DmaChannelPatternEnable is set to true.
          reference DmaTransferLinkedListAssignment [0..1]: multiplicity set at post-build, origin=ChipowerTech, post-build-variant-multiplicity=true, post-build-variant-value=true, set at post-build, destination=DmaChLinkedListItemConfig  # Assignment of a linked list configuration to this transfer. This transfer must be the first member in the linked list. Note This parameter is available only if the parameter DmaChannel-LinkedListEnable is set to true.
          reference DmaTransferDoubleBufferAssignment [0..1]: multiplicity set at post-build, origin=ChipowerTech, post-build-variant-multiplicity=true, post-build-variant-value=true, set at post-build, destination=DmaDoubleBuffer  # Assignment of a double buffer configuration to this transfer. Note This parameter is available only if the parameter DmaChannelDoubleBufferEnable is set to true.
          reference DmaTransferCircularBufferAssignment [0..1]: multiplicity set at post-build, origin=ChipowerTech, post-build-variant-multiplicity=true, post-build-variant-value=true, set at post-build, destination=DmaCircularBuffer  # Assignment of a circular buffer configuration to this transfer. Note This parameter is available only if the parameter DmaChannelCircularBufferEnable is set to true.
          reference DmaTransferPatternAssignment [0..1]: multiplicity set at post-build, origin=ChipowerTech, post-build-variant-multiplicity=true, post-build-variant-value=true, set at post-build, destination=DmaPattern  # Assignment of a pattern match configuration to this transfer. Note This parameter is available only if the parameter DmaChannelPatternEnable is set to true.
        container DmaChLinkedListItemConfig [0..254]: multiplicity set at pre-compile, requires-index=true  # This container contains the configuration parameters of the linked list information. Note - This container is available only if the parameter DmaChannelLinkedListEnable for this channel is set to true. - The number of linked list elements must be greater than 2.
          integer DmaChLinkedListId: 0..254, origin=ChipowerTech, set at pre-compile, default-value=1  # Logical identifies of the linked list in the current channel.
          reference DmaChLinkedListTransferAssignment [2..*]: multiplicity set at post-build, origin=ChipowerTech, post-build-variant-multiplicity=true, post-build-variant-value=true, requires-index=true, set at post-build, destination=DmaChTransferConfig  # Assignment of transfers to this linked list.
        container DmaChShadowConfig [0..254]: multiplicity set at pre-compile, requires-index=true  # This container contains the configuration parameters of the shadowing operation information. Note - This container is available only if the parameter DmaChannelShadowOperationEnable for this channel is set to true.
          integer DmaChShadowId: 0..254, origin=ChipowerTech, set at pre-compile, default-value=1  # Logical identifiers of each shadowing in the current channel.
          boolean DmaChShadowLinkedListEnable [0..1]: multiplicity set at post-build, origin=ChipowerTech, post-build-variant-multiplicity=true, post-build-variant-value=true, set at post-build, default-value=false  # Enables / Disables the linked list for this shadowing operation in this channel. Note This parameter is only valid when "DmaChannelLinkedListEnable" is true.
          reference DmaChShadowLinkedListAssignment [0..1]: multiplicity set at post-build, origin=ChipowerTech, post-build-variant-multiplicity=true, post-build-variant-value=true, set at post-build, destination=DmaChLinkedListItemConfig  # Assignment of a linked list to this shadowing.
          reference DmaChShadowTransferAssignment: origin=ChipowerTech, post-build-variant-value=true, set at post-build, destination=DmaChTransferConfig  # Assignment of a transfer to this shadowing.
      container DmaDoubleBuffer [0..254]: multiplicity set at pre-compile, requires-index=true  # This container contains the configuration parameters of the double buffer. Note This container is available only if the parameter DmaDoubleBufferEnable is set to true.
        integer DmaDoubleBufferId: 0..254, origin=ChipowerTech, post-build-variant-value=true, set at post-build, default-value=1  # Logical identifies for each double buffer.
        string DmaDoubleBufferAddress: origin=ChipowerTech, post-build-variant-value=true, set at post-build, default-value=NULL_PTR  # Second address for this double buffering. Note The input address can be a number or a variable address. - If it is a number, the suffix U must be added, such as "0x8000000U" - If it is a variable, the address-of operator & must be used, for example "&DoubleBufferAddress". - If it is an array, the array head address can be written directly, such as "&DoubleBufferAddressArray[0]" or "DoubleBufferAddressArray".
        enumeration DmaDoubleBufferSelect: {SOURCE, DESTINATION}, origin=ChipowerTech, post-build-variant-value=true, set at post-build, default-value=SOURCE  # Select whether the double buffering applies to source buffer or destination buffer.
        enumeration DmaDoubleBufferSwitchMethod: {DMA_DBSWITCHMODE_SW, DMA_DBSWITCHMODE_HW_SW}, origin=ChipowerTech, post-build-variant-value=true, set at post-build, default-value=DMA_DBSWITCHMODE_HW_SW  # Select double buffering switch method.
        function name DmaDoubleBufferFrozenNotification [0..1]: multiplicity set at post-build, origin=ChipowerTech, post-build-variant-multiplicity=true, post-build-variant-value=true, set at post-build, default-value=NULL_PTR  # Callback function for any buffer in the double buffering is frozen.
      container DmaCircularBuffer [0..254]: multiplicity set at pre-compile, requires-index=true  # This container contains the configuration parameters of the circular buffer. Note This parameter is available only if the parameter DmaCircularBufferEnable is set to true.
        integer DmaCircularBufferId: 0..254, origin=ChipowerTech, post-build-variant-value=true, set at post-build, default-value=1  # Logical identifies for each circular buffer.
        enumeration DmaSourceCircularBufferSize: {DMA_CBSIZE_NONE, DMA_CBSIZE_2BYTE, DMA_CBSIZE_4BYTE, DMA_CBSIZE_8BYTE, DMA_CBSIZE_16BYTE, DMA_CBSIZE_32BYTE, DMA_CBSIZE_64BYTE, DMA_CBSIZE_128BYTE, DMA_CBSIZE_256BYTE, DMA_CBSIZE_512BYTE, DMA_CBSIZE_1024BYTE, DMA_CBSIZE_4096BYTE, DMA_CBSIZE_8192BYTE, DMA_CBSIZE_16384BYTE, DMA_CBSIZE_32768BYTE}, origin=ChipowerTech, post-build-variant-value=true, set at post-build, default-value=DMA_CBSIZE_NONE  # Configure the circular size of the circular buffer for the source address.
        enumeration DmaDestinationCircularBufferSize: {DMA_CBSIZE_NONE, DMA_CBSIZE_2BYTE, DMA_CBSIZE_4BYTE, DMA_CBSIZE_8BYTE, DMA_CBSIZE_16BYTE, DMA_CBSIZE_32BYTE, DMA_CBSIZE_64BYTE, DMA_CBSIZE_128BYTE, DMA_CBSIZE_256BYTE, DMA_CBSIZE_512BYTE, DMA_CBSIZE_1024BYTE, DMA_CBSIZE_4096BYTE, DMA_CBSIZE_8192BYTE, DMA_CBSIZE_16384BYTE, DMA_CBSIZE_32768BYTE}, origin=ChipowerTech, post-build-variant-value=true, set at post-build, default-value=DMA_CBSIZE_NONE  # Configure the circular size of the circular buffer for the destination address.
        boolean DmaDcbRollbackHaltEnable [0..1]: multiplicity set at post-build, origin=ChipowerTech, post-build-variant-multiplicity=true, post-build-variant-value=true, set at post-build, default-value=false  # Enables / Disables the destination circular buffer rollback halt functionablity for the circular buffer.
      container DmaPattern [0..254]: multiplicity set at pre-compile, requires-index=true  # This container contains the configuration parameters of the pattern match. Note This parameter is available only if the parameter DmaPatternEnable is set to true.
        integer DmaPatternId: 0..254, origin=ChipowerTech, post-build-variant-value=true, set at post-build, default-value=1  # Logical identifies for each pattern.
        enumeration DmaPatternSize: {DMA_PATTERNSIZE_8BIT, DMA_PATTERNSIZE_16BIT, DMA_PATTERNSIZE_32BIT}, origin=ChipowerTech, post-build-variant-value=true, set at post-build, default-value=DMA_PATTERNSIZE_8BIT  # Configure the data size for pattern matching.
        integer DmaPatternData: 0..4294967295, origin=ChipowerTech, post-build-variant-value=true, set at post-build, default-value=0  # Data for pattern matching.
        integer DmaPatternDataMaskBits [0..1]: 0..4294967295, multiplicity set at post-build, origin=ChipowerTech, post-build-variant-multiplicity=true, post-build-variant-value=true, set at post-build, default-value=0  # Data mask bits of pattern matching.
        boolean DmaTransferStopPatternMatched [0..1]: multiplicity set at post-build, origin=ChipowerTech, post-build-variant-multiplicity=true, post-build-variant-value=true, set at post-build, default-value=false  # Whether to stop the current transfer when the data pattern matches successfully. true: Stop false: Not stop
      container DmaDaisyChain [0..254]: multiplicity set at pre-compile, requires-index=true  # This container contains the configuration parameters of the daisy chain. Note This parameter is available only if the parameter DmaDaisyChainEnable is set to true.
        integer DmaDaisyChainId: 0..65535, origin=ChipowerTech, post-build-variant-value=true, set at post-build, symbolic-name-value=true, default-value=1  # Logical identifies for each daisy chain Note This parameter is only valid when DmaDaisyChainEnable = true
        reference DmaDaisyChainAssignment [2..*]: multiplicity set at post-build, origin=ChipowerTech, post-build-variant-multiplicity=true, post-build-variant-value=true, requires-index=true, set at post-build, destination=DmaChannel  # Assignment of a channel configuration to this daisychain.
    container CommonPublishedInformation  # Common container, aggregated by all modules. It contains published information about vendor and versions.
      integer ArReleaseMajorVersion: 0..255, origin=ChipowerTech, set at published-information, default-value=4  # Major version number of AUTOSAR specification on which the appropriate implementation is based on.
      integer ArReleaseMinorVersion: 0..255, origin=ChipowerTech, set at published-information, default-value=4  # Minor version number of AUTOSAR specification on which the appropriate implementation is based on.
      integer ArReleaseRevisionVersion: 0..255, origin=ChipowerTech, set at published-information, default-value=0  # Revision version number of AUTOSAR specification on which the appropriate implementation is based on.
      integer ModuleId: 0..255, origin=ChipowerTech, set at published-information, default-value=255  # Module ID of this module from Module List.
      integer SwMajorVersion: 0..255, origin=ChipowerTech, set at published-information, default-value=1  # Major version number of the vendor specific implementation of the module. The numbering is vendor specific.
      integer SwMinorVersion: 0..255, origin=ChipowerTech, set at published-information, default-value=2  # Minor version number of the vendor specific implementation of the module. The numbering is vendor specific.
      integer SwPatchVersion: 0..255, origin=ChipowerTech, set at published-information, default-value=0  # Patch level version number of the vendor specific implementation of the module. The numbering is vendor specific.
      integer VendorId: 175..175, origin=ChipowerTech, set at published-information, default-value=175  # Vendor ID of the dedicated implementation of this module according to the AUTOSAR vendor list.
