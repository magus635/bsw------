AUTOSAR XML (schema 00046)
package /THA6_AS440_FuSa
  ecuc definition collection Sent_EcuParameterDefinition: module=Sent
  module definition Sent [0..*]: post-build-variant-support=true, variants post-build  # Configuration of the Sent module.
    container SentConfigSet [0..1]: multiplicity set at pre-compile  # This is the base container that contains the post-build selectable configuration parameters
      container SentChannelConfigSet [1..25]: multiplicity set at pre-compile, requires-index=true  # This is the base container that contains the post-build selectable configuration parameters for a particular channel
        integer SentChLogiIndex: 0..24, origin=ChipowerTech, set at pre-compile, default-value=0  # SENT Logical Channel Id to be configured.
        enumeration SentChPhyIndex: {SENT0, SENT1, SENT2, SENT3, SENT4, SENT5, SENT6, SENT7, SENT8, SENT9, SENT10, SENT11, SENT12, SENT13, SENT14, SENT15, SENT16, SENT17, SENT18, SENT19, SENT20, SENT21, SENT22, SENT23, SENT24}, origin=ChipowerTech, set at pre-compile, default-value=SENT0  # Defines the physical id of the Sent
        enumeration SentChanCRCType: {SENT_CRC_TYPE_2010, SENT_CRC_TYPE_2007}, origin=ChipowerTech, post-build-variant-value=true, set at post-build, default-value=SENT_CRC_TYPE_2010  # Defines the CRC mode to be used for fast channel/slow channel data communication
        boolean SentChanStatusNibbleCRCInc: origin=ChipowerTech, post-build-variant-value=true, set at post-build, default-value=false  # Defines whether status nibble should be used for CRC calculation.
        boolean SentChanFrameCrcDisable: origin=ChipowerTech, post-build-variant-value=true, set at post-build, default-value=false  # Defines whether the current SENT frame's CRC should be verified internally by SENT hardware. If TRUE, then it is responsibility of the application to verify the CRC of the received SENT frame.
        integer SentChanFrameDataLen: 1..6, origin=ChipowerTech, post-build-variant-value=true, set at post-build, default-value=6  # Defines the number of data nibbles per SENT frame. It does not include sync pulse, status nibble, CRC nibble, or the additional zero length nibble. If more than 8 nibbles are configured, RDI interrupt is issued each time 8 nibbles are written into RDR register of that channel. At the end of the last data frame also, RDI interrupt is issued. If no RDI interrupt occurs at the last data frame, an error has occurred. RSI interrupt shall be issued at every successful receive of a single SENT frame.
        boolean SentChanIgnoreEndPulse: origin=ChipowerTech, post-build-variant-value=true, set at post-build, default-value=false  # Defines whether end pulse should be ignored or not. For some systems with an end pulse, during synchronize or resynchronize of reception, if calibration pulses are detected one immediately following the other, the first calibration pulse shall be ignored as it may be a pause pulse with duration matching the calibration pulse range.
        enumeration SentChanInPulse: {SENT_POLARITY_RISING, SENT_POLARITY_FALLING}, origin=ChipowerTech, post-build-variant-value=true, set at post-build, default-value=SENT_POLARITY_RISING  # Defines pulse polarity of the respective input channel.
        integer SentClocksPerTick: 1..2047, origin=ChipowerTech, post-build-variant-value=true, set at post-build, default-value=15  # Number of clocks in a tick as resulting from the sync pulse.
        function name SentChanCalloutFn: origin=ChipowerTech, post-build-variant-value=true, set at post-build, default-value=NULL_PTR  # Defines the function to be invoked for any notification event of the respective channel.
        function name SentChanErrCalloutFn: origin=ChipowerTech, post-build-variant-value=true, set at post-build, default-value=NULL_PTR  # Defines the function to be invoked for any notification error of the respective channel.
        container SPCConfig: requires-index=true  # This is the base container that contains configuration parameters for SPC.
          boolean SentChanUsedSpc: origin=ChipowerTech, post-build-variant-value=true, set at post-build, default-value=false  # Defines whether spc should be used or not.
          enumeration SentTriggerMode: {SENT_TRIGGER_MODE_SPC, SENT_TRIGGER_MODE_GTM}, origin=ChipowerTech, post-build-variant-value=true, set at post-build, default-value=SENT_TRIGGER_MODE_SPC  # The trigger mode (SPC or GTM).
          integer SentSpcPlusWidth: 1..255, origin=ChipowerTech, post-build-variant-value=true, set at post-build, default-value=3  # Number of tick for the SPC master pulse.
          choice reference SentGtmChannel: origin=ChipowerTech, post-build-variant-value=true, set at post-build, destination=[SaradcSent, Dsadc]  # Gtm channel for triggering SPC.
    container SentGeneral  # General configuration (parameters) of the SENT driver software module.
      boolean SentDeInitApi: origin=ChipowerTech, set at pre-compile, default-value=false  # Adds / removes the service Sent_DeInit() from the code. true: Sent_DeInit() can be used. false: Sent_DeInit() can not be used.
      boolean SentDevErrorDetect: origin=ChipowerTech, set at pre-compile, default-value=true  # Switches the Development Error Detection and Notification ON or OFF. true: Enabled. false: Disabled.
      boolean SentSafetyErrorDetect: origin=ChipowerTech, set at pre-compile, default-value=true  # Switches the Safety Development Error Detection and Notification ON or OFF. true: Enabled. false: Disabled.
      boolean SentSpcFeatureSupport: origin=ChipowerTech, set at pre-compile, default-value=false  # Determines, if the SPC (Short PWM Code) feature should be enabled or not. true: Enabled. false: Disabled.
      boolean SentVersionInfoApi: origin=ChipowerTech, set at pre-compile, default-value=false  # Adds / removes the service Sent_GetVersionInfo() from the code. true: Sent_GetVersionInfo() can be used. false: Sent_GetVersionInfo() can not be used.
      integer SentIndex: 0..255, origin=ChipowerTech, set at pre-compile, default-value=0  # Specifies the InstanceId of this module instance. If only one instance is present it shall have the Id 0.
    container SentPublishedInformation  # Additional published parameters not covered by CommonPublishedInformation container. Note that these parameters do not have any configuration class setting, since they are published information.
    container CommonPublishedInformation  # Common container, aggregated by all modules. It contains published information about vendor and versions.
      integer ArReleaseMajorVersion: 0..255, origin=ChipowerTech, set at published-information, default-value=4  # Major version number of AUTOSAR specification on which the appropriate implementation is based on.
      integer ArReleaseMinorVersion: 0..255, origin=ChipowerTech, set at published-information, default-value=4  # Minor version number of AUTOSAR specification on which the appropriate implementation is based on.
      integer ArReleasePatchVersion: 0..255, origin=ChipowerTech, set at published-information, default-value=0  # Patch level version number of AUTOSAR specification on which the appropriate implementation is based on.
      integer SwMajorVersion: 0..255, origin=ChipowerTech, set at published-information, default-value=1  # Major version number of the vendor specific implementation of the module. The numbering is vendor specific.
      integer SwMinorVersion: 0..255, origin=ChipowerTech, set at published-information, default-value=2  # Minor version number of the vendor specific implementation of the module. The numbering is vendor specific.
      integer SwPatchVersion: 0..255, origin=ChipowerTech, set at published-information, default-value=0  # Patch level version number of the vendor specific implementation of the module. The numbering is vendor specific.
      integer ModuleId: 0..65535, origin=ChipowerTech, set at published-information, default-value=255  # Module ID of this module from Module List
      integer VendorId: 0..65535, origin=ChipowerTech, set at published-information, default-value=175  # Vendor ID of the dedicated implementation of this module according to the AUTOSAR vendor list
