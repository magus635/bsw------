AUTOSAR XML (schema 00046)
package /THA6_AS440_FuSa
  ecuc definition collection Icu_EcuParameterDefinition: module=Icu
  module definition Icu [0..1]: post-build-variant-support=true, refined-module-def=Icu, variants post-build  # Configuration of the Icu (Input Capture Unit) module.
    container IcuConfigSet  # This container contains the configuration parameters and sub containers of the AUTOSAR Icu module.
      integer IcuMaxChannel: 0..65535, set at pre-compile, default-value=1  # This parameter contains the number of Channels configured. It will be gathered by tools during the configuration stage. calculation Formula = Number of configured Icu Channels Implementation Type: Icu_ChannelType. This parameter doesn't have any influence on the generated code file
      container IcuChannel [1..*]: multiplicity set at post-build, requires-index=true  # Configuration of an individual ICU channel.
        integer IcuChannelId: 0..65535, scope=ECU, set at pre-compile, symbolic-name-value=true, default-value=0  # Channel Id of the ICU channel. This value will be assigned to the symbolic name derived of the IcuChannel container short name.
        enumeration IcuDefaultStartEdge: {ICU_BOTH_EDGES, ICU_FALLING_EDGE, ICU_RISING_EDGE}, post-build-variant-value=true, set at post-build, default-value=ICU_FALLING_EDGE  # Configures the default-activation-edge which shall be used for this channel if there was no activation-edge configured by the call of service Icu_SetActivationCondition().
        enumeration IcuMeasurementMode: {ICU_MODE_EDGE_COUNTER, ICU_MODE_SIGNAL_EDGE_DETECT, ICU_MODE_SIGNAL_MEASUREMENT, ICU_MODE_TIMESTAMP}, post-build-variant-value=true, set at post-build, default-value=ICU_MODE_EDGE_COUNTER  # Configures the measurement mode of this channel.
        boolean IcuWakeupCapability: post-build-variant-value=true, set at post-build, default-value=false  # Information about the wakeup-capability of this channel.
        enumeration TimChannelInputSelect [0..1]: {INPUT_OF_CURRENT_TIM_CHANNEL, INPUT_OF_PREVIOUS_TIM_CHANNEL, INPUT_OF_AUX_IN}, multiplicity set at post-build, origin=ChipowerTech, post-build-variant-value=true, set at post-build, default-value=INPUT_OF_CURRENT_TIM_CHANNEL  # This decides the Input for the channel INPUT_OF_CURRENT_TIM_CHANNEL: Input to the current TIM Channel will be the input assigned to this channel. INPUT_OF_PREVIOUS_TIM_CHANNEL: Input to the current TIM channel will be the input assigned to the previous channel. Please note, the Port and Pin number applicable in this case is the configuration for the previous channel and not the Port and Pin configured for this channel. INPUT_OF_AUX_IN: Input to the current TIM channel will be ATOM or TOM signal.
        enumeration AuxInSource [0..1]: {TOM0CH01N, TOM00CH00, ATOM0CH1N, ATOM0CH00, TOM0CH02N, TOM00CH01, ATOM0CH2N, ATOM0CH01, TOM0CH03N, TOM00CH02, ATOM0CH3N, ATOM0CH02, TOM0CH04N, TOM00CH03, ATOM0CH4N, ATOM0CH03, TOM0CH05N, TOM00CH04, ATOM0CH5N, ATOM0CH04, TOM0CH06N, TOM00CH05, ATOM0CH6N, ATOM0CH05, TOM0CH07N, TOM00CH06, ATOM0CH7N, ATOM0CH06, TOM0CH00N, TOM00CH07, ATOM0CH0N, ATOM0CH07, TOM0CH09N, TOM00CH08, ATOM1CH1N, ATOM1CH00, TOM01CH00, TOM0CH10N, TOM00CH09, ATOM1CH2N, ATOM1CH01, TOM01CH01, TOM0CH11N, TOM00CH10, ATOM1CH3N, ATOM1CH02, TOM01CH02, TOM0CH12N, TOM00CH11, ATOM1CH4N, ATOM1CH03, TOM01CH03, TOM0CH13N, TOM00CH12, ATOM1CH5N, ATOM1CH04, TOM01CH04, TOM0CH14N, TOM00CH13, ATOM1CH6N, ATOM1CH05, TOM01CH05, TOM0CH15N, TOM00CH14, ATOM1CH7N, ATOM1CH06, TOM01CH06, TOM0CH08N, TOM00CH15, ATOM1CH0N, ATOM1CH07, TOM01CH07, TOM1CH01N, ATOM2CH1N, ATOM2CH00, TOM02CH00, TOM1CH02N, ATOM2CH2N, ATOM2CH01, TOM02CH01, TOM1CH03N, ATOM2CH3N, ATOM2CH02, TOM02CH02, TOM1CH04N, ATOM2CH4N, ATOM2CH03, TOM02CH03, TOM1CH05N, ATOM2CH5N, ATOM2CH04, TOM02CH04, TOM1CH06N, ATOM2CH6N, ATOM2CH05, TOM02CH05, TOM1CH07N, ATOM2CH7N, ATOM2CH06, TOM02CH06, TOM1CH00N, ATOM2CH0N, ATOM2CH07, TOM02CH07}, multiplicity set at post-build, origin=ChipowerTech, post-build-variant-value=true, set at post-build, default-value=TOM0CH01N  # This decides the input Source of the Icu channel when TimChannelInputSelect is INPUT_OF_AUX_IN. There are two groups of channels to choose from, all TOM channels are selected from the same group. Group1:{TimXChY choose TomXChY (Y less than 8)}. group2 {TimXchY choose TomXchY (Y from 0 to 7) or choose Tom(X-1)ChY (X bigger than 0 , Y from 0 to 15) }
        enumeration IcuGtmSmuClkSrc: {CMU_CLK0, CMU_CLK1, CMU_CLK2, CMU_CLK3, CMU_CLK4, CMU_CLK5, CMU_CLK6, CMU_CLK7}, origin=ChipowerTech, post-build-variant-value=true, set at post-build, default-value=CMU_CLK0  # This parameter is used to select the clock source for timer TIM SMU sub module
        choice reference IcuChannelInputSelection: scope=ECU, origin=ChipowerTech, post-build-variant-value=true, set at post-build, destination=GtmTimChannel  # This parameter contains the selection of ICU channel.
        reference IcuChannelEcucPartitionRef [0..*]: scope=ECU, multiplicity set at pre-compile, post-build-variant-multiplicity=true, post-build-variant-value=true, set at pre-compile, destination=EcucPartition  # Maps an ICU channel to zero or multiple ECUC partitions to limit the access to this channel. The ECUC partitions referenced are a subset of the ECUC partitions where the ICU driver is mapped to. Tags: atp.Status=draft
        container TimChannelFilterConfig  # This holds the filter specific configurations for the channels.
          boolean TimChannelFilterEnable: origin=ChipowerTech, post-build-variant-value=true, set at post-build, default-value=false  # Enables Filter for the Channel. This sets FLT_EN for the channel
          enumeration TimChFilterCounterFreqSelect: {CMU_TIM_FILTER_CLK_0, CMU_TIM_FILTER_CLK_1, CMU_TIM_FILTER_CLK_6, CMU_TIM_FILTER_CLK_7}, origin=ChipowerTech, post-build-variant-value=true, set at post-build, default-value=CMU_TIM_FILTER_CLK_0  # This decides the Filter Counter frequency for the TIM Channel. This modifies the FLT_CNT_FRQ for the channel
          enumeration TimChFilterModeForRisingEdge: {TIM_FLTMODE_IMMEDIATE, TIM_FLTMODE_DEGLITCHTIMEUPDOWN, TIM_FLTMODE_DEGLITCHTIMEHOLD}, origin=ChipowerTech, post-build-variant-value=true, set at post-build, default-value=TIM_FLTMODE_IMMEDIATE  # This decides the Filter Mode for Rising Edge of the TIM Channel Input
          enumeration TimChFilterModeForFallingEdge: {TIM_FLTMODE_IMMEDIATE, TIM_FLTMODE_DEGLITCHTIMEUPDOWN, TIM_FLTMODE_DEGLITCHTIMEHOLD}, origin=ChipowerTech, post-build-variant-value=true, set at post-build, default-value=TIM_FLTMODE_IMMEDIATE  # This decides the Filter Mode for Falling Edge of the TIM Channel Input
          integer TimChFilterTimeForRisingEdge: 0..16777215, origin=ChipowerTech, post-build-variant-value=true, set at post-build, default-value=0  # This parameter specifies the Filter Time for Rising Edge of the TIM Channel Input
          integer TimChFilterTimeForFallingEdge: 0..16777215, origin=ChipowerTech, post-build-variant-value=true, set at post-build, default-value=0  # This parameter specifies the Filter Time for Falling Edge of the TIM Channel Input
        container IcuSignalEdgeDetection [0..1]: multiplicity set at post-build  # This container contains the configuration (parameters) in case the measurement mode is "IcuSignalEdgeDetection"
          function name IcuSignalNotification [0..1]: multiplicity set at post-build, post-build-variant-multiplicity=true, post-build-variant-value=true, set at post-build, default-value=Icu_SignalNotification_0  # Notification function for signal notification.
        container IcuSignalMeasurement [0..1]: multiplicity set at post-build  # This container contains the configuration (parameters) in case the measurement mode is "IcuSignalMeasurement"
          enumeration IcuSignalMeasurementProperty: {ICU_DUTY_CYCLE, ICU_HIGH_TIME, ICU_LOW_TIME, ICU_PERIOD_TIME}, post-build-variant-value=true, set at post-build, default-value=ICU_HIGH_TIME  # Configures the property that could be measured in case the mode is "IcuSignalMeasurement".
        container IcuTimestampMeasurement [0..1]: multiplicity set at post-build  # This container contains the configuration (parameters) in case the measurement mode is "IcuTimestamp"
          enumeration IcuTimestampMeasurementProperty: {ICU_CIRCULAR_BUFFER, ICU_LINEAR_BUFFER}, post-build-variant-value=true, set at post-build, default-value=ICU_CIRCULAR_BUFFER  # Configures the handling of the buffer in case the mode is "Timestamp"
          function name IcuTimestampNotification [0..1]: multiplicity set at post-build, post-build-variant-multiplicity=true, post-build-variant-value=true, set at post-build, default-value=Icu_TimestampNotification_0  # Notification function if the number of requested timestamps
        container IcuWakeup [0..1]: multiplicity set at post-build  # This container contains the configuration (parameters) needed to configure a wakeup capable channel
          reference IcuChannelWakeupInfo [0..1]: multiplicity set at post-build, post-build-variant-multiplicity=true, post-build-variant-value=true, set at post-build, requires-symbolic-name-value=true, destination=EcuMWakeupSource  # If the wakeup-capability is true the wakeup source referenced is transmitted to the ECU State Manager (EcuM) .
    container IcuGeneral  # Configuration of general ICU parameters.
      boolean IcuDevErrorDetect: set at pre-compile, default-value=false  # Switches the Default Error Tracer (Det) detection and notification ON or OFF.
      boolean IcuSafetyErrorDetect: origin=ChipowerTech, set at pre-compile, default-value=true  # Switches the Safety Error detection ON or OFF.
      boolean IcuReportWakeupSource: set at pre-compile, default-value=false  # Switch for enabling Wakeup source reporting.
      boolean IcuAlreadyEnableDisableDetCheck: origin=ChipowerTec, set at post-build, default-value=true  # This parameter enables/disables the ICU_E_ALREADY_ENABLED / ICU_E_ALREADY_DISABLED Det check in API Icu_EnableNotification / Icu_DisableNotification
      boolean IcuAlreadyInitDetCheck: origin=ChipowerTec, set at post-build, default-value=true  # This parameter enables / disables the ICU_E_ALREADY_INITIALIZED Det check in Icu_Init API.
      reference IcuEcucPartitionRef [0..*]: scope=ECU, multiplicity set at pre-compile, post-build-variant-multiplicity=true, post-build-variant-value=true, set at pre-compile, destination=EcucPartition  # Maps the ICU driver to zero or multiple ECUC partitions to make the driver API available in the according partition. Tags: atp.Status=draft
      reference IcuKernelEcucPartitionRef [0..1]: scope=ECU, multiplicity set at pre-compile, post-build-variant-multiplicity=true, post-build-variant-value=true, set at pre-compile, destination=EcucPartition  # Maps the ICU kernel to zero or one ECUC partitions to assign the driver kernel to a certain core. The ECUC partition referenced is a subset of the ECUC partitions where the ICU driver is mapped to. Tags: atp.Status=draft
    container IcuOptionalApis  # This container contains all configuration switches for configuring optional API services of the ICU driver.
      boolean IcuDeInitApi: set at pre-compile, default-value=true  # Adds / removes the service Icu_DeInit() from the code.
      boolean IcuDisableWakeupApi: set at pre-compile, default-value=false  # Adds / removes the service Icu_DisableWakeup() from the code.
      boolean IcuEdgeCountApi: set at pre-compile, default-value=true  # Adds / removes all services related to the edge counting functionality as listed below, from the code: Icu_ResetEdgeCount(), Icu_EnableEdgeCount(), Icu_DisableEdgeCount(), Icu_GetEdgeNumbers().
      boolean IcuEdgeDetectApi: set at pre-compile, default-value=true  # Adds / removes the services related to the edge detection functionality, from the code:
      boolean IcuEnableWakeupApi: set at pre-compile, default-value=false  # Adds / removes the service Icu_EnableWakeup() from the code.
      boolean IcuGetDutyCycleValuesApi: set at pre-compile, default-value=true  # Adds / removes the service Icu_GetDutyCycleValues() from the code.
      boolean IcuGetInputStateApi: set at pre-compile, default-value=true  # Adds / removes the service Icu_GetInputState() from the code.
      boolean IcuGetTimeElapsedApi: set at pre-compile, default-value=true  # Adds / removes the service Icu_GetTimeElapsed() from the code.
      boolean IcuGetVersionInfoApi: set at pre-compile, default-value=false  # Adds / removes the service Icu_GetVersionInfo() from the code.
      boolean IcuSetModeApi: set at pre-compile, default-value=false  # Adds / removes the service Icu_SetMode() from the code.
      boolean IcuSignalMeasurementApi: set at pre-compile, default-value=true  # Adds / removes the services Icu_StartSignalMeasurement() and Icu_StopSignalMeasurement() from the code.
      boolean IcuTimestampApi: set at pre-compile, default-value=true  # Adds / removes all services related to the timestamping functionality as listed below from the code: Icu_StartTimestamp(), Icu_StopTimestamp(), Icu_GetTimestampIndex().
      boolean IcuWakeupFunctionalityApi: set at pre-compile, default-value=false  # Adds / removes the service Icu_CheckWakeup() from the code.
    container CommonPublishedInformation  # Common container, aggregated by all modules. It contains published information about vendor and versions.
      integer ArReleaseMajorVersion: 4..4, origin=ChipowerTech, set at published-information, default-value=4  # Major version number of AUTOSAR specification on which the appropriate implementation is based on.
      integer ArReleaseMinorVersion: 0..255, origin=ChipowerTech, set at published-information, default-value=4  # Minor version number of AUTOSAR specification on which the appropriate implementation is based on.
      integer ArReleaseRevisionVersion: 0..255, origin=ChipowerTech, set at published-information, default-value=0  # Revision version number of AUTOSAR specification on which the appropriate implementation is based on.
      integer ModuleId: 122..122, origin=ChipowerTech, set at published-information, default-value=122  # Module ID of this module from Module List. Note: Implementation Specific Parameter
      integer SwMajorVersion: 0..255, origin=ChipowerTech, set at published-information, default-value=1  # Major version number of the vendor specific implementation of the module. The numbering is vendor specific. Note: Implementation Specific Parameter
      integer SwMinorVersion: 0..255, origin=ChipowerTech, set at published-information, default-value=2  # Minor version number of the vendor specific implementation of the module. The numbering is vendor specific. Note: Implementation Specific Parameter
      integer SwPatchVersion: 0..255, origin=ChipowerTech, set at published-information, default-value=0  # Patch level version number of the vendor specific implementation of the module. The numbering is vendor specific. Note: Implementation Specific Parameter
      integer VendorId: 175..175, origin=ChipowerTech, set at published-information, default-value=175  # Vendor ID of the dedicated implementation of this module according to the AUTOSAR vendor list. Note: Implementation Specific Parameter
