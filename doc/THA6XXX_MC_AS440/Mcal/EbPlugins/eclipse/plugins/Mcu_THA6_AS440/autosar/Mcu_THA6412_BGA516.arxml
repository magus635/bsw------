[part 1 of 2: package /THA6_AS440_FuSa]
AUTOSAR XML (schema 00046)
package /THA6_AS440_FuSa
  ecuc definition collection Mcu_EcuParameterDefinition: module=Mcu
  module definition Mcu [0..1]: post-build-variant-support=true, refined-module-def=Mcu, variants post-build  # Configuration of the Mcu (Microcontroller Unit) module.
    container McuGeneralConfiguration  # This container contains the configuration (parameters) of the MCU driver.
      boolean McuDevErrorDetect: set at pre-compile, default-value=false  # Switches the Default Error Tracer (Det) detection and notification ON or OFF.
      boolean McuSafetyErrorDetect: origin=ChipowerTech, set at pre-compile, default-value=true  # Switches the Safety Error detection ON or OFF.
      boolean McuGetRamStateApi: set at pre-compile, default-value=false  # Pre-processor switch to enable/disable the API Mcu_GetRamState.
      boolean McuClearColdResetStatusApi: origin=Chipower, set at pre-compile, default-value=false  # Pre-processor switch to enable/disable the API Mcu_ClearColdResetStatus..
      boolean McuInitClock: set at pre-compile, default-value=true  # If this parameter is set to FALSE, the clock initialization has to be disabled from the MCU driver. This concept applies when there are some write once clock registers and a bootloader is present. If this parameter is set to TRUE, the MCU driver is responsible of the clock initialization.
      boolean McuNoPll: set at pre-compile, default-value=false  # This parameter shall be set True, if the H/W does not have a PLL or the PLL circuitry is enabled after the power on without S/W intervention. In this case MCU_DistributePllClock has to be disabled and MCU_GetPllStatus has to return MCU_PLL_STATUS_UNDEFINED. Otherwise this parameters has to be set False
      boolean McuPerformResetApi: set at pre-compile, default-value=false  # Pre-processor switch to enable / disable the use of the function Mcu_PerformReset()
      boolean McuVersionInfoApi: set at pre-compile, default-value=false  # Pre-processor switch to enable / disable the API to read out the modules version information.
      reference McuEcucPartitionRef [0..*]: scope=ECU, multiplicity set at pre-compile, post-build-variant-multiplicity=true, post-build-variant-value=true, set at pre-compile, destination=EcucPartition  # Maps the MCU driver to zero or multiple ECUC partition to make the driver API available in this partition. Tags: atp.Status=draft
    container McuModuleConfiguration  # This container contains the configuration (parameters) of the MCU driver
      enumeration McuClockSrcFailureNotification: {DISABLED, ENABLED}, post-build-variant-value=true, set at post-build, default-value=DISABLED  # Enables/Disables clock failure notification. In case this feature is not supported by HW the setting should be disabled.
      integer McuNumberOfMcuModes: 1..255, set at pre-compile, default-value=1  # This parameter shall represent the number of Modes available for the MCU.
      integer McuRamSectors: 0..4294967295, post-build-variant-value=true, set at post-build, default-value=0  # This parameter shall represent the number of Ram available for the MCU. This parameter is disabled and is included here for completeness. calculation Formula = Number of configured McuRamSectorSettingConf.
      integer McuResetSetting [0..1]: 1..255, multiplicity set at pre-compile, set at pre-compile, default-value=1  # This parameter relates to the MCU specific reset configuration. This applies to the function Mcu_PerformReset, which performs a microcontroller reset using the hardware feature of the microcontroller. This parameter is disabled and is included here for completeness.
      container McuResetConfig  # This container contains the configuration (parameters) of the reset settings
        enumeration McuSWResetConf: {RCC_RSTTYPE_NONE, RCC_RSTTYPE_SYS, RCC_RSTTYPE_APP}, origin=ChipowerTech, post-build-variant-value=true, set at post-build, default-value=RCC_RSTTYPE_APP  # This parameter defines the response of SW reset request. RCC_RSTTYPE_NONE : No reset request is triggered. RCC_RSTTYPE_SYS : System reset is triggered. RCC_RSTTYPE_APP: Application reset request is triggered.
        enumeration McuESR0ResetConf: {RCC_RSTTYPE_NONE, RCC_RSTTYPE_SYS, RCC_RSTTYPE_APP}, origin=ChipowerTech, post-build-variant-value=true, set at post-build, default-value=RCC_RSTTYPE_APP  # This parameter defines the response of ESR0 reset request. RCC_RSTTYPE_NONE : No reset request is triggered. RCC_RSTTYPE_SYS : System reset is triggered. RCC_RSTTYPE_APP: Application reset request is triggered.
        enumeration McuESR1ResetConf: {RCC_RSTTYPE_NONE, RCC_RSTTYPE_APP}, origin=ChipowerTech, post-build-variant-value=true, set at post-build, default-value=RCC_RSTTYPE_NONE  # This parameter defines the response of ESR1 reset request. RCC_RSTTYPE_NONE : No reset request is triggered. RCC_RSTTYPE_SYS : System reset is triggered. RCC_RSTTYPE_APP: Application reset request is triggered.
        enumeration McuSACResetConf: {RCC_RSTTYPE_NONE, RCC_RSTTYPE_SYS, RCC_RSTTYPE_APP}, origin=ChipowerTech, post-build-variant-value=true, set at post-build, default-value=RCC_RSTTYPE_NONE  # This parameter defines the response of SAC reset request. RCC_RSTTYPE_NONE : No reset request is triggered. RCC_RSTTYPE_SYS : System reset is triggered. RCC_RSTTYPE_APP: Application reset request is triggered.
        enumeration McuIWDGResetConf: {RCC_RSTTYPE_NONE, RCC_RSTTYPE_SYS, RCC_RSTTYPE_APP}, origin=ChipowerTech, post-build-variant-value=true, set at post-build, default-value=RCC_RSTTYPE_NONE  # This parameter defines the response of IWDG reset request. RCC_RSTTYPE_NONE : No reset request is triggered. RCC_RSTTYPE_SYS : System reset is triggered. RCC_RSTTYPE_APP: Application reset request is triggered.
        enumeration McuCPU0REQResetConf: {RCC_RSTTYPE_NONE, RCC_RSTTYPE_SYS, RCC_RSTTYPE_APP}, origin=ChipowerTech, post-build-variant-value=true, set at post-build, default-value=RCC_RSTTYPE_NONE  # This parameter defines the response of CPU0REQ reset request. RCC_RSTTYPE_NONE : No reset request is triggered. RCC_RSTTYPE_SYS : System reset is triggered. RCC_RSTTYPE_APP: Application reset request is triggered.
        enumeration McuCPU1REQResetConf: {RCC_RSTTYPE_NONE, RCC_RSTTYPE_SYS, RCC_RSTTYPE_APP}, origin=ChipowerTech, post-build-variant-value=true, set at post-build, default-value=RCC_RSTTYPE_NONE  # This parameter defines the response of CPU1REQ reset request. RCC_RSTTYPE_NONE : No reset request is triggered. RCC_RSTTYPE_SYS : System reset is triggered. RCC_RSTTYPE_APP: Application reset request is triggered.
        integer McuResetTimeoutCnt [0..1]: 1..4096, multiplicity set at pre-compile, origin=ChipowerTech, set at pre-compile, default-value=400  # This parameter is the Counter delay of Reset setting. Set the Timeout counter value, the default value is 0x190, and the time length is 100us.Note: The counter clock is 4Mhz and the configuration range is 1 to 0x1000
      container McuClockSettingConfig [1..*]: multiplicity set at pre-compile  # This container contains the configuration (parameters) for the Clock settings of the MCU. Please see MCU031 for more information on the MCU clock settings.
        integer McuClockSettingId: 0..255, set at pre-compile, default-value=0  # The Id of this McuClockSettingConfig to be used as argument for the API call "Mcu_InitClock".
        container McuSysPllClk_Configuration
          enumeration McuSysPllSource: {RCC_PLLCLOCKSOURCE_HSE, RCC_PLLCLOCKSOURCE_HSI}, origin=ChipowerTech, post-build-variant-value=true, set at post-build, default-value=RCC_PLLCLOCKSOURCE_HSE  # Choose the source of SysPll.
          float McuHSIClkFrequency: 1000.0..2.0E8, origin=ChipowerTech, set at post-build, default-value=1.0E8  # The item is indicate that Mcu basic frequency which is from HSI.Then the clock is set to FREF if it is used.
          float McuHSEClkFrequency: 1.6E7..4.0E7, origin=ChipowerTech, post-build-variant-value=true, set at post-build, default-value=2.0E7  # The item is indicate that Mcu basic frequency which is from HSE.Then the clock is set to FREF if it is used.
          enumeration McuSysPllMode: {RCC_PLLMODE_INTEGER, RCC_PLLMODE_DECIMAL}, origin=ChipowerTech, post-build-variant-value=true, set at post-build, default-value=RCC_PLLMODE_INTEGER  # Choose the mode of SysPll.
          integer McuSysPllRefDiv: 1..63, origin=ChipowerTech, post-build-variant-value=true, set at post-build, default-value=2  # Set the RefDiv coefficient of SysPll.
          integer McuSysPllPostDiv1: 1..7, origin=ChipowerTech, post-build-variant-value=true, set at post-build, default-value=1  # Set the PostDiv1 coefficient of SysPll.
          integer McuSysPllPostDiv2: 1..7, origin=ChipowerTech, post-build-variant-value=true, set at post-build, default-value=1  # Set the PostDiv2 coefficient of SysPll.
          integer McuSysPllFBDiv: 16..2400, origin=ChipowerTech, post-build-variant-value=true, set at post-build, default-value=80  # Set the FBDiv coefficient of SysPll.
          integer McuSysPllFRAC: 0..16777215, origin=ChipowerTech, post-build-variant-value=true, set at post-build, default-value=0  # Set the FRAC coefficient of SysPll. it is used in DECIMAL Mode.
          float McuSysPllFrequency: 1000.0..4.0E8, origin=ChipowerTech, post-build-variant-value=true, set at post-build, default-value=4.0E8  # The System Pll mode clock frequency. SysPllClk =(FREF/REFDIV)*(FBDIV/(POSTDIV1*POSTDIV2*2))
        container McuPerPllClk_Configuration
          enumeration McuPerPllSource: {RCC_PLLCLOCKSOURCE_HSE, RCC_PLLCLOCKSOURCE_HSI}, origin=ChipowerTech, post-build-variant-value=true, set at post-build, default-value=RCC_PLLCLOCKSOURCE_HSE  # Choose the source of PerPll.
          enumeration McuPerPllMode: {RCC_PLLMODE_INTEGER, RCC_PLLMODE_DECIMAL}, origin=ChipowerTech, post-build-variant-value=true, set at post-build, default-value=RCC_PLLMODE_INTEGER  # Choose the mode of PerPll.
          integer McuPerPllRefDiv: 1..63, origin=ChipowerTech, post-build-variant-value=true, set at post-build, default-value=2  # Set the RefDiv coefficient of PerPll.
          integer McuPerPllPostDiv1: 1..7, origin=ChipowerTech, post-build-variant-value=true, set at post-build, default-value=1  # Set the PostDiv1 coefficient of PerPll.
          integer McuPerPllPostDiv2: 1..7, origin=ChipowerTech, post-build-variant-value=true, set at post-build, default-value=1  # Set the PostDiv2 coefficient of PerPll.
          integer McuPerPllFBDiv: 16..2400, origin=ChipowerTech, post-build-variant-value=true, set at post-build, default-value=80  # Set the FBDiv coefficient of SysPll.
          integer McuPerPllFRAC: 0..16777215, origin=ChipowerTech, post-build-variant-value=true, set at post-build, default-value=0  # Set the FRAC coefficient of PerPll. it is used in DECIMAL Mode
          float McuPerPllFrequency: 1000.0..4.0E8, origin=ChipowerTech, post-build-variant-value=true, set at post-build, default-value=4.0E8  # The Peripheral Pll mode clock frequency. PerPllClk =(FREF/REFDIV)*(FBDIV/(POSTDIV1*POSTDIV2*2))
        container McuSysClkDiv_Configuration
          enumeration McuSysClockSource: {RCC_CPUCLOCKSOURCE_SYSPLL, RCC_CPUCLOCKSOURCE_HSE, RCC_CPUCLOCKSOURCE_HSI}, origin=ChipowerTech, post-build-variant-value=true, set at post-build, default-value=RCC_CPUCLOCKSOURCE_SYSPLL  # Choose the source of SysClock. ()
          integer CpuClkDiv: 0..255, origin=ChipowerTech, post-build-variant-value=true, set at post-build, default-value=0  # Set division paramater of CpuClk
          float McuCpuClkFrequency: 1000.0..4.0E8, origin=ChipowerTech, post-build-variant-value=true, set at post-build, default-value=4.0E8  # The Cpu clock frequency. The expression is CpuClk=McuSysClockSource/(CpuClkDiv+1).
          integer SysClkDiv: 0..7, origin=ChipowerTech, post-build-variant-value=true, set at post-build, default-value=0  # Set the SysClkDiv coefficient of Clock.()
          float McuSysClkFrequency: 2.0E7..4.0E8, origin=ChipowerTech, post-build-variant-value=true, set at post-build, default-value=4.0E8  # The SysClk clock frequency. The expression is SysClk= McuCpuClkFrequency/(SysClkDiv +1).
          integer AxiDiv: 0..63, origin=ChipowerTech, post-build-variant-value=true, set at post-build, default-value=1  # Set the AxiDiv coefficient of Clock.()
          float McuAXIClkFrequency: 0.0..2.0E8, origin=ChipowerTech, post-build-variant-value=true, set at post-build, default-value=2.0E8  # The AXI clock frequency( AxiClk and Geth CLOCK). The expression is AxiClk=McuCpuClkFrequency/ (AxiDiv+1).
          integer AhbDiv: 0..511, origin=ChipowerTech, post-build-variant-value=true, set at post-build, default-value=3  # Set the AhbDiv coefficient of Clock.()
          float McuAHBClkFrequency: 0.0..1.0E8, origin=ChipowerTech, post-build-variant-value=true, set at post-build, default-value=1.0E8  # The Ahb and Apb clock frequency. The expression is AhbClk=McuCpuClkFrequency/ (AhbDiv+1).
        container McuGTMClk_Configuration  # McuGTMClk Configuration
          enumeration GTMClockSource: {RCC_MODULECLOCKSOURCE_HSI, RCC_MODULECLOCKSOURCE_PERPLL, RCC_MODULECLOCKSOURCE_HSE}, origin=ChipowerTech, post-build-variant-value=true, set at post-build, default-value=RCC_MODULECLOCKSOURCE_PERPLL  # Choose the clock source of GTM.(HSI,HSE,PerPllClk/2.)
          integer GTMClockDiv: 0..31, origin=ChipowerTech, post-build-variant-value=true, set at post-build, default-value=0  # Set the GTMClockDiv coefficient of Clock. ()
          float McuGTMClkFrequency: 0.0..2.0E8, origin=ChipowerTech, post-build-variant-value=true, set at post-build, default-value=2.0E8  # The GTM clock frequency. The expression is GtmClk=GTMClockSource/(GTMClockDiv+1).
        container McuMSCClk_Configuration  # McuMSCClk Configuration
          enumeration MSCClockSource: {RCC_MODULECLOCKSOURCE_HSI, RCC_MODULECLOCKSOURCE_PERPLL, RCC_MODULECLOCKSOURCE_HSE}, origin=ChipowerTech, post-build-variant-value=true, set at post-build, default-value=RCC_MODULECLOCKSOURCE_PERPLL  # Choose the clock source of MSC(HSI,HSE,PerPllClk/2.)
        container McuESPIClk_Configuration  # McuESPIClk Configuration
          enumeration ESPIClockSource: {RCC_MODULECLOCKSOURCE_HSI, RCC_MODULECLOCKSOURCE_PERPLL, RCC_MODULECLOCKSOURCE_HSE}, origin=ChipowerTech, post-build-variant-value=true, set at post-build, default-value=RCC_MODULECLOCKSOURCE_PERPLL  # Choose the clock source of ESPI.(HSI,HSE,PerPllClk/2.)
          integer ESPIClockDiv: 0..31, origin=ChipowerTech, post-build-variant-value=true, set at post-build, default-value=0  # Set the ESPIClockDiv coefficient of Clock.( )
          float McuESPIClkFrequency: 0.0..2.0E8, origin=ChipowerTech, post-build-variant-value=true, set at post-build, default-value=2.0E8  # The ESPI clock frequency. The expression is EspiClk=ESPIClockSource/(ESPIClockDiv+1).
        container McuWDTClk_Configuration  # McuWDTClk Configuration
          enumeration CpuWDTClockSource: {RCC_MODULECLOCKSOURCE_HSI, RCC_MODULECLOCKSOURCE_PERPLL, RCC_MODULECLOCKSOURCE_HSE}, origin=ChipowerTech, post-build-variant-value=true, set at post-build, default-value=RCC_MODULECLOCKSOURCE_PERPLL  # Choose the clock source of WDT internal CPU.(HSI,HSE,PerPllClk/2.)
          integer CpuWDTClockDiv: 0..31, origin=ChipowerTech, post-build-variant-value=true, set at post-build, default-value=3  # Set the CpuWDTClockDiv coefficient of Clock.()
          float McuCPU_WDTClkFrequency: 0.0..5.0E7, origin=ChipowerTech, post-build-variant-value=true, set at post-build, default-value=5.0E7  # The CPU_WDT clock frequency. The expression is WdtClk =CpuWDTClockSource/(CpuWDTClockDiv+1).
        container McuCanClk_Configuration  # McuCanClk Configuration
          enumeration CANClockSource: {RCC_MODULECLOCKSOURCE_HSI, RCC_MODULECLOCKSOURCE_PERPLL, RCC_MODULECLOCKSOURCE_HSE}, origin=ChipowerTech, post-build-variant-value=true, set at post-build, default-value=RCC_MODULECLOCKSOURCE_PERPLL  # Choose the clock source of CAN.((HSI,HSE,PerPllClk))
          integer CANClockDiv: 0..63, origin=ChipowerTech, post-build-variant-value=true, set at post-build, default-value=4  # Set the CANClockDiv coefficient of Clock.()Note: .
          float McuCAN_PEClkFrequency: 0.0..4.0E8, origin=ChipowerTech, post-build-variant-value=true, set at post-build, default-value=4.0E8  # The CAN_PE clock frequency. The expression is CAN_PE_CLK=CANClockSource/(CANClockDiv+1).
        container McuDMAClk_Configuration  # McuDMAClk Configuration
          boolean DMA0_CLKEN: origin=ChipowerTech, post-build-variant-value=true, set at post-build, default-value=true  # This parameter specifies the clock of DMA0 is enable or not. it is as same as AXI clock
          boolean DMA{1..3}_CLKEN: origin=ChipowerTech, post-build-variant-value=true, set at post-build, default-value=true  # This parameter specifies the clock of DMA{1..3} is enable or not.it is as same as AXI clock
        container McuSarAdcClk_Configuration  # SarAdcClk Configuration
          enumeration SarAdcClockSource: {RCC_MODULECLOCKSOURCE_HSI, RCC_MODULECLOCKSOURCE_PERPLL, RCC_MODULECLOCKSOURCE_HSE}, origin=ChipowerTech, post-build-variant-value=true, set at post-build, default-value=RCC_MODULECLOCKSOURCE_PERPLL  # Choose the clock source of SarAdc.(HSI,HSE,PerPllClk/2.)
        container McuBaseTimerClk_Configuration  # McuBaseTimer Configration
          enumeration BaseTimer0ClockSource: {RCC_MODULECLOCKSOURCE_HSI, RCC_MODULECLOCKSOURCE_PERPLL, RCC_MODULECLOCKSOURCE_HSE}, origin=ChipowerTech, post-build-variant-value=true, set at post-build, default-value=RCC_MODULECLOCKSOURCE_PERPLL  # Choose the clock source of BaseTimer .(HSI,HSE,PerPllClk/2.)
          integer BaseTimer0ClockDiv: 3..65535, origin=ChipowerTech, post-build-variant-value=true, set at post-build, default-value=3  # Set the ClockDiv coefficient of BaseTimer Clock.(BaceTimerXCLK=BaseTimerXClockSource/(BaseTimerXClockDiv+1))
          float BaseTimer0Frequency: 0.0..5.0E7, origin=ChipowerTech, post-build-variant-value=true, set at post-build, default-value=5.0E7  # The BaseTimer clock frequency. The expression is BaceTimerCLK=BaseTimerClockSource/(BaseTimerClockDiv+1).
          enumeration BaseTimer1ClockSource: {RCC_MODULECLOCKSOURCE_HSI, RCC_MODULECLOCKSOURCE_PERPLL, RCC_MODULECLOCKSOURCE_HSE}, origin=ChipowerTech, post-build-variant-value=true, set at post-build, default-value=RCC_MODULECLOCKSOURCE_PERPLL  # Choose the clock source of BaseTimer .(HSI,HSE,PerPllClk/2.)
          integer BaseTimer1ClockDiv: 3..65535, origin=ChipowerTech, post-build-variant-value=true, set at post-build, default-value=3  # Set the ClockDiv coefficient of BaseTimer Clock.(BaceTimerXCLK=BaseTimerXClockSource/(BaseTimerXClockDiv+1))
          float BaseTimer1Frequency: 0.0..5.0E7, origin=ChipowerTech, post-build-variant-value=true, set at post-build, default-value=5.0E7  # The BaseTimer clock frequency. The expression is BaceTimerCLK=BaseTimerClockSource/(BaseTimerClockDiv+1).
          enumeration BaseTimer2ClockSource: {RCC_MODULECLOCKSOURCE_HSI, RCC_MODULECLOCKSOURCE_PERPLL, RCC_MODULECLOCKSOURCE_HSE}, origin=ChipowerTech, post-build-variant-value=true, set at post-build, default-value=RCC_MODULECLOCKSOURCE_PERPLL  # Choose the clock source of BaseTimer .(HSI,HSE,PerPllClk/2.)
          integer BaseTimer2ClockDiv: 3..65535, origin=ChipowerTech, post-build-variant-value=true, set at post-build, default-value=3  # Set the ClockDiv coefficient of BaseTimer Clock.(BaceTimerXCLK=BaseTimerXClockSource/(BaseTimerXClockDiv+1))
          float BaseTimer2Frequency: 0.0..5.0E7, origin=ChipowerTech, post-build-variant-value=true, set at post-build, default-value=5.0E7  # The BaseTimer clock frequency. The expression is BaceTimerCLK=BaseTimerClockSource/(BaseTimerClockDiv+1).
          enumeration BaseTimer3ClockSource: {RCC_MODULECLOCKSOURCE_HSI, RCC_MODULECLOCKSOURCE_PERPLL, RCC_MODULECLOCKSOURCE_HSE}, origin=ChipowerTech, post-build-variant-value=true, set at post-build, default-value=RCC_MODULECLOCKSOURCE_PERPLL  # Choose the clock source of BaseTimer .(HSI,HSE,PerPllClk/2.)
          integer BaseTimer3ClockDiv: 3..65535, origin=ChipowerTech, post-build-variant-value=true, set at post-build, default-value=3  # Set the ClockDiv coefficient of BaseTimer Clock.(BaceTimerXCLK=BaseTimerXClockSource/(BaseTimerXClockDiv+1))
          float BaseTimer3Frequency: 0.0..5.0E7, origin=ChipowerTech, post-build-variant-value=true, set at post-build, default-value=5.0E7  # The BaseTimer clock frequency. The expression is BaceTimerCLK=BaseTimerClockSource/(BaseTimerClockDiv+1).
          enumeration BaseTimer4ClockSource: {RCC_MODULECLOCKSOURCE_HSI, RCC_MODULECLOCKSOURCE_PERPLL, RCC_MODULECLOCKSOURCE_HSE}, origin=ChipowerTech, post-build-variant-value=true, set at post-build, default-value=RCC_MODULECLOCKSOURCE_PERPLL  # Choose the clock source of BaseTimer .(HSI,HSE,PerPllClk/2.)
          integer BaseTimer4ClockDiv: 3..65535, origin=ChipowerTech, post-build-variant-value=true, set at post-build, default-value=3  # Set the ClockDiv coefficient of BaseTimer Clock.(BaceTimerXCLK=BaseTimerXClockSource/(BaseTimerXClockDiv+1))
          float BaseTimer4Frequency: 0.0..5.0E7, origin=ChipowerTech, post-build-variant-value=true, set at post-build, default-value=5.0E7  # The BaseTimer clock frequency. The expression is BaceTimerCLK=BaseTimerClockSource/(BaseTimerClockDiv+1).
          enumeration BaseTimer5ClockSource: {RCC_MODULECLOCKSOURCE_HSI, RCC_MODULECLOCKSOURCE_PERPLL, RCC_MODULECLOCKSOURCE_HSE}, origin=ChipowerTech, post-build-variant-value=true, set at post-build, default-value=RCC_MODULECLOCKSOURCE_PERPLL  # Choose the clock source of BaseTimer .(HSI,HSE,PerPllClk/2.)
          integer BaseTimer5ClockDiv: 3..65535, origin=ChipowerTech, post-build-variant-value=true, set at post-build, default-value=3  # Set the ClockDiv coefficient of BaseTimer Clock.(BaceTimerXCLK=BaseTimerXClockSource/(BaseTimerXClockDiv+1))
          float BaseTimer5Frequency: 0.0..5.0E7, origin=ChipowerTech, post-build-variant-value=true, set at post-build, default-value=5.0E7  # The BaseTimer clock frequency. The expression is BaceTimerCLK=BaseTimerClockSource/(BaseTimerClockDiv+1).
        container Mcu_Dsadc_Rdc_Clk_Configuration  # McuDsadcClk Configuration
          enumeration ClockSource: {RCC_MODULECLOCKSOURCE_HSI, RCC_MODULECLOCKSOURCE_PERPLL, RCC_MODULECLOCKSOURCE_HSE}, origin=ChipowerTech, post-build-variant-value=true, set at post-build, default-value=RCC_MODULECLOCKSOURCE_PERPLL  # Choose the clock source of DSADC or RDC.((HSI,HSE,PerPllClk))
          integer DSADCClockDiv: 0..63, origin=ChipowerTech, post-build-variant-value=true, set at post-build, default-value=24  # Set the DSADCClockDiv coefficient of Clock.()Note: .
          float McuDSADC_ClkFrequency: 0.0..4.0E8, origin=ChipowerTech, post-build-variant-value=true, set at post-build, default-value=0.0  # The DSADC clock frequency. The expression is DSADC_CLK=ClockSource/(DSADCClockDiv+1).
          integer RDCClockDiv: 0..63, origin=ChipowerTech, post-build-variant-value=true, set at post-build, default-value=19  # Set the RDCClockDiv coefficient of Clock.()Note: .
          float McuRdc_ClkFrequency: 0.0..4.0E8, origin=ChipowerTech, post-build-variant-value=true, set at post-build, default-value=0.0  # The Rdc clock frequency. The expression is RDC_CLK=ClockSource/(RDCClockDiv+1).
        container McuClockReferencePoint [1..*]: multiplicity set at post-build, post-build-variant-multiplicity=true  # This container defines a reference point in the Mcu Clock tree. It defines the frequency which then can be used by other modules as an input value. Lower multiplicity is 1, as even in the simplest case (only one frequency is used), there is one frequency to be defined.
          enumeration McuClockReferenceSelect: {RCC_MODULECLOCKSOURCE_HSI, RCC_MODULECLOCKSOURCE_HSE, TEST_CLK, SYSPLL_REF_CLK, CPU_CLK, SYS_CLK, AXI_CLK, APB_AHB_CLK, APB_STB_CLK, ASI_CLK, STM_CLK, GTM_CLK, ESPI_CLK, WDT_CLK, CAN_CLK, MSC_CLK, BASE_TIMER0_CLK, BASE_TIMER1_CLK, BASE_TIMER2_CLK, BASE_TIMER3_CLK, BASE_TIMER4_CLK, BASE_TIMER5_CLK, SAR_ADC_CLK, DSADC_CLK, RDC_CLK}, scope=ECU, origin=ChipowerTech, post-build-variant-value=true, set at post-build, default-value=RCC_MODULECLOCKSOURCE_HSI  # This is the frequency for the specific instance of the McuClockReferencePoint container. It shall be given in Hz.
          float McuClockReferencePointFrequency: 0.0..INF, scope=ECU, post-build-variant-value=true, set at post-build, default-value=0.0  # This is the frequency for the specific instance of the McuClockReferencePoint container. It shall be given in Hz.
      container McuDemEventParameterRefs [0..1]: multiplicity set at pre-compile  # Container for the references to DemEventParameter elements which shall be invoked using the API Dem_ReportErrorStatus API in case the corresponding error occurs. The EventId is taken from the referenced DemEventParameter's DemEventId symbolic name. The standardized errors are provided in the container and can be extended by vendor specific error references.
        reference MCU_E_CLOCK_FAILURE [0..1]: multiplicity set at pre-compile, set at pre-compile, requires-symbolic-name-value=true, destination=DemEventParameter  # Reference to configured DEM event to report "Clock source failure".
      container McuModeSettingConf [1..2]: multiplicity set at pre-compile, requires-index=true  # This container contains the configuration (parameters) for the Mode setting of the MCU. Please see MCU035 for more information on the MCU mode settings.
        integer McuMode: 0..1, set at pre-compile, symbolic-name-value=true, default-value=0  # The parameter represents the MCU Mode settings. 0 : IDLE mode is selected. 1 : STANDBY mode is selected.
        container McuStdbySettingConf
          container McuStdbyWakeupSource
            boolean ESR0: origin=ChipowerTech, post-build-variant-value=true, set at post-build, default-value=false  # ESR0 as wake-up source for standby mode.
            enumeration ESR0Edge: {RISING, FALLING, RISINGFALLING}, origin=ChipowerTech, post-build-variant-value=true, set at post-build, default-value=FALLING  # Define PWRC Standby Domain wake-up pin edge for standby mode
            boolean ESR1: origin=ChipowerTech, post-build-variant-value=true, set at post-build, default-value=false  # ESR1 as wake-up source for standby mode.
            enumeration ESR1Edge: {RISING, FALLING, RISINGFALLING}, origin=ChipowerTech, post-build-variant-value=true, set at post-build, default-value=FALLING  # Define PWRC Standby Domain wake-up pin edge for standby mode
            boolean PINA: origin=ChipowerTech, post-build-variant-value=true, set at post-build, default-value=false  # PINA as wake-up source for standby mode.
            enumeration PINAEdge: {RISING, FALLING, RISINGFALLING}, origin=ChipowerTech, post-build-variant-value=true, set at post-build, default-value=FALLING  # Define PWRC Standby Domain wake-up pin edge for standby mode
            boolean PINB: origin=ChipowerTech, post-build-variant-value=true, set at post-build, default-value=false  # PINB as wake-up source for standby mode.
            enumeration PINBEdge: {RISING, FALLING, RISINGFALLING}, origin=ChipowerTech, post-build-variant-value=true, set at post-build, default-value=FALLING  # Define PWRC Standby Domain wake-up pin edge for standby mode
            boolean PORST: origin=ChipowerTech, post-build-variant-value=true, set at post-build, default-value=false  # PORST as wake-up source for standby mode.
            enumeration PORSTEdge: {RISING, FALLING, RISINGFALLING}, origin=ChipowerTech, post-build-variant-value=true, set at post-build, default-value=FALLING  # Define PWRC Standby Domain wake-up pin edge for standby mode
            boolean VEXT: origin=ChipowerTech, post-build-variant-value=true, set at post-build, default-value=false  # VEXT as wake-up source for standby mode.
            enumeration VEXTEdge: {RISING, FALLING, RISINGFALLING}, origin=ChipowerTech, post-build-variant-value=true, set at post-build, default-value=FALLING  # Define PWRC Standby Domain wake-up pin edge for standby mode
            boolean P33_00: origin=ChipowerTech, post-build-variant-value=true, set at post-build, default-value=false  # P33_00 as wake-up source for standby mode.
            enumeration P33_00Edge: {RISING, FALLING, RISINGFALLING}, origin=ChipowerTech, post-build-variant-value=true, set at post-build, default-value=FALLING  # Define PWRC Standby Domain wake-up pin edge for standby mode
            boolean P33_01: origin=ChipowerTech, post-build-variant-value=true, set at post-build, default-value=false  # P33_01 as wake-up source for standby mode.
            enumeration P33_01Edge: {RISING, FALLING, RISINGFALLING}, origin=ChipowerTech, post-build-variant-value=true, set at post-build, default-value=FALLING  # Define PWRC Standby Domain wake-up pin edge for standby mode
            boolean P33_02: origin=ChipowerTech, post-build-variant-value=true, set at post-build, default-value=false  # P33_02 as wake-up source for standby mode.
            enumeration P33_02Edge: {RISING, FALLING, RISINGFALLING}, origin=ChipowerTech, post-build-variant-value=true, set at post-build, default-value=FALLING  # Define PWRC Standby Domain wake-up pin edge for standby mode
            boolean P33_03: origin=ChipowerTech, post-build-variant-value=true, set at post-build, default-value=false  # P33_03 as wake-up source for standby mode.
            enumeration P33_03Edge: {RISING, FALLING, RISINGFALLING}, origin=ChipowerTech, post-build-variant-value=true, set at post-build, default-value=FALLING  # Define PWRC Standby Domain wake-up pin edge for standby mode
            boolean P33_04: origin=ChipowerTech, post-build-variant-value=true, set at post-build, default-value=false  # P33_04 as wake-up source for standby mode.
            enumeration P33_04Edge: {RISING, FALLING, RISINGFALLING}, origin=ChipowerTech, post-build-variant-value=true, set at post-build, default-value=FALLING  # Define PWRC Standby Domain wake-up pin edge for standby mode
            boolean P33_05: origin=ChipowerTech, post-build-variant-value=true, set at post-build, default-value=false  # P33_05 as wake-up source for standby mode.
            enumeration P33_05Edge: {RISING, FALLING, RISINGFALLING}, origin=ChipowerTech, post-build-variant-value=true, set at post-build, default-value=FALLING  # Define PWRC Standby Domain wake-up pin edge for standby mode
            boolean P33_06: origin=ChipowerTech, post-build-variant-value=true, set at post-build, default-value=false  # P33_06 as wake-up source for standby mode.
            enumeration P33_06Edge: {RISING, FALLING, RISINGFALLING}, origin=ChipowerTech, post-build-variant-value=true, set at post-build, default-value=FALLING  # Define PWRC Standby Domain wake-up pin edge for standby mode
            boolean P33_07: origin=ChipowerTech, post-build-variant-value=true, set at post-build, default-value=false  # P33_07 as wake-up source for standby mode.
            enumeration P33_07Edge: {RISING, FALLING, RISINGFALLING}, origin=ChipowerTech, post-build-variant-value=true, set at post-build, default-value=FALLING  # Define PWRC Standby Domain wake-up pin edge for standby mode
            boolean P33_08: origin=ChipowerTech, post-build-variant-value=true, set at post-build, default-value=false  # P33_08 as wake-up source for standby mode.
            enumeration P33_08Edge: {RISING, FALLING, RISINGFALLING}, origin=ChipowerTech, post-build-variant-value=true, set at post-build, default-value=FALLING  # Define PWRC Standby Domain wake-up pin edge for standby mode
            boolean P33_09: origin=ChipowerTech, post-build-variant-value=true, set at post-build, default-value=false  # P33_09 as wake-up source for standby mode.
            enumeration P33_09Edge: {RISING, FALLING, RISINGFALLING}, origin=ChipowerTech, post-build-variant-value=true, set at post-build, default-value=FALLING  # Define PWRC Standby Domain wake-up pin edge for standby mode
            boolean P33_10: origin=ChipowerTech, post-build-variant-value=true, set at post-build, default-value=false  # P33_10 as wake-up source for standby mode.
            enumeration P33_10Edge: {RISING, FALLING, RISINGFALLING}, origin=ChipowerTech, post-build-variant-value=true, set at post-build, default-value=FALLING  # Define PWRC Standby Domain wake-up pin edge for standby mode
            boolean P33_11: origin=ChipowerTech, post-build-variant-value=true, set at post-build, default-value=false  # P33_11 as wake-up source for standby mode.
            enumeration P33_11Edge: {RISING, FALLING, RISINGFALLING}, origin=ChipowerTech, post-build-variant-value=true, set at post-build, default-value=FALLING  # Define PWRC Standby Domain wake-up pin edge for standby mode
            boolean P33_13: origin=ChipowerTech, post-build-variant-value=true, set at post-build, default-value=false  # P33_13 as wake-up source for standby mode.
            enumeration P33_13Edge: {RISING, FALLING, RISINGFALLING}, origin=ChipowerTech, post-build-variant-value=true, set at post-build, default-value=FALLING  # Define PWRC Standby Domain wake-up pin edge for standby mode
            boolean P33_14: origin=ChipowerTech, post-build-variant-value=true, set at post-build, default-value=false  # P33_14 as wake-up source for standby mode.
            enumeration P33_14Edge: {RISING, FALLING, RISINGFALLING}, origin=ChipowerTech, post-build-variant-value=true, set at post-build, default-value=FALLING  # Define PWRC Standby Domain wake-up pin edge for standby mode
            boolean P33_15: origin=ChipowerTech, post-build-variant-value=true, set at post-build, default-value=false  # P33_15 as wake-up source for standby mode.
            enumeration P33_15Edge: {RISING, FALLING, RISINGFALLING}, origin=ChipowerTech, post-build-variant-value=true, set at post-build, default-value=FALLING  # Define PWRC Standby Domain wake-up pin edge for standby mode
            boolean P34_01: origin=ChipowerTech, post-build-variant-value=true, set at post-build, default-value=false  # P34_01 as wake-up source for standby mode.
            enumeration P34_01Edge: {RISING, FALLING, RISINGFALLING}, origin=ChipowerTech, post-build-variant-value=true, set at post-build, default-value=FALLING  # Define PWRC Standby Domain wake-up pin edge for standby mode
            boolean P34_02: origin=ChipowerTech, post-build-variant-value=true, set at post-build, default-value=false  # P34_02 as wake-up source for standby mode.
            enumeration P34_02Edge: {RISING, FALLING, RISINGFALLING}, origin=ChipowerTech, post-build-variant-value=true, set at post-build, default-value=FALLING  # Define PWRC Standby Domain wake-up pin edge for standby mode
            boolean P34_03: origin=ChipowerTech, post-build-variant-value=true, set at post-build, default-value=false  # P34_03 as wake-up source for standby mode.
            enumeration P34_03Edge: {RISING, FALLING, RISINGFALLING}, origin=ChipowerTech, post-build-variant-value=true, set at post-build, default-value=FALLING  # Define PWRC Standby Domain wake-up pin edge for standby mode
            boolean P34_04: origin=ChipowerTech, post-build-variant-value=true, set at post-build, default-value=false  # P34_04 as wake-up source for standby mode.
            enumeration P34_04Edge: {RISING, FALLING, RISINGFALLING}, origin=ChipowerTech, post-build-variant-value=true, set at post-build, default-value=FALLING  # Define PWRC Standby Domain wake-up pin edge for standby mode
            boolean P34_05: origin=ChipowerTech, post-build-variant-value=true, set at post-build, default-value=false  # P34_05 as wake-up source for standby mode.
            enumeration P34_05Edge: {RISING, FALLING, RISINGFALLING}, origin=ChipowerTech, post-build-variant-value=true, set at post-build, default-value=FALLING  # Define PWRC Standby Domain wake-up pin edge for standby mode
      container McuRamSectorSettingConf [0..*]: multiplicity set at pre-compile  # This container contains the configuration (parameters) for the RAM Sector setting. Please see MCU030 for more information on RAM sec-tor settings.
        integer McuRamDefaultValue: 0..255, post-build-variant-value=true, set at post-build, default-value=0  # This parameter shall represent the Data pre-setting to be initialized
        integer McuRamSectionBaseAddress: 0..4294967295, post-build-variant-value=true, set at post-build, default-value=2097152  # This parameter shall represent the MCU RAM section base address. This address requires 16 byte alignment
        integer McuRamSectionSize: 4..4294967295, post-build-variant-value=true, set at post-build, default-value=8192  # This parameter represents the MCU RAM Section size in bytes.
        integer McuRamSectionWriteSize: 0..4294967295, post-build-variant-value=true, set at post-build, default-value=8  # This parameter shall define the size in bytes of data which can be written into RAM at once.
    container McuPublishedInformation  # Container holding all MCU specific published information parameters
      container McuResetReasonConf [14..14]: multiplicity set at pre-compile, requires-index=true  # This container contains the configuration for the different type of reset reason that can be retrieved from Mcu_GetResetReason Api.
        integer McuResetReason: 0..255, scope=ECU, set at published-information, symbolic-name-value=true, default-value=0  # The parameter represents the different type of reset that a Micro supports. This parameter is referenced by the parameter EcuMResetReason in the ECU State manager module.
