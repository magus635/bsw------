AUTOSAR XML (schema 00046)
package /THA6_AS440_FuSa
  ecuc definition collection Pwm_EcuParameterDefinition: module=Pwm
  module definition Pwm [0..*]: post-build-variant-support=true, refined-module-def=Pwm, variants post-build  # Configuration of Pwm (Pulse Width Modulation) module.
    container PwmChannelConfigSet  # This container contains the configuration parameters and sub containers of the AUTOSAR Pwm module.
      container PwmChannel [1..144]: multiplicity set at pre-compile, requires-index=true  # Configuration of an individual PWM channel.
        enumeration PwmChannelClass [0..1]: {PWM_FIXED_PERIOD, PWM_VARIABLE_PERIOD, PWM_FIXED_PERIOD_SHIFTED, PWM_FIXED_PERIOD_CENTER_ALIGNED}, multiplicity set at post-build, post-build-variant-multiplicity=true, post-build-variant-value=true, set at post-build, default-value=PWM_FIXED_PERIOD  # Class of PWM Channel.
        integer PwmChannelId: 0..143, set at pre-compile, symbolic-name-value=true, default-value=1  # Channel Id of the PWM channel. This value will be assigned to the symbolic name derived of the PwmChannel container short name.
        integer PwmDutycycleDefault: 0..16777215, post-build-variant-value=true, set at post-build, default-value=0  # Value of duty cycle used for Initialization Depends on PwmDutyShiftInTicks parameter. When the PwmDutyShiftInTicks is OFF, the Dutycyle should be entered as percentage: 0, represents 0% 0x8000 represents 100% When the PwmDutyShiftInTicks is ON, the Dutycyle should be entered as absolute ticks: 0, represents 0% Same value as Period value represents 100%
        enumeration PwmIdleState: {PWM_HIGH, PWM_LOW}, post-build-variant-value=true, set at post-build, default-value=PWM_HIGH  # The parameter PWM_IDLE_STATE represents the output state of the PWM after the signal is stopped (e.g. call of Pwm_SetOutputToIdle).
        function name PwmNotification [0..1]: multiplicity set at post-build, post-build-variant-multiplicity=true, post-build-variant-value=true, set at post-build, default-value=Pwm_Notification_0  # Definition of the Callback function.
        float PwmPeriodDefault: 0.0..65535.0, post-build-variant-value=true, set at post-build, default-value=0.0  # Value of period used for Initialization.(in seconds).This parameter does not impact the channels of class PWM_FIXED_PERIOD_SHIFTED and PWM_FIXED_PERIOD_CENTER_ALIGNED
        enumeration PwmPolarity: {PWM_HIGH, PWM_LOW}, post-build-variant-value=true, set at post-build, default-value=PWM_LOW  # Defines the starting polarity of each PWM channel.
        enumeration PwmClockSrc: {CMU_FXCLK0, CMU_FXCLK1, CMU_FXCLK2, CMU_FXCLK3, CMU_FXCLK4}, origin=ChipowerTech, post-build-variant-value=true, set at post-build, default-value=CMU_FXCLK0  # CMU Clock source select for each PWM channel based on GTM-TOM. For ATOM channel the clock source are only determinated by PwmMcuClockReference For TOM channel the available clock sources are CMU_FXCLK0 (CMU_FXCLK) CMU_FXCLK1 (CMU_FXCLK/16) CMU_FXCLK2 (CMU_FXCLK/256) CMU_FXCLK3 (CMU_FXCLK/4096) CMU_FXCLK4 (CMU_FXCLK/65536)
        integer PwmShiftValue: 1..16777215, origin=ChipowerTech, post-build-variant-value=true, set at post-build, default-value=1  # Shift Value for PWM_FIXED_PERIOD_SHIFTED Signal. Valid only when PwmChannelClass is PWM_FIXED_PERIOD_SHIFTED. This depends on PwmDutyShiftInTicks parameter. When the PwmDutyShiftInTicks is OFF, the Shift value should be entered as percentage: 0, represents 0% 0x8000 represents 100% When the PwmDutyShiftInTicks is ON, the Shift value should be entered as absolute ticks: 0, represents 0% Same value as Period value represents 100%
        boolean PwmCoherentUpdate: origin=ChipowerTech, post-build-variant-value=true, set at post-build, default-value=false  # This parameter intend to determine channel is coherent or not.
        choice reference PwmChannelSelection: scope=ECU, origin=ChipowerTech, post-build-variant-value=true, set at post-build, destination=[GtmAtomChannel, GtmTomChannel]  # This parameter lists all the GTM timer channels (TOM/ATOM).
        reference PwmMcuClockReferencePoint: post-build-variant-value=true, set at post-build, destination=CmuClockReferencePoint  # This parameter defines PWM module clock source This parameter is reference from MCU GTM Cmu clock, configure clock first in MCU Container
        reference PwmReferenceChannel [0..1]: multiplicity set at post-build, origin=ChipowerTech, post-build-variant-value=true, set at post-build, destination=PwmChannel  # Reference channel for PWM_FIXED_PERIOD_SHIFTED, and PWM_FIXED_PERIOD_CENTER_ALIGNED. Reference should be a channel of PWM_FIXED_PERIOD Only.
        reference PwmChannelEcucPartitionRef [0..*]: scope=ECU, multiplicity set at pre-compile, post-build-variant-multiplicity=true, post-build-variant-value=true, set at pre-compile, destination=EcucPartition  # Maps a PWM channel to zero or multiple ECUC partitions to limit the access to this channe. The ECUC partitions referenced are a subset of the ECUC partitions where the PWM driver is mapped to. Tags: atp.Status=draft
    container PwmConfigurationOfOptApiServices  # This parameter group contains the optional API services for PWM.
      boolean PwmDeInitApi: set at pre-compile, default-value=false  # Adds / removes the service Pwm_DeInit() from the code.
      boolean PwmGetOutputState: set at pre-compile, default-value=false  # Adds / removes the service Pwm_GetOutputState() from the code.
      boolean PwmSetDutyCycle: set at pre-compile, default-value=false  # Adds / removes the service Pwm_SetDutyCycle() from the code.
      boolean PwmSetOutputToIdle: set at pre-compile, default-value=false  # Adds / removes the service Pwm_SetOutputToIdle() from the code.
      boolean PwmSetPeriodAndDuty: set at pre-compile, default-value=false  # Adds / removes the service Pwm_SetPeriodAndDuty() from the code.
      boolean PwmVersionInfoApi: set at pre-compile, default-value=false  # Switch to indicate that the Pwm_ GetVersionInfo is supported
    container PwmGeneral  # General settings for the PWM driver.
      boolean PwmDevErrorDetect: set at pre-compile, default-value=false  # Switches the Default Error Tracer (Det) detection and notification ON or OFF.
      boolean PwmSafetyErrorDetect: origin=ChipowerTech, set at pre-compile, default-value=true  # Switches the Safety Error detection ON or OFF.
      boolean PwmDutycycleUpdatedEndperiod: set at pre-compile, default-value=true  # Switch for enabling the update of the duty cycle parameter at the end of the current period.
      integer PwmIndex: 0..0, set at pre-compile, default-value=0  # Specifies the InstanceId of this module instance. If only one instance is present it shall have the Id 0.
      boolean PwmLowPowerStatesSupport [0..1]: multiplicity set at pre-compile, set at pre-compile, default-value=false  # Adds / removes all power state management related APIs (PWM_SetPowerState, PWM_GetCurrentPowerState, PWM_GetTargetPowerState, PWM_PreparePowerState, PWM_Main_PowerTransitionManager), indicating if the HW offers low power state management.
      boolean PwmNotificationSupported: set at pre-compile, default-value=false  # Switch to indicate that the notifications are supported
      boolean PwmChannelCoherentSelection: origin=ChipowerTech, set at pre-compile, default-value=false  # Switch for enabling the update of the period / duty parameter at the end of the current period. Switching on this parameter obsoletes PwmDutycycleUpdatedEndperiod and PwmPeriodUpdatedEndperiod.
      boolean PwmHandleShiftByOffset: origin=ChipowerTech, set at pre-compile, default-value=false  # Switch for enabling Speacial handling for shifted channels.
      boolean PwmEnable0Or100DutyHandle: origin=ChipowerTech, set at pre-compile, default-value=false  # Switch for enabling Special handling for interrupt, in the case of a duty cycle of 0% or 100%, or the period is 0.
      boolean PwmDutyShiftInTicks: origin=ChipowerTech, set at pre-compile, default-value=false  # Switch for Pwm Duty Cycle type: Disabled - Duty Cycle and Shift value in percentage. Enabled - Duty Cycle and Shift value in timer ticks. User has to take care of entering the right values for PwmDutycycleDefault and PwmShiftValue based on this selection.
      boolean PwmPeriodUpdatedEndperiod: set at pre-compile, default-value=true  # Switch for enabling the update of the period parameter at the end of the current period.PWM_FIXED_PERIOD, PWM_FIXED_PERIOD_SHIFTED and PWM_FIXED_PERIOD_CENTER_ALIGNED channel class will not get affected with this parameter setting.
      boolean PwmPowerStateAsynchTransitionMode [0..1]: multiplicity set at pre-compile, set at pre-compile, default-value=false  # Enables / disables support of the PWM Driver to the asynchronous power state transition.
      boolean PwmRefChannelOutputAhead: origin=ChipowerTech, set at pre-compile, default-value=false  # Enable to output the reference channel to strictly ahead of the phase-shifting channel or the center-aligned channel
      reference PwmEcucPartitionRef [0..*]: scope=ECU, multiplicity set at pre-compile, post-build-variant-multiplicity=true, post-build-variant-value=true, set at pre-compile, destination=EcucPartition  # Maps the PWM driver to zero or multiple ECUC partitions to make the driver API available in the according partition. Tags: atp.Status=draft
      reference PwmKernelEcucPartitionRef [0..1]: scope=ECU, multiplicity set at pre-compile, post-build-variant-multiplicity=true, post-build-variant-value=true, set at pre-compile, destination=EcucPartition  # Maps the PWM kernel to zero or one ECUC partitions to assign the driver kernel to a certain core. The ECUC partition referenced is a subset of the ECUC partitions where the PWM driver is mapped to. Tags: atp.Status=draft
      container PwmPowerStateConfig [0..*]: multiplicity set at pre-compile, requires-index=true  # Each instance of this parameter defines a power state and the callback to be called when this power state is reached.
        integer PwmPowerState: 0..9223372036854775807, set at pre-compile, symbolic-name-value=true, default-value=0  # Each instance of this parameter describes a different power state supported by the PWM HW. It should be defined by the HW supplier and used by the PWMDriver to reference specific HW configurations which set the PWM HW module in the referenced power state.
        function name PwmPowerStateReadyCbkRef: set at pre-compile, default-value=PwmPowerStateCbk  # Each instance of this parameter contains a reference to a power mode callback defined in a CDD or IoHwAbs component.
    container CommonPublishedInformation  # Common container, aggregated by all modules. It contains published information about vendor and versions.
      integer ArReleaseMajorVersion: 4..4, origin=ChipowerTech, set at published-information, default-value=4  # Major version number of AUTOSAR specification on which the appropriate implementation is based on.
      integer ArReleaseMinorVersion: 2..4, origin=ChipowerTech, set at published-information, default-value=4  # Minor version number of AUTOSAR specification on which the appropriate implementation is based on.
      integer ArReleaseRevisionVersion: 0..2, origin=ChipowerTech, set at published-information, default-value=0  # Revision version number of AUTOSAR specification on which the appropriate implementation is based on.
      integer ModuleId: 121..121, origin=ChipowerTech, set at published-information, default-value=121  # Module ID of this module from Module List. Note: Implementation Specific Parameter
      integer SwMajorVersion: 0..255, origin=ChipowerTech, set at published-information, default-value=1  # Major version number of the vendor specific implementation of the module. The numbering is vendor specific. Note: Implementation Specific Parameter
      integer SwMinorVersion: 0..255, origin=ChipowerTech, set at published-information, default-value=2  # Minor version number of the vendor specific implementation of the module. The numbering is vendor specific. Note: Implementation Specific Parameter
      integer SwPatchVersion: 0..255, origin=ChipowerTech, set at published-information, default-value=0  # Patch level version number of the vendor specific implementation of the module. The numbering is vendor specific. Note: Implementation Specific Parameter
      integer VendorId: 175..175, origin=ChipowerTech, set at published-information, default-value=175  # Vendor ID of the dedicated implementation of this module according to the AUTOSAR vendor list. Note: Implementation Specific Parameter
