AUTOSAR XML (schema 00046)
package /THA6_AS440_FuSa
  ecuc definition collection Resource_EcuParameterDefinition: module=Resource
  module definition Resource [0..*]: variants pre-compile  # Configuration of Resource module.
    container ResourceGeneral  # Resource General config. container.
      enumeration ResourceSubderivative: {THA610X_LFBGA180, THA6206_LFBGA292, THA6412_BGA516}, origin=ChipowerTech, set at pre-compile, default-value=THA6206_LFBGA292  # Sub-derivative selector for the current platform.
    container ResourceCoreConfigSet  # This container contains the configuration parameters and sub containers of the AUTOSAR Resource module.
      enumeration ResourceMasterCore: {CORE0, CORE1}, origin=ChipowerTech, set at pre-compile, default-value=CORE0  # Master core is default core0. If a configured MCAL resource is not allocated to a core, it will default to master core. Note The master core is the safety core and also the boot core(which needs to be configured by the user in the UCB). Users should configure the master core to be the same as the safety core (as well as the boot core).
      container ResourceCoreConfig [1..4]: multiplicity set at pre-compile, requires-index=true  # General container to allocate Mcal resources to cores
        enumeration ResourceCoreId: {CORE0, CORE1, CORE2, CORE3}, origin=ChipowerTech, set at pre-compile, default-value=CORE0  # Select the core to allocation the mudule resource.
        boolean ResourceCoreEnable: origin=ChipowerTech, set at pre-compile, default-value=true  # Enable/Disable the core mapping resource allocation. false - disable true - enable
        container ResourceAllocation [0..*]: multiplicity set at pre-compile, requires-index=true  # Container to allocate module resources to this core.
          enumeration ResourceModule: {ADC, PWM, GPT, CAN, SPI, ETH, LIN, ICU, OCU, UART, MSC, DMA, IOM, SENT, DSADC, I2C}, origin=ChipowerTech, set at pre-compile, default-value=SPI  # The module that need to be allocated to this core.
          choice reference ResourceModuleRef: scope=ECU, origin=ChipowerTech, set at pre-compile, destination=[GptChannelConfiguration, PwmChannel, IcuChannel, CanController, AdcHwUnit, OcuChannel, EthCtrlConfig, LinChannel, SpiHwUnitConfig, UartChannel, MscModuleConfiguration, DmaChannel, DsadcChannel, SentChannelConfigSet, I2cChannel, Iom]  # This parameter contains reference to resource. Only one Iom HW unit in the MCU, so not need to allocate resource.
    container CommonPublishedInformation  # Common container, aggregated by all modules. It contains published information about vendor and versions.
      integer ArReleaseMajorVersion: 4..4, origin=ChipowerTech, set at published-information, default-value=4  # Major version number of AUTOSAR specification on which the appropriate implementation is based on.
      integer ArReleaseMinorVersion: 0..255, origin=ChipowerTech, set at published-information, default-value=4  # Minor version number of AUTOSAR specification on which the appropriate implementation is based on.
      integer ArReleaseRevisionVersion: 0..255, origin=ChipowerTech, set at published-information, default-value=0  # Revision version number of AUTOSAR specification on which the appropriate implementation is based on.
      integer ModuleId: 0..255, origin=ChipowerTech, set at published-information, default-value=255  # Module ID of this module from Module List.
      integer SwMajorVersion: 0..255, origin=ChipowerTech, set at published-information, default-value=1  # Major version number of the vendor specific implementation of the module. The numbering is vendor specific.
      integer SwMinorVersion: 0..255, origin=ChipowerTech, set at published-information, default-value=2  # Minor version number of the vendor specific implementation of the module. The numbering is vendor specific.
      integer SwPatchVersion: 0..255, origin=ChipowerTech, set at published-information, default-value=0  # Patch level version number of the vendor specific implementation of the module. The numbering is vendor specific.
      integer VendorId: 0..255, origin=ChipowerTech, set at published-information, default-value=175  # Vendor ID of the dedicated implementation of this module according to the AUTOSAR vendor list.
