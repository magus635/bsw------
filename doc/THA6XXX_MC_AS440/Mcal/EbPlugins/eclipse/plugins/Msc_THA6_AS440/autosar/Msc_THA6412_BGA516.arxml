AUTOSAR XML (schema 00046)
package /THA6_AS440_FuSa
  ecuc definition collection Msc_EcuParameterDefinition: module=Msc
  module definition Msc [0..1]: post-build-variant-support=true, variants post-build  # Configuration of the Msc module.
    container MscConfigSet  # Module Configuration of MSC Driver
      container MscModuleConfiguration [1..3]: multiplicity set at post-build, requires-index=true  # Module Configuration of MSC Driver
        enumeration MscHWUnitMapping: {Msc_0, Msc_1, Msc_2}, origin=ChipowerTech, post-build-variant-value=true, set at post-build, default-value=Msc_0  # This parameter is the symbolic name to identify the HW MSC Hardware microcontroller peripheral.
        container MscClockConfiguration  # Clock Configuration MSC Driver
          integer MscSerialOutputFrequency: 0..50000000, origin=ChipowerTech, post-build-variant-value=true, set at post-build, default-value=30000000  # Specifies the MSC serial clock frequency of downstream transmit. Unit: Hz
          enumeration MscUpstreamDivider: {MSC_UPDIV_4, MSC_UPDIV_8, MSC_UPDIV_16, MSC_UPDIV_32, MSC_UPDIV_64, MSC_UPDIV_128}, origin=ChipowerTech, post-build-variant-value=true, set at post-build, default-value=MSC_UPDIV_4  # Divider Value for upstream: MSC_UPDIV_4: MscSerialOutputFrequency / 4 MSC_UPDIV_8: MscSerialOutputFrequency / 8 MSC_UPDIV_16: MscSerialOutputFrequency / 16 MSC_UPDIV_32: MscSerialOutputFrequency / 32 MSC_UPDIV_64: MscSerialOutputFrequency / 64 MSC_UPDIV_128: MscSerialOutputFrequency / 128
          enumeration MscClockDividerMode: {MSC_DIVMODE_NORMAL, MSC_DIVMODE_FRACTIONAL}, origin=ChipowerTech, post-build-variant-value=true, set at post-build, default-value=MSC_DIVMODE_NORMAL  # Divider Mode for MSC Clock: MSC_DIVMODE_NORMAL:Integer divider MSC_DIVMODE_FRACTIONAL:Fractional divider
        container MscTxConfiguration  # This container contains the configuration for receiver and transmitter.
          enumeration MscDataFrameTxMode: {MSC_TRANSMODE_TRIGGERED, MSC_TRANSMODE_DATAREPETITION}, origin=ChipowerTech, post-build-variant-value=true, set at post-build, default-value=MSC_TRANSMODE_TRIGGERED  # Selects the mode for transmission of data frames MSC_TRANSMODE_TRIGGERED: Send data by trigger signal(Software trigger) MSC_TRANSMODE_DATAREPETITION: Send data automatic by hardware feature
          integer MscPassiveTimeFrameNumber: 0..15, origin=ChipowerTech, post-build-variant-value=true, set at post-build, default-value=0  # The number of passive frame between data/cmd frame in repetition transmit mode
          enumeration MscCDCMode: {MSC_CDCMODE_DISABLED, MSC_CDCMODE_ENABLED}, origin=ChipowerTech, post-build-variant-value=true, set at post-build, default-value=MSC_CDCMODE_ENABLED  # In repetition transmit mode, select whether to insert one command frame between data frames
          container MscTxSignalTypeConfiguration  # Tx Signal polarity Configuration, it is determined by the specific slave device
            enumeration MscTxClockSignalType: {MSC_FCLLINEPOLARITY_INVERTED, MSC_FCLLINEPOLARITY_NONINVERTED}, origin=ChipowerTech, post-build-variant-value=true, set at post-build, default-value=MSC_FCLLINEPOLARITY_NONINVERTED  # This parameter determines the polarity of the transmitted clock signal of the MSC transmitter
            enumeration MscTxDataSignalType: {MSC_SIGNALPOLARITY_INVERTED, MSC_SIGNALPOLARITY_NONINVERTED}, origin=ChipowerTech, post-build-variant-value=true, set at post-build, default-value=MSC_SIGNALPOLARITY_NONINVERTED  # This parameter determines the polarity of the transmitted data signal of the MSC transmitter
            enumeration MscTxChipSelectSignalType: {MSC_SIGNALPOLARITY_NONINVERTED, MSC_SIGNALPOLARITY_INVERTED}, origin=ChipowerTech, post-build-variant-value=true, set at post-build, default-value=MSC_SIGNALPOLARITY_NONINVERTED  # This parameter determines the polarity of the transmitted Enable (chipselect) signal of the MSC transmitter
            enumeration MscActivateClock: {MSC_FCLVALID_ALWAYS, MSC_FCLVALID_ACTIVE_PHASE_ONLY}, origin=ChipowerTech, post-build-variant-value=true, set at post-build, default-value=MSC_FCLVALID_ALWAYS  # Specifies activate clock control mode.
          container MscCmdFrameConfiguration  # This container contains the settings for transmission of command frames
            integer MscCmdFrameLen: 1..31, origin=ChipowerTech, post-build-variant-value=true, set at post-build, default-value=16  # Specifies the number of bits to be transmitted of the Command frame
            integer MscCmdPassivePhaseLen: 2..65, origin=ChipowerTech, post-build-variant-value=true, set at post-build, default-value=2  # Specifies the length of passive phase of command frame, passive time frame transmission
            enumeration MscCmdFrameIntService [0..1]: {MSC_INTRNODE_SR0, MSC_INTRNODE_SR1, MSC_INTRNODE_SR2, MSC_INTRNODE_SR3}, multiplicity set at post-build, origin=ChipowerTech, post-build-variant-value=true, set at post-build, default-value=MSC_INTRNODE_SR0  # Configuration parameters of interrupt service for Command Frame
            function name MscCmdFrameNotification: origin=ChipowerTech, post-build-variant-value=true, set at post-build, default-value=Msc0_CmdFrameNotification  # Specifies the notification function of Command Frame Interrupt
          container MscTimeFrameConfiguration  # This containner includes timeFrame interrupt configuration.
            enumeration MscTimeFrameIntService [0..1]: {MSC_INTRNODE_SR0, MSC_INTRNODE_SR1, MSC_INTRNODE_SR2, MSC_INTRNODE_SR3}, multiplicity set at post-build, origin=ChipowerTech, post-build-variant-value=true, set at post-build, default-value=MSC_INTRNODE_SR0  # Configuration parameters of interrupt service for time frame
            function name MscTimeFrameNotification: origin=ChipowerTech, post-build-variant-value=true, set at post-build, default-value=Msc0_TimeFrameNotification  # Specifies the notification function of time frame interrupt
          container MscDataFrameConfiguration  # This container contains the settings for transmission of data frames
            enumeration MscSelectionBitHighEnable: {MSC_SELBIT_LOWLEVEL, MSC_SELBIT_NONE}, origin=ChipowerTech, post-build-variant-value=true, set at post-build, default-value=MSC_SELBIT_LOWLEVEL  # This parameter is decided to insert a low-bit or not to the start of the srh phase of data frame
            enumeration MscSelectionBitLowEnable: {MSC_SELBIT_LOWLEVEL, MSC_SELBIT_NONE}, origin=ChipowerTech, post-build-variant-value=true, set at post-build, default-value=MSC_SELBIT_LOWLEVEL  # This parameter is decided to insert a low-bit or not to the start of the srl phase of data frame
            integer MscPassivePhaseLen: 2..33, origin=ChipowerTech, post-build-variant-value=true, set at post-build, default-value=4  # Specifies the length of passive phase of data frame
            integer MscDataFrameSrlLen: 0..16, origin=ChipowerTech, post-build-variant-value=true, set at post-build, default-value=0  # Specifies the number of bits to be transmitted in the data frame srl phase.
            integer MscDataFrameSrhLen: 0..16, origin=ChipowerTech, post-build-variant-value=true, set at post-build, default-value=0  # Specifies the number of bits to be transmitted in the data frame srh phase.
            enumeration MscDataFrameIntService [0..1]: {MSC_INTRNODE_SR0, MSC_INTRNODE_SR1, MSC_INTRNODE_SR2, MSC_INTRNODE_SR3}, multiplicity set at post-build, origin=ChipowerTech, post-build-variant-value=true, set at post-build, default-value=MSC_INTRNODE_SR0  # Selects the service request to be raised when a data frame interrupt is triggered
            enumeration MscDataFrameIntType: {MSC_DFINTERRUPT_LASTBIT, MSC_DFINTERRUPT_FIRSTBIT}, origin=ChipowerTech, post-build-variant-value=true, set at post-build, default-value=MSC_DFINTERRUPT_LASTBIT  # Selects the interrupt type of data frame
            function name MscDataFrameNotification: origin=ChipowerTech, post-build-variant-value=true, set at post-build, default-value=Msc0_DataFrameNotification  # Specifies the application define function name, that will called on Data Frame Interrupt
            container MscDataBitLowConfiguration [0..16]: multiplicity set at post-build, requires-index=true  # Container for Low Data Bits Configuration
              integer MscDataBitIndex: 0..31, origin=ChipowerTech, post-build-variant-value=true, set at post-build, default-value=0  # This parameter identifies the data bit of the data frame using an index. This index is used for further configuration of the data bit source,emergency stop behaviour
              enumeration MscDataBitSrc: {SRC_DOWNSTREAMDATA, SRC_GTMSIGNAL, SRC_GTMSIGNAL_INVERTED}, origin=ChipowerTech, post-build-variant-value=true, set at post-build, default-value=SRC_DOWNSTREAMDATA  # This parameter selects the data source for the data bit indexed by MscDataBitIndex
            container MscDataBitHighConfiguration [0..16]: multiplicity set at post-build, requires-index=true  # Container for High Data Bits Configuration
              integer MscDataBitIndex: 0..31, origin=ChipowerTech, post-build-variant-value=true, set at post-build, default-value=0  # This parameter identifies the data bit of the data frame using an index. This index is used for further configuration of the data bit source,emergency stop behaviour
              enumeration MscDataBitSrc: {SRC_DOWNSTREAMDATA, SRC_GTMSIGNAL, SRC_GTMSIGNAL_INVERTED}, origin=ChipowerTech, post-build-variant-value=true, set at post-build, default-value=SRC_DOWNSTREAMDATA  # This parameter selects the data source for the data bit indexed by MscDataBitIndex
          container MscPinInjectConfiguration  # This container contains the settings for external pin injection
            integer MscPin0InjectionPos [0..1]: 0..31, multiplicity set at post-build, origin=ChipowerTech, post-build-variant-value=true, set at post-build, default-value=0  # (Configure the injection position of Pin0(P0.0))
            integer MscPin1InjectionPos [0..1]: 0..31, multiplicity set at post-build, origin=ChipowerTech, post-build-variant-value=true, set at post-build, default-value=0  # Configure the injection position of Pin1(P10.5)
        container MscRxConfiguration  # This container contains the configuration parameters required to configure the MSC receiver (upstream channel)
          enumeration MscRxFrameType: {MSC_FRAMETYPE_12BIT, MSC_FRAMETYPE_16BIT}, origin=ChipowerTech, post-build-variant-value=true, set at post-build, default-value=MSC_FRAMETYPE_12BIT  # Defines if the Address field is present/absent in the frames to be received
          enumeration MscRxParityType: {MSC_PARITY_ODD, MSC_PARITY_EVEN}, origin=ChipowerTech, post-build-variant-value=true, set at post-build, default-value=MSC_PARITY_EVEN  # Selects parity type used in Rx frames
          enumeration MscRxFrameIntService [0..1]: {MSC_INTRNODE_SR0, MSC_INTRNODE_SR1, MSC_INTRNODE_SR2, MSC_INTRNODE_SR3}, multiplicity set at post-build, origin=ChipowerTech, post-build-variant-value=true, set at post-build, default-value=MSC_INTRNODE_SR0  # Selects the service request to be raised when a data frame interrupt is triggered.
          enumeration MscRxFrameIntType: {MSC_RDITYPE_RECEIVE, MSC_RDITYPE_RDIESET, MSC_RDITYPE_RECEIVEINUD3}, origin=ChipowerTech, post-build-variant-value=true, set at post-build, default-value=MSC_RDITYPE_RECEIVE  # Selects the interrupt type of receive data MSC_RDITYPE_RECEIVE: Interrupt is generated when data received MSC_RDITYPE_RDIESET: Interrupt is generated when data received and the data is not equal to 0x00 MSC_RDITYPE_RECEIVEINUD3: Interrupt is generated when data received in UD3 register
          enumeration MscRxIntDelayEnabled: {MSC_REQDELAY_NODELAY, MSC_REQDELAY_1BIT}, origin=ChipowerTech, post-build-variant-value=true, set at post-build, default-value=MSC_REQDELAY_NODELAY  # Enable/Disable a delay of one bit dealy for receive data interrupt generated by Hardware
          function name MscRxFrameNotification: origin=ChipowerTech, post-build-variant-value=true, set at post-build, default-value=Msc0_RxNotification  # Specifies the notification function of receive data interrupt
          container MscRxSignalTypeConfiguration  # Rx Signal polarity Configuration, it is determined by the specific slave device
            enumeration MscRxClockSignalType: {MSC_SIGNALPOLARITY_INVERTED, MSC_SIGNALPOLARITY_NONINVERTED}, origin=ChipowerTech, post-build-variant-value=true, set at post-build, default-value=MSC_SIGNALPOLARITY_NONINVERTED  # This parameter determines the polarity of the receive signal of the MSC receiver
          container MscTimeoutConfiguration [0..1]: multiplicity set at post-build, post-build-variant-multiplicity=true  # Upstream timeout Configuration
            integer MscUpstreamTimeoutPrescalar: 0..15, origin=ChipowerTech, post-build-variant-value=true, set at post-build, default-value=0  # Used to conculate upstream timeout with MscUpstreamTimeoutValue Formula TimeutValue = BitTime*2^(MscUpstreamTimeoutPrescalar + 1) * (MscUpstreamTimeoutValue + 1) TimeutValue:Time of timeout BitTime:Time it takes to transmit 1 bit, it's equal to (1/Upstream Baud Rate)
            integer MscUpstreamTimeoutValue: 0..15, origin=ChipowerTech, post-build-variant-value=true, set at post-build, default-value=0  # Used to conculate upstream timeout with MscUpstreamTimeoutPrescalar Formula TimeoutValue = BitTime*2^(MscUpstreamTimeoutPrescalar + 1) * (MscUpstreamTimeoutValue + 1) TimeoutValue:Time of timeout BitTime:Time it takes to transmit 1 bit, it's equal to (1/Upstream Baud Rate)
            enumeration MscUpTimeoutIntService [0..1]: {MSC_ALINTRNODE_SR0, MSC_ALINTRNODE_SR1, MSC_ALINTRNODE_SR2, MSC_ALINTRNODE_SR3, MSC_ALINTRNODE_SR4}, multiplicity set at post-build, origin=ChipowerTech, post-build-variant-value=true, set at post-build, default-value=MSC_ALINTRNODE_SR0  # Selects the service request to be raised when timeout interrupt is triggered
            function name MscUpTimeoutNotification: origin=ChipowerTech, post-build-variant-value=true, set at post-build, default-value=Msc0_UpTimeoutNotification  # Specifies the notification function of timeout interrupt
    container MscConfigurationOfOptApiServices  # This section contains the configuration of optional API services for MSC driver
      boolean MscGetVersionInfo: origin=ChipowerTech, set at pre-compile, default-value=false  # This parameter decides the availability of the API Msc_GetVersionInfo
      boolean MscDeInitApi: origin=ChipowerTech, set at pre-compile, default-value=false  # This parameter decides the availability of the API Msc_DeInit
      boolean Msc_GetRxDataApi: origin=ChipowerTech, set at pre-compile, default-value=false  # This parameter decides the availability of the API Msc_GetRxData
      boolean MscGetTxStatusApi: origin=ChipowerTech, set at pre-compile, default-value=false  # This parameter decides the availability of the API Msc_GetTxStatus
      boolean MscSelectRxDeviceApi: origin=ChipowerTech, set at pre-compile, default-value=false  # This parameter decides the availability of the API Msc_SelectRxDevice
      boolean MscTxDataFrameApi: origin=ChipowerTech, set at pre-compile, default-value=false  # This parameter decides the availability of the API Msc_TxDataFrame
      boolean MscChangeTxStateApi: origin=ChipowerTech, set at pre-compile, default-value=false  # This parameter decides the availability of the API Msc_ChangeTxState
      boolean MscChangeRxStateApi: origin=ChipowerTech, set at pre-compile, default-value=false  # This parameter decides the availability of the API Msc_ChangeRxState
      boolean Msc_StartRxTimeoutAPI: origin=ChipowerTech, set at pre-compile, default-value=false  # This parameter decides the availability of the API Msc_StartRxTimeout
      boolean MscGetRxTimeoutStatusApi: origin=ChipowerTech, set at pre-compile, default-value=false  # This parameter decides the availability of the API Msc_GetRxTimeoutStatus
    container MscDriverConfiguration  # This contains the functional feature configuration of MSC driver
      boolean MscDevErrorDetect: origin=ChipowerTech, set at pre-compile, default-value=false  # Switch to enable/disable the function of development error trace
    container CommonPublishedInformation  # It contains published information about vendor and versions.
      integer ArReleaseMajorVersion: 0..65535, origin=ChipowerTech, set at published-information, default-value=4  # Major version number of AUTOSAR specification on which the appropriate implementation is based on.
      integer ArReleaseMinorVersion: 0..65535, origin=ChipowerTech, set at published-information, default-value=4  # Minor version number of AUTOSAR specification on which the appropriate implementation is based on.
      integer ArReleaseRevisionVersion: 0..65535, origin=ChipowerTech, set at published-information, default-value=0  # Revision version number of AUTOSAR specification on which the appropriate implementation is based on.
      integer SwMajorVersion: 0..65535, origin=ChipowerTech, set at published-information, default-value=1  # Major version number of the vendor specific implementation of the module. The numbering is vendor specific. Note: Implementation Specific Parameter
      integer SwMinorVersion: 0..65535, origin=ChipowerTech, set at published-information, default-value=2  # Minor version number of the vendor specific implementation of the module. The numbering is vendor specific. Note: Implementation Specific Parameter
      integer SwPatchVersion: 0..65535, origin=ChipowerTech, set at published-information, default-value=0  # Patch level version number of the vendor specific implementation of the module. The numbering is vendor specific. Note: Implementation Specific Parameter
      integer ModuleId: 0..65535, origin=ChipowerTech, set at published-information, default-value=255  # Module ID of this module from Module List. Note: Implementation Specific Parameter
      integer VendorId: 0..65535, origin=ChipowerTech, set at published-information, default-value=175  # Vendor ID of the dedicated implementation of this module according to the AUTOSAR vendor list. Note: Implementation Specific Parameter
