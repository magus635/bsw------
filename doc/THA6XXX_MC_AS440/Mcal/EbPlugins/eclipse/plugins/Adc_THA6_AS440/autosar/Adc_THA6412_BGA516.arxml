AUTOSAR XML (schema 00046)
package /THA6_AS440_FuSa
  ecuc definition collection Adc_EcuParameterDefinition: module=Adc
  module definition Adc [0..1]: post-build-variant-support=true, refined-module-def=Adc, variants post-build  # Configuration of the Adc (Analog Digital Conversion) module.
    container AdcConfigSet  # This container contains the configuration parameters and sub containers of the AUTOSAR Adc module.
      reference AdcAnalogClockSource: origin=ChipowerTech, post-build-variant-value=true, set at post-build, destination=McuClockReferencePoint  # This parameter defines ADC module clock(hz) This parameter is reference from MCU ADC clock(McuClockReferencePoint), configure ADC clock first in MCU Container
      container AdcHwUnit [1..12]: multiplicity set at pre-compile, requires-index=true  # This container contains the Driver configuration (parameters) depending on grouping of channels
        enumeration AdcHwUnitId: {SARADC0, SARADC1, SARADC2, SARADC3, SARADC4, SARADC5, SARADC6, SARADC7, SARADC8, SARADC9, SARADC10, SARADC11}, set at pre-compile, default-value=SARADC0  # Numeric ID of the HW Unit. This symbolic name allows accessing Hw Unit data. Enumeration literals are defined vendor specific.
        enumeration AdcClockSource [0..1]: {undefined}, multiplicity set at post-build, post-build-variant-multiplicity=true, post-build-variant-value=true, set at post-build  # The ADC module specific clock input for the conversion unit can statically be configured to select different clock sources if provided by hardware. Note This parameter is not used and has been replaced by AdcConfigSet/AdcAnalogClockSource.
        integer AdcPrescale [0..1]: 2..320, multiplicity set at post-build, post-build-variant-multiplicity=true, post-build-variant-value=true, set at post-build, default-value=14  # Optional ADC module specific clock divider factor. Note f_ADC = f_input / AdcPrescale. This value must be an even number.
        enumeration AdcRequestSource{0..2}Prio: {LOWEST, LOW, HIGH, HIGHEST}, origin=ChipowerTech, post-build-variant-value=true, set at post-build, default-value=LOWEST  # Priority for the Request Source {0..2}
        enumeration AdcResolution: {BITS_12, BITS_10, BITS_8}, origin=ChipowerTech, post-build-variant-value=true, set at post-build, default-value=BITS_12  # ADC resolution in bits for channel conversion in the AdcHwUnit. Note BITS_8 - 8-bit conversion. BITS_10 - 10-bit conversion. BITS_12 - 12-bit conversion.
        integer AdcKernelChSampleTime: 0..255, origin=ChipowerTech, post-build-variant-value=true, set at post-build, default-value=2  # ADC sample time for channel conversion in the AdcHwUnit. <h1>Note</h1> The sample time = AdcKernelChSampleTime + 1.5.
        enumeration AdcRefVoltsrcHigh [0..1]: {REF_VOLTAGE_VAREF}, multiplicity set at post-build, origin=ChipowerTech, post-build-variant-multiplicity=true, post-build-variant-value=true, set at post-build, default-value=REF_VOLTAGE_VAREF  # Upper reference voltage source for all channels. Note REF_VOLTAGE_VAREF - Standard reference input voltage.
        enumeration AdcRefVoltsrcLow [0..1]: {REF_VOLTAGE_GND}, multiplicity set at post-build, origin=ChipowerTech, post-build-variant-multiplicity=true, post-build-variant-value=true, set at post-build, default-value=REF_VOLTAGE_GND  # Lower reference voltage source for all channels. <h1>Note</h1> REF_VOLTAGE_GND - Lower reference voltage is GND.
        enumeration AdcResultHandlingImplementation: {INTERRUPT_MODE, POLLING_MODE, DMA_MODE}, origin=ChipowerTech, set at pre-compile, default-value=INTERRUPT_MODE  # Determines the conversion result handling method of this HW unit. Note INTERRUPT_MODE: Conversion results are transferred in the ISR (AUTOSAR Mode). If used it is necessary to configure the interrupt of this HW unit in the INTC module. POLLING_MODE: Conversion results are transferred using API Adc_GetGroupStatus(). If used this API needs to be called periodically. DMA_MODE: Conversion results are transferred using a DMA channel.If used it is necessary to configure the DMA channel of this HW unit in the DMA module.
        boolean AdcDmaResultHandlingInterruptEnable [0..1]: multiplicity set at pre-compile, origin=ChipowerTech, set at pre-compile, default-value=false  # Enables / Disables ADC interrupt in the DMA result handling mode. Note If disabled, the streaming access mode for groups under this hardware unit will be prohibited, and the API Adc_GetGroupStatus cannot be called.
        enumeration AdcSyncConvMode [0..1]: {ADC_STANDALONE, ADC_SYNC_CONV_MASTER, ADC_SYNC_CONV_SLAVE}, multiplicity set at post-build, origin=ChipowerTech, post-build-variant-multiplicity=true, post-build-variant-value=true, set at post-build, default-value=ADC_STANDALONE  # The working mode of the synchronization group. ADC_STANDALONE: This HW unit does not use synchronization conversion function. ADC_SYNC_CONV_MASTER: This HW unit serves as the master for the synchronization conversion group. ADC_SYNC_CONV_SLAVE: This HW unit serves as the slave for the synchronization conversion group. Note This parameter is available only if the parameter AdcSyncConvEnable is set to true.
        reference AdcSyncConvMasterObject [0..1]: multiplicity set at post-build, origin=ChipowerTech, post-build-variant-multiplicity=true, post-build-variant-value=true, set at post-build, destination=AdcHwUnit  # If the 'AdcSyncConvMode' is set to the 'ADC_SYNC_CONV_SLAVE', this parameter selects the master HW unit for this slave HW unit in synchronization group. Note This parameter is available only is the parameter AdcSyncConvEnable is set to 'ADC_SYNC_CONV_SLAVE'.
        container AdcChannel [1..255]: multiplicity set at pre-compile, requires-index=true  # This container contains the channel configuration (parameters) depending on the hardware capability. The organization of this data structure could contain dependencies to the microcontroller so this is left up to the implementer and its location is left up to the configuration. Note: Since a AdcChannel can be part of several AdcGroups, this container is not realized as a subcontainer of AdcGroup but instead as a subcontainer of AdcHwUnit.
          integer AdcChannelId: 0..255, set at pre-compile, default-value=0  # This parameter defines the assignment of the channel to the physical ADC hardware channel.
          enumeration AdcAnChannelNum: {AN0, AN1, AN2, AN3, AN4, AN5, AN6, AN7, AN8, AN9, AN10, AN11, AN12, AN13, AN14, AN15, AN16, AN17_P40_10, AN18_P40_11, AN19_P40_12, AN20, AN21, AN22, AN23, AN24_P40_0, AN25_P40_1, AN26_P40_2, AN27_P40_3, AN28_P40_13, AN29_P40_14, AN30, AN31, AN48, AN49, AN50, AN51, AN52, AN53, AN54_P41_4, AN55_P41_5, AN32_P40_4, AN33_P40_5, AN34, AN35, AN56, AN57, AN58, AN59, AN60, AN61, AN62_P41_6, AN63_P41_7, P01_5, P01_4, P01_3, P02_11, AN64_P41_8, AN65, AN66, AN67_P40_15, AN68_P41_0, AN69_P41_1, AN70_P41_2, AN71_P41_3, AN44, AN45, AN46, AN47, AN36_P40_6, AN37_P40_7, AN38_P40_8, AN39_P40_9, AN40, AN41, AN42, AN43, P00_12, P00_11, P00_10, P00_9, P00_8, P00_7, P00_6, P00_5, P00_4, P00_3, P00_2, P00_1, P33_7, P33_6, P33_5, P33_4, P33_3, P33_2, P33_1, P33_0, P34_4, P34_3, P34_2, P34_1}, origin=ChipowerTech, post-build-variant-value=true, set at post-build  # Analog Input Channel Number. 8/16 analog inputs for each ADC HW Units are connected.
          integer AdcChannelConvTime [0..1]: 0..9223372036854775807, multiplicity set at post-build, post-build-variant-multiplicity=true, post-build-variant-value=true, set at post-build, default-value=0  # Configuration of conversion time, i.e. the time during which the analogue value is converted into digital representation, (in clock cycles) for each channel, if supported by hardware. Note This parameter is not used.
          boolean AdcChannelLimitCheck [0..1]: multiplicity set at pre-compile, set at pre-compile, default-value=false  # Enables or disables limit checking for an ADC channel. Note 1. This parameter is available only when the parameter AdcEnableLimitCheck is set to true; 2. This parameter must set to false when the parameter AdcEnableLimitCheck is set to false; 3. if the parameter AdcChannelLimitCheck is set to true, the parameter AdcChannelLowLimit must be configured; 4. if the parameter AdcChannelHighLimit is set to true, the parameter AdcChannelLowLimit must be configured; 5. if the parameter AdcChannelRangeSelect is set to true, the parameter AdcChannelLowLimit must be configured;
          integer AdcChannelHighLimit [0..1]: 0..9223372036854775807, multiplicity set at pre-compile, set at pre-compile, default-value=4095  # High limit - used for limit checking. 1. when the resolution of HW unit is 12bits: range is 0 to 4095; 2. when the resolution of HW unit is 10bits; range is 0 to 1023; 3. when the resolution of HW unit is 8bits; range is 0 to 255; Note This parameter is available only when the parameters AdcChannelLimitCheck and AdcEnableLimitCheck are set to true;
          integer AdcChannelLowLimit [0..1]: 0..9223372036854775807, multiplicity set at pre-compile, set at pre-compile, default-value=0  # Low limit - used for limit checking. 1. when the resolution of HW unit is 12bits: range is 0 to 4095; 2. when the resolution of HW unit is 10bits; range is 0 to 1023; 3. when the resolution of HW unit is 8bits; range is 0 to 255; Note This parameter is available only when the parameters AdcChannelLimitCheck and AdcEnableLimitCheck are set to true;
          enumeration AdcChannelRangeSelect [0..1]: {ADC_RANGE_ALWAYS, ADC_RANGE_BETWEEN, ADC_RANGE_NOT_BETWEEN, ADC_RANGE_NOT_OVER_HIGH, ADC_RANGE_NOT_UNDER_LOW, ADC_RANGE_OVER_HIGH, ADC_RANGE_UNDER_LOW}, multiplicity set at pre-compile, set at pre-compile, default-value=ADC_RANGE_ALWAYS  # In case of active limit checking: defines which conversion values are taken into account related to the boarders defined with AdcChannelLowLimit and AdcChannelHighLimit. ADC_RANGE_ALWAYS - Complete range - independent from channel limit settings. ADC_RANGE_BETWEEN - Range between low limit and high limit - high limit value included. ADC_RANGE_NOT_BETWEEN - Range above high limit or below low limit - low limit value included. ADC_RANGE_NOT_OVER_HIGH - Range below high limit - high limit value included. ADC_RANGE_NOT_UNDER_LOW - Range above low limit. ADC_RANGE_OVER_HIGH - Range above high limit. ADC_RANGE_UNDER_LOW - Range below limit - low limit value included. Note This parameter is available only when the parameters AdcChannelLimitCheck and AdcEnableLimitCheck are set to true.;
          enumeration AdcChannelRefVoltsrcHigh [0..1]: {REF_VOLTAGE_VAREF}, multiplicity set at post-build, post-build-variant-multiplicity=true, post-build-variant-value=true, set at post-build, default-value=REF_VOLTAGE_VAREF  # Upper reference voltage source for each channel. <h1>Note</h1>Not supported on Adc Channel and has been replaced by AdcHwUnit/AdcRefVoltHigh.
          enumeration AdcChannelRefVoltsrcLow [0..1]: {undefined}, multiplicity set at post-build, post-build-variant-multiplicity=true, post-build-variant-value=true, set at post-build  # Lower reference voltage source for each channel. <h1>Note</h1>Not supported on Adc Channel and has been replaced by AdcHwUnit/AdcRefVoltLow.
          integer AdcChannelResolution [0..1]: 1..63, multiplicity set at post-build, post-build-variant-multiplicity=true, post-build-variant-value=true, set at post-build, default-value=1  # Channel resolution in bits. <h1>Note</h1>Not supported on Adc Channel and has been replaced by AdcHwUnit/AdcResolution.
          integer AdcChannelSampTime [0..1]: 0..9223372036854775807, multiplicity set at post-build, post-build-variant-multiplicity=true, post-build-variant-value=true, set at post-build, default-value=0  # Configuration of sampling time, i.e. the time during which the value is sampled, (in clock cycles) for each channel, if supported by hardware. <h1>Note</h1>Not supported on Adc Channel and has been replaced by AdcHwUnit/AdcKernelChSampleTime.
          boolean AdcChannelSyncConvEnable [0..1]: multiplicity set at post-build, origin=ChipowerTech, post-build-variant-multiplicity=true, post-build-variant-value=true, set at post-build, default-value=false  # Enables / disables the synchronous conversion functionality for this channel. true: Enable the synchronous conversion for this channel. false: Disable the synchronous conversion for this channel. Note This parameter is available only when the parameter AdcSyncConvEnable is set to true and the parameter AdcSyncConvMode is set to 'ADC_SYNC_CONV_MASTER'.
        container AdcGroup [1..32]: multiplicity set at pre-compile, requires-index=true  # This container contains the Group configuration (parameters).
          integer AdcGroupId: 0..1023, set at pre-compile, symbolic-name-value=true, default-value=0  # Numeric ID of the group. This parameter is the symbolic name to be used on the API. This symbolic name allows accessing Channel Group data. This value will be assigned to the symbolic name derived of the AdcGroup container shortName.
          enumeration AdcGroupAccessMode: {ADC_ACCESS_MODE_SINGLE, ADC_ACCESS_MODE_STREAMING}, post-build-variant-value=true, set at post-build, default-value=ADC_ACCESS_MODE_SINGLE  # Type of access mode to group conversion results. ADC_ACCESS_MODE_SINGLE - Single value access mode. ADC_ACCESS_MODE_STREAMING - Streaming access mode.
          enumeration AdcGroupConversionMode: {ADC_CONV_MODE_CONTINUOUS, ADC_CONV_MODE_ONESHOT}, post-build-variant-value=true, set at post-build, default-value=ADC_CONV_MODE_ONESHOT  # Type of conversion mode supported by the driver. ADC_CONV_MODE_CONTINUOUS - Conversions of an ADC channel group are performed continuously after a software API call (start). The conversions itself are running automatically (no additional software or hardware trigger needed). ADC_CONV_MODE_ONESHOT - The conversion of an ADC channel group is performed once after a trigger.
          integer AdcGroupPriority [0..1]: 0..255, multiplicity set at post-build, post-build-variant-multiplicity=true, post-build-variant-value=true, set at post-build, default-value=0  # Priority level of the AdcGroup. Note THe lowest priority is 0. This parameter is available only when the parameter AdcGroupTriggSrc is set to 'ADC_TRIGG_SRC_SW' and the parameter AdcPriorityImplementation is set to 'ADC_PRIORITY_HW_SW'.
          enumeration AdcGroupReplacement [0..1]: {ADC_GROUP_REPL_ABORT_RESTART, ADC_GROUP_REPL_SUSPEND_RESUME}, multiplicity set at post-build, post-build-variant-multiplicity=true, post-build-variant-value=true, set at post-build, default-value=ADC_GROUP_REPL_ABORT_RESTART  # Replacement mechanism, which is used on ADC group level, if a group conversion is interrupted by a group which has a higher priority. ADC_GROUP_REPL_ABORT_RESTART - Abort/Restart mechanism is used on group level, if a group is interrupted by a higher priority group. The complete conversion round of the interrupted group (all group channels) is restarted after the higher priority group conversion is finished. If the group is configured in streaming access mode, only the results of the interrupted conversion round are discarded. Results of previous conversion rounds which are already written to the result buffer are not affected. ADC_GROUP_REPL_SUSPEND_RESUME - Suspend/Resume mechanism is used on group level, if a group is interrupted by a higher priority group. The converions round (conversion of all group channels) of the interrupted group is completed after the higher priority group conversion is finished. If the group is configured in streaming access mode, only the results of the interrupted conversion round are discarded. Results of previous conversion rounds which are already written to the result buffer are not affected. Note Not supported for channel group
          enumeration AdcGroupTriggSrc: {ADC_TRIGG_SRC_HW, ADC_TRIGG_SRC_SW}, post-build-variant-value=true, set at post-build, default-value=ADC_TRIGG_SRC_SW  # Type of source event that starts a group conversion. ADC_TRIGG_SRC_HW - Group is triggered by a hardware event. ADC_TRIGG_SRC_SW - Group is triggered by a software API call.
          enumeration AdcGroupRequestSource: {REQUESTSOURCE_QUEUE0, REQUESTSOURCE_QUEUE1, REQUESTSOURCE_QUEUE2}, origin=ChipowerTech, set at pre-compile, default-value=REQUESTSOURCE_QUEUE0  # Microcontroller specific request source selection. REQSRC0_SEL - Request source 'AdcRequestSource0Prio' REQSRC1_SEL - Request source 'AdcRequestSource1Prio' REQSRC2_SEL - Request source 'AdcRequestSource2Prio'
          enumeration AdcHwTrigSignal [0..1]: {ADC_HW_TRIG_BOTH_EDGES, ADC_HW_TRIG_FALLING_EDGE, ADC_HW_TRIG_RISING_EDGE}, multiplicity set at post-build, post-build-variant-multiplicity=true, post-build-variant-value=true, set at post-build, default-value=ADC_HW_TRIG_RISING_EDGE  # Configures on which edge of the hardware trigger signal the driver should react, i.e. start the conversion (only if supported by the ADC hardware). ADC_HW_TRIG_BOTH_EDGES - React on both edges of the hardware trigger signal (only if supported by the ADC hardware). ADC_HW_TRIG_FALLING_EDGE - React on the falling edge of the hardware trigger signal (only if supported by the ADC hardware). ADC_HW_TRIG_RISING_EDGE - React on the rising edge of the hardware trigger signal (only if supported by the ADC hardware). Note 1. This parameter is available only when the parameter AdcGroupTriggSrc is set to 'ADC_TRIGG_SRC_HW'. 2. Default is 'ADC_HW_TRIG_RISING_EDGE' when this parameter is disabled.
          integer AdcHwTrigTimer [0..1]: 0..9223372036854775807, multiplicity set at post-build, post-build-variant-multiplicity=true, post-build-variant-value=true, set at post-build, default-value=0  # Reload value of the ADC module embedded timer (only if supported by ADC hardware). Note This parameter is not used.
          function name AdcNotification [0..1]: multiplicity set at post-build, post-build-variant-multiplicity=true, post-build-variant-value=true, set at post-build, default-value=NULL_PTR  # Callback function for each group.This function pointer is called everytime when the conversion of this group is completed. Note This parameter is available only when the parameter AdcGrpNotifCapability is set to true. Notification function must be no return value(type void) and no formal parameters.
          enumeration AdcStreamingBufferMode: {ADC_STREAM_BUFFER_CIRCULAR, ADC_STREAM_BUFFER_LINEAR}, post-build-variant-value=true, set at post-build, default-value=ADC_STREAM_BUFFER_LINEAR  # Configure streaming buffer as "linear buffer" (i.e. the ADC Driver stops the conversion as soon as the stream buffer is full) or as "ring buffer" (wraps around if the end of the stream buffer is reached). ADC_STREAM_BUFFER_CIRCULAR - The ADC Driver continues the conversion even if the stream buffer is full (number of samples reached) by wrapping around the stream buffer itself. ADC_STREAM_BUFFER_LINEAR - The ADC Driver stops the conversion as soon as the stream buffer is full (number of samples reached).
          integer AdcStreamingNumSamples: 1..255, post-build-variant-value=true, set at post-build, default-value=1  # Number of ADC values to be acquired per channel in streaming access mode. Note: in single access mode this parameter assumes value 1, since only one sample per channel is processed.
          integer AdcResultAccumulation [0..1]: 2..16, multiplicity set at post-build, origin=ChipowerTech, post-build-variant-multiplicity=true, post-build-variant-value=true, set at post-build, default-value=2  # Accumulation of 2~16 conversion results of each channel in this group.
          boolean AdcResultRegisterManual [0..1]: multiplicity set at post-build, origin=ChipowerTech, post-build-variant-multiplicity=true, post-build-variant-value=true, set at post-build, default-value=false  # Enables / Disables manual configuration of result registers(see AdcResultRegisterDefinition). true: AdcResultRegisterDefinition must be configured. false: AdcResultRegisterDefinition need not be configured. The conversion result of each channel is stored in the result register matching its physical channel ID.
          integer AdcResultRegisterDefinition [0..*]: 0..15, multiplicity set at post-build, origin=ChipowerTech, post-build-variant-multiplicity=true, post-build-variant-value=true, requires-index=true, set at post-build, default-value=0  # Assignment of result register to AdcGroupDefinition. This parameter defines the result register for storing conversion result of each channel in the corresponding AdcGroupDefinition. The value of this parameter must be configured in descending order to match the node sequence in AdcGroupDefinition.
          reference AdcHwExtTrigSelect [0..1]: multiplicity set at post-build, origin=ChipowerTech, post-build-variant-multiplicity=true, post-build-variant-value=true, set at post-build, destination=SaradcSent  # External request pin/signal selection. Selection should depend on the configured group request source (RS) and ADC Hw Unit. Note This parameter is available only when the parameter AdcGroupTriggSrc is set to 'ADC_TRIGG_SRC_HW'
          reference AdcGroupDefinition [1..*]: multiplicity set at post-build, post-build-variant-multiplicity=true, post-build-variant-value=true, requires-index=true, set at post-build, destination=AdcChannel  # Assignment of AdcChannels to a AdcGroups.
          reference AdcGroupEcucPartitionRef [0..*]: scope=ECU, multiplicity set at pre-compile, post-build-variant-multiplicity=true, post-build-variant-value=true, set at pre-compile, destination=EcucPartition  # Maps an ADC channel group to zero or multiple ECUC partitions to limit the access to this channel group. The ECUC partitions referenced are a subset of the ECUC partitions where the ADC driver is mapped to. Tags: atp.Status=draft
    container AdcGeneral  # General configuration (parameters) of the ADC Driver software module. true: Adc_DeInit() can be used. false: Adc_DeInit() can not be used.
      boolean AdcDevErrorDetect: set at pre-compile, default-value=false  # Switches the Default Error Tracer (Det) detection and notification ON or OFF. true: enabled (ON). false: disabled (OFF).
      boolean AdcSafetyErrorDetect: origin=ChipowerTech, set at pre-compile, default-value=true  # Switches the safety error detection ON or OFF.
      boolean AdcDeInitApi: set at pre-compile, default-value=true  # Adds / removes the service Adc_DeInit() from the code. true: Enabled. false: Disabled.
      boolean AdcEnableLimitCheck: set at pre-compile, default-value=false  # Enables or disables limit checking feature in the ADC driver. true: Enabled. false: Disabled.
      boolean AdcEnableQueuing: set at pre-compile, default-value=false  # Determines, if the queuing mechanism is active in case of priority mechanism disabled. true: Enabled. false: Disabled. Note 1. If priority mechanism is enabled, queuing mechanism is always active and the parameter ADC_ENABLE_QUEUING is not evaluated. 2. This parameter is available only when the parameter AdcPriorityImplementation is set to 'ADC_PRIORITY_NONE'. 3. This parameter can not be set to true when the parameter AdcEnableStartStopGroupApi is set to false.
      boolean AdcEnableStartStopGroupApi: set at pre-compile, default-value=true  # Adds / removes the services Adc_StartGroupConversion() and Adc_StopGroupConversion() from the code. true: Adc_StartGroupConversion() and Adc_StopGroupConversion() can be used false: Adc_StartGroupConversion() and Adc_StopGroupConversion() can not be used
      boolean AdcGrpNotifCapability: set at pre-compile, default-value=false  # Determines, if the group notification mechanism (the functions to enable and disable the notifications) is available at runtime. true: Enabled. false: Disabled.
      boolean AdcHwTriggerApi: set at pre-compile, default-value=false  # Adds / removes the services Adc_EnableHardwareTrigger() and Adc_DisableHardwareTrigger() from the code. true: Adc_EnableHardwareTrigger() and Adc_DisableHardwareTrigger() can be used. false: Adc_EnableHardwareTrigger() and Adc_DisableHardwareTrigger() can not be used.
      boolean AdcLowPowerStatesSupport [0..1]: multiplicity set at pre-compile, set at pre-compile, default-value=false  # Adds / removes all power state management related APIs (ADC_SetPowerState, ADC_GetCurrentPowerState, ADC_GetTargetPowerState, ADC_PreparePowerState, ADC_Main_PowerTransitionManager), indicating if the HW offers low power state management. Note Not supported on hardware.
      boolean AdcPowerStateAsynchTransitionMode [0..1]: multiplicity set at pre-compile, set at pre-compile, default-value=false  # Enables / disables support of the ADCDriver to the asynchronous power state transition. Note Not supported on hardware.
      boolean AdcStartupCalibration: origin=ChipowerTech, set at pre-compile, default-value=false  # Enables / disables Adc Startup Calibration feature when call API Adc_Init().
      boolean AdcReadGroupApi: set at pre-compile, default-value=true  # Adds / removes the service Adc_ReadGroup() and from the code. true: Adc_ReadGroup() can be used. false: Adc_ReadGroup() can not be used.
      boolean AdcSyncConvEnable: origin=ChipowerTech, set at pre-compile, default-value=false  # Enables / disables hardware synchronous conversion feature. true: Enable the synchronous conversion. false: Disable the synchronous conversion.
      enumeration AdcPriorityImplementation: {ADC_PRIORITY_HW, ADC_PRIORITY_HW_SW, ADC_PRIORITY_NONE}, set at pre-compile, default-value=ADC_PRIORITY_NONE  # Determines whether a priority mechanism is available for prioritization of the conversion requests and if available, the type of prioritization mechanism. The selection applies for groups with trigger source software and trigger source hardware. Two types of prioritization mechanism can be selected. The hardware prioritization mechanism (AdcPriorityHw) uses the ADC hardware features for prioritization of the software conversion requests and hardware trigger signals for groups with trigger source hardware. The mixed hardware and software prioritization mechanism (AdcPriorityHwSw) uses the ADC hardware features for prioritization of ADC hardware trigger for groups with trigger source hardware and a software implemented prioritization mechanism for groups with trigger source software. The group priorities for software triggered groups are typically configured with lower priority levels than the group priorities for hardware triggered groups. ADC_PRIORITY_HW - Hardware priority mechanism is available only ADC_PRIORITY_HW_SW - Both hardware and software priority mechanisms are available ADC_PRIORITY_NONE - priority mechanism is not available Note The priority can not be 'ADC_PRIORITY_HW_SW' when 'AdcEnableStartStopGroupApi' is false
      enumeration AdcResultAlignment: {ADC_ALIGN_LEFT, ADC_ALIGN_RIGHT}, set at pre-compile, default-value=ADC_ALIGN_RIGHT  # Alignment of ADC raw results in ADC result buffer. ADC_ALIGN_LEFT - left alignment ADC_ALIGN_RIGHT - right alignment
      boolean AdcVersionInfoApi: set at pre-compile, default-value=false  # Adds / removes the service Adc_GetVersionInfo() from the code. true: Adc_GetVersionInfo() can be used. false: Adc_GetVersionInfor() can not be used.
      reference AdcEcucPartitionRef [0..*]: scope=ECU, multiplicity set at pre-compile, post-build-variant-multiplicity=true, post-build-variant-value=true, requires-index=true, set at pre-compile, destination=EcucPartition  # Maps the ADC driver to zero or multiple ECUC partitions to make the driver API available in the according partition. Tags: atp.Status=draft
      reference AdcKernelEcucPartitionRef [0..1]: scope=ECU, multiplicity set at pre-compile, post-build-variant-multiplicity=true, post-build-variant-value=true, requires-index=true, set at pre-compile, destination=EcucPartition  # Maps the ADC kernel to zero or one ECUC partitions to assign the driver kernel to a certain core. The ECUC partition referenced is a subset of the ECUC partitions where the ADC driver is mapped to. Tags: atp.Status=draft
      container AdcPowerStateConfig [0..*]: multiplicity set at pre-compile, requires-index=true  # Each instance of this parameter defines a power state and the callback to be called when this power state is reached.
        integer AdcPowerState: 0..18446744073709551615, set at pre-compile, symbolic-name-value=true, default-value=0  # Each instance of this parameter describes a different power state supported by the ADC HW. It should be defined by the HW supplier and used by the ADCDriver to reference specific HW configurations which set the ADC HW module in the referenced power state. At least the power mode corresponding to full power state shall be always configured. This parameter shall only be configured if the parameter AdcLowPowerStatesSupport is set to true.
        function name AdcPowerStateReadyCbkRef: set at pre-compile, default-value=NULL_PTR  # Each instance of this parameter contains a reference to a power mode callback defined in a CDD or IoHwAbs component. This parameter shall only be configured if the parameter AdcLowPowerStatesSupport is set to true
    container AdcPublishedInformation  # Additional published parameters not covered by "Common" Published Information. Note that these parameters have "PUBLISHED-INFORMATION" configuration class setting, since they are published information.
      boolean AdcChannelValueSigned: set at published-information, default-value=false  # Information whether the result value of the ADC driver has sign information (true) or not (false). If the result shall be interpreted as signed value it shall apply to C-language rules.
      boolean AdcGroupFirstChannelFixed: set at published-information, default-value=false  # Information whether the first channel of an ADC Channel group can be configured (false) or is fixed (true) to a value determined by the ADC HW Unit.
      integer AdcMaxChannelResolution: 1..63, set at published-information, default-value=12  # Maximum Channel resolution in bits (does not specify accuracy).
    container CommonPublishedInformation  # Common container, aggregated by all modules. It contains published information about vendor and versions.
      integer ArReleaseMajorVersion: 0..255, origin=ChipowerTech, set at published-information, default-value=4  # Major version number of AUTOSAR specification on which the appropriate implementation is based on.
      integer ArReleaseMinorVersion: 0..255, origin=ChipowerTech, set at published-information, default-value=4  # Minor version number of AUTOSAR specification on which the appropriate implementation is based on.
      integer ArReleaseRevisionVersion: 0..255, origin=ChipowerTech, set at published-information, default-value=0  # Revision version number of AUTOSAR specification on which the appropriate implementation is based on.
      integer ModuleId: 0..255, origin=ChipowerTech, set at published-information, default-value=123  # Module ID of this module from Module List.
      integer SwMajorVersion: 0..255, origin=ChipowerTech, set at published-information, default-value=1  # Major version number of the vendor specific implementation of the module. The numbering is vendor specific.
      integer SwMinorVersion: 0..255, origin=ChipowerTech, set at published-information, default-value=2  # Minor version number of the vendor specific implementation of the module. The numbering is vendor specific.
      integer SwPatchVersion: 0..255, origin=ChipowerTech, set at published-information, default-value=0  # Patch level version number of the vendor specific implementation of the module. The numbering is vendor specific.
      integer VendorId: 175..175, origin=ChipowerTech, set at published-information, default-value=175  # Vendor ID of the dedicated implementation of this module according to the AUTOSAR vendor list.
