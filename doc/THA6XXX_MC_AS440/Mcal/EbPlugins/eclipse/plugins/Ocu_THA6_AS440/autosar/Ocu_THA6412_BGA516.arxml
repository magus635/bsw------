AUTOSAR XML (schema 00046)
package /THA6_AS440_FuSa
  ecuc definition collection Ocu_EcuParameterDefinition: module=Ocu
  module definition Ocu [0..1]: post-build-variant-support=true, refined-module-def=Ocu, variants post-build  # Configuration of Ocu (Output Compare Unit) module.
    container OcuConfigSet  # This container is the base of a Configuration Set, which contains the configured OCU channels. This way, different configuration sets can be defined for post-build process.
      enumeration OcuCountdirection [0..1]: {OCU_UPCOUNTING}, multiplicity set at post-build, post-build-variant-multiplicity=true, post-build-variant-value=true, set at post-build, default-value=OCU_UPCOUNTING  # This parameter indicates the count direction for the whole OCU driver.
      container OcuChannel [1..64]: multiplicity set at pre-compile, requires-index=true  # Configuration of an individual OCU channel.
        integer OcuAssignedHardwareChannel: 0..15, post-build-variant-value=true, set at post-build, default-value=0  # The physical hardware channel that is assigned to this logical channel.
        integer OcuChannelId: 0..65535, set at pre-compile, symbolic-name-value=true, default-value=0  # Channel Id of the OCU channel. This value will be assigned to the symbolic name derived from the OcuChannel container short name. It defines the assignment of the channel to the physical OCU hardware channel.
        integer OcuChannelTickDuration: 1..32768, post-build-variant-value=true, set at post-build, default-value=1  # Specifies the tick duration of the counter of the channel. This parameter is the number of the input clock edges (rising edges or falling edges exclusively) counted each time to increase the counter by one unit.Note: This parameter is not-used,not editable and default value is set to 1
        integer OcuDefaultThreshold: 1..16777215, post-build-variant-value=true, set at post-build, default-value=1  # Value of comparison threshold used for Initialization.
        integer OcuHardwareTriggeredAdc [0..1]: 0..255, multiplicity set at post-build, post-build-variant-multiplicity=true, post-build-variant-value=true, set at post-build, default-value=0  # This parameter is used to allow the OCU channel to trigger an ADC channel upon compare match. The mapping of ADC physical channel and OCU physical channel is configurated in MCU module. This parameter is just used to choose the output event of this ocu channel is to trigger adc
        integer OcuHardwareTriggeredDMA [0..1]: 0..255, multiplicity set at post-build, post-build-variant-multiplicity=true, post-build-variant-value=true, set at post-build, default-value=0  # This parameter is used to allow the OCU channel to trigger a DMA channel upon compare match. The value of the parameter represents the DMA physical channel to trigger.
        integer OcuMaxCounterValue: 1..4294967295, post-build-variant-value=true, set at post-build, default-value=16777215  # Maximum value in ticks, the counter of the OCU channel is able to count.
        function name OcuNotification [0..1]: multiplicity set at post-build, post-build-variant-multiplicity=true, post-build-variant-value=true, set at post-build, default-value=Ocu_Notification_0  # Definition of a function pointer to a Callback function.
        boolean OcuOuptutPinUsed: set at pre-compile, default-value=false  # Information about the usage of an output pin on this channel.
        enumeration OcuOutputPinDefaultState [0..1]: {OCU_HIGH, OCU_LOW}, multiplicity set at post-build, post-build-variant-value=true, set at post-build, default-value=OCU_LOW  # The parameter OcuOutputPinDefaultState represents the state that a pin associated with a channel shall be set to after initialisation.
        reference OcuChannelEcucPartitionRef [0..*]: scope=ECU, multiplicity set at pre-compile, post-build-variant-multiplicity=true, post-build-variant-value=true, set at pre-compile, destination=EcucPartition  # Maps an OCU channel to zero or multiple ECUC partitions to limit the access to this channel. The ECUC partitions referenced are a subset of the ECUC partitions where the OCU driver is mapped to. Tags: atp.Status=draft
        container GtmTimerOutputModuleConfiguration: multiplicity set at pre-compile  # Choose GTM-ATOM channel which will be used by this OCU Channel. Referred timer channel in MCU should have TomChannelUsage/ AtomChannelUsage as USED_BY_OCU_DRIVER
          enumeration GtmTimerClockSelect: {GTM_TBU_TS0, GTM_TBU_TS1, GTM_TBU_TS2}, origin=ChipowerTech, post-build-variant-value=true, set at post-build, default-value=GTM_TBU_TS0  # This parameter decides the compare object of GTM-ATOM timer.
          choice reference GtmTimerUsed: scope=ECU, origin=ChipowerTech, post-build-variant-value=true, set at post-build, destination=GtmAtomChannel  # This parameter lists all the GTM timer channels (ATOM).
      container OcuHWSpecificSettings [0..1]: multiplicity set at pre-compile  # This container contains Ocu-specific parameters for selecting the clock source and setting optional prescalers if supported by hardware.
        enumeration OcuClockSource [0..1]: {UNUSED}, multiplicity set at post-build, post-build-variant-value=true, set at post-build, default-value=UNUSED  # The OCU driver specific clock input for the unit can statically be configured to select different clock sources if provided by hardware. Enumeration literals are defined vendor specific.
        enumeration OcuPrescale [0..1]: {UNUSED}, multiplicity set at post-build, post-build-variant-value=true, set at post-build, default-value=UNUSED  # Optional OCU driver specific clock prescale factor, if supported by hardware. Implementation is defined vendor specific.
    container OcuConfigurationOfOptionalApis  # Configuration of optional APIs.
      boolean OcuDeInitApi: set at pre-compile, default-value=false  # Adds / removes the service Ocu_DeInit() from the code.
      boolean OcuGetCounterApi: set at pre-compile, default-value=false  # Adds / removes the service Ocu_GetCounter() from the code.
      boolean OcuNotificationSupported: set at pre-compile, default-value=false  # Adds / removes the services Ocu_EnableNotification() and Ocu_DisableNotification() from the code.
      boolean OcuSetAbsoluteThresholdApi: set at pre-compile, default-value=false  # Adds / removes the service Ocu_SetAbsoluteThreshold() from the code.
      boolean OcuSetPinActionApi: set at pre-compile, default-value=false  # Adds / removes the service Ocu_SetPinAction() from the code.
      boolean OcuSetPinStateApi: set at pre-compile, default-value=false  # Adds / removes the service Ocu_SetPinState() from the code.
      boolean OcuSetRelativeThresholdApi: set at pre-compile, default-value=false  # Adds / removes the service Ocu_SetRelativeThreshold() from the code.
      boolean OcuVersionInfoApi: set at pre-compile, default-value=false  # Switch to indicate that the Ocu_GetVersionInfo() is supported.
    container OcuGeneral  # This container contains the module-wide configuration parameters of the OCU Driver.
      boolean OcuDevErrorDetect: set at pre-compile, default-value=false  # Switches the Default Error Tracer (Det) detection and notification ON or OFF.
      boolean OcuSafetyErrorDetect: origin=ChipowerTech, set at pre-compile, default-value=true  # Switches the Safety Error detection ON or OFF.
      reference OcuEcucPartitionRef [0..*]: scope=ECU, multiplicity set at pre-compile, post-build-variant-multiplicity=true, post-build-variant-value=true, set at pre-compile, destination=EcucPartition  # Maps the OCU driver to zero or multiple ECUC partitions to make the driver API available in the according partition. Tags: atp.Status=draft
      reference OcuKernelEcucPartitionRef [0..1]: scope=ECU, multiplicity set at pre-compile, post-build-variant-multiplicity=true, post-build-variant-value=true, set at pre-compile, destination=EcucPartition  # Maps the OCU kernel to zero or one ECUC partitions to assign the driver kernel to a certain core. The ECUC partition referenced is a subset of the ECUC partitions where the OCU driver is mapped to. Tags: atp.Status=draft
    container CommonPublishedInformation  # Common container, aggregated by all modules. It contains published information about vendor and versions.
      integer ArReleaseMajorVersion: 4..4, origin=ChipowerTech, set at published-information, default-value=4  # Major version number of AUTOSAR specification on which the appropriate implementation is based on.
      integer ArReleaseMinorVersion: 0..255, origin=ChipowerTech, set at published-information, default-value=4  # Minor version number of AUTOSAR specification on which the appropriate implementation is based on.
      integer ArReleaseRevisionVersion: 0..255, origin=ChipowerTech, set at published-information, default-value=0  # Revision version number of AUTOSAR specification on which the appropriate implementation is based on.
      integer ModuleId: 125..125, origin=ChipowerTech, set at published-information, default-value=125  # Module ID of this module from Module List. Note: Implementation Specific Parameter
      integer SwMajorVersion: 1..255, origin=ChipowerTech, set at published-information, default-value=1  # Major version number of the vendor specific implementation of the module. The numbering is vendor specific. Note: Implementation Specific Parameter
      integer SwMinorVersion: 0..255, origin=ChipowerTech, set at published-information, default-value=2  # Minor version number of the vendor specific implementation of the module. The numbering is vendor specific. Note: Implementation Specific Parameter
      integer SwPatchVersion: 0..255, origin=ChipowerTech, set at published-information, default-value=0  # Patch level version number of the vendor specific implementation of the module. The numbering is vendor specific. Note: Implementation Specific Parameter
      integer VendorId: 175..175, origin=ChipowerTech, set at published-information, default-value=175  # Vendor ID of the dedicated implementation of this module according to the AUTOSAR vendor list. Note: Implementation Specific Parameter
