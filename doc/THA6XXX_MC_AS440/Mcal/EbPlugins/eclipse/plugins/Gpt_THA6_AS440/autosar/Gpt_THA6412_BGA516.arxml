AUTOSAR XML (schema 00046)
package /THA6_AS440_FuSa
  ecuc definition collection Gpt_EcuParameterDefinition: module=Gpt
  module definition Gpt [0..1]: post-build-variant-support=true, refined-module-def=Gpt, variants post-build  # Configuration of the Gpt (General Purpose Timer) module.
    container GptChannelConfigSet  # This container is the base of a Configuration Set which contains the configured GPT channels. This way, different configuration sets can be defined for post-build process.
      container GptChannelConfiguration [1..86]: multiplicity set at pre-compile, requires-index=true  # Configuration of an individual GPT channel.
        integer GptChannelId: 0..85, scope=ECU, set at pre-compile, symbolic-name-value=true, default-value=0  # Channel Id of the GPT channel. This value will be assigned to the symbolic name derived of the GptChannelConfiguration container short name.
        enumeration GptChannelMode: {GPT_CH_MODE_CONTINUOUS, GPT_CH_MODE_ONESHOT}, scope=ECU, post-build-variant-value=true, set at post-build, default-value=GPT_CH_MODE_CONTINUOUS  # Specifies the behavior of the timer channel after the target time is reached.
        enumeration GptTimerChannelUsage: {GPT_PREDEF_TIMER_1US_16BIT_ENABLED, GPT_PREDEF_TIMER_1US_16_24BIT_ENABLED, GPT_PREDEF_TIMER_1US_16_24_32BIT_ENABLED, GPT_PREDEF_TIMER_100US_32BIT_ENABLED, GPT_TIMER_CHANNEL_NORMAL}, origin=ChipowerTech, set at pre-compile, default-value=GPT_TIMER_CHANNEL_NORMAL  # Specifies the grade of enabling the GPT Predef Timers for this channel.
        float GptChannelTickFrequency: 0.0..4.0E8, scope=ECU, post-build-variant-value=true, set at post-build, default-value=0.0  # Specifies the tick frequency of the timer channel in Hz.
        integer GptChannelTickValueMax: 0..4294967295, scope=ECU, post-build-variant-value=true, set at post-build, default-value=65535  # Maximum value in ticks, the timer channel is able to count. With the next tick, the timer rolls over to zero.
        boolean GptEnableWakeup: post-build-variant-value=true, set at post-build, default-value=false  # Enables wakeup capability of MCU for a channel.
        enumeration GptAssignedHwUnit: {GTM, BASETIMER}, scope=ECU, origin=ChipowerTech, post-build-variant-value=true, set at post-build, default-value=BASETIMER  # Specifies the timer hardware used for this Gpt channel.
        function name GptNotification [0..1]: multiplicity set at post-build, post-build-variant-multiplicity=true, post-build-variant-value=true, set at post-build, default-value=Gpt_Notification_0  # Function pointer to callback function (for non-wakeup notification)
        enumeration BaseTimerUsed [0..1]: {BASETIMER0, BASETIMER1, BASETIMER2, BASETIMER3, BASETIMER4, BASETIMER5}, scope=ECU, multiplicity set at post-build, origin=ChipowerTech, post-build-variant-value=true, set at post-build, default-value=BASETIMER0  # This parameter lists all the basetimers.
        reference GptChannelClkSrcRef: scope=ECU, post-build-variant-value=true, set at post-build, destination=GptClockReferencePoint  # Reference to the GptClockReferencePoint from which the channel clock is derived.
        reference GptChannelEcucPartitionRef [0..*]: scope=ECU, multiplicity set at pre-compile, post-build-variant-multiplicity=true, post-build-variant-value=true, set at pre-compile, destination=EcucPartition  # Maps a GPT channel to zero or multiple ECUC partitions to limit the access to this channel group. The ECUC partitions referenced are a subset of the ECUC partitions where the GPT driver is mapped to. Tags: atp.Status=draft
        container GtmTimerOutputModuleConfiguration [0..1]: multiplicity set at post-build, requires-index=true  # Choose GTM TOM channel which will be used by this GPT Driver. Referred timer channel in MCU should have TomChannelUsage as USED_BY_GPT_DRIVER
          enumeration GtmTimerClockSelect: {CMU_FXCLK0, CMU_FXCLK1, CMU_FXCLK2, CMU_FXCLK3, CMU_FXCLK4}, scope=ECU, origin=ChipowerTech, post-build-variant-value=true, set at post-build, default-value=CMU_FXCLK0  # CMU Clock source select for each GPT channel(based on GTM-TOM). For TOM channel the available clock sources are CMU_FXCLK0 (CMU_FXCLK/1) CMU_FXCLK1 (CMU_FXCLK/16) CMU_FXCLK2 (CMU_FXCLK/256) CMU_FXCLK3 (CMU_FXCLK/4096) CMU_FXCLK4 (CMU_FXCLK/65536)
          choice reference GtmTimerUsed: scope=ECU, origin=ChipowerTech, post-build-variant-value=true, set at post-build, destination=GtmTomChannel  # This parameter lists all the GTM timer channels (TOM).
        container GptWakeupConfiguration [0..1]: multiplicity set at post-build, post-build-variant-multiplicity=true, requires-index=true  # Function pointer to callback function (for wakeup notification).
          reference GptWakeupSourceRef: post-build-variant-value=true, set at post-build, requires-symbolic-name-value=true, destination=EcuMWakeupSource  # In case the wakeup-capability is true this value is transmitted to the Ecu State Manager. Enabled only if GptReportWakeupSource and GptEnableWakeup are True
    container GptConfigurationOfOptApiServices  # This container contains all configuration switches for configuring optional API services of the GPT driver.
      boolean GptDeinitApi: set at pre-compile, default-value=false  # Adds / removes the service Gpt_DeInit() from the code.
      boolean GptEnableDisableNotificationApi: set at pre-compile, default-value=false  # Adds / removes the services Gpt_EnableNotification() and Gpt_DisableNotification from the code.
      boolean GptTimeElapsedApi: set at pre-compile, default-value=false  # Adds / removes the service Gpt_GetTimeElapsed() from the code
      boolean GptTimeRemainingApi: set at pre-compile, default-value=false  # Adds / removes the service Gpt_GetTimeRemaining() from the code.
      boolean GptVersionInfoApi: set at pre-compile, default-value=false  # Adds / removes the service Gpt_GetVersionInfo() from the code.
      boolean GptWakeupFunctionalityApi: set at pre-compile, default-value=false  # Adds / removes the services Gpt_SetMode(), Gpt_EnableWakeup() Gpt_DisableWakeup() and Gpt_CheckWakeup() from the code.
    container GptDriverConfiguration  # This container contains the module-wide configuration (parameters) of the GPT Driver
      boolean GptDevErrorDetect: set at pre-compile, default-value=false  # Switches the Default Error Tracer (Det) detection and notification ON or OFF.
      boolean GptSafetyErrorDetect: origin=ChipowerTech, set at pre-compile, default-value=true  # Switches the Safety Error detection ON or OFF.
      boolean GptPredefTimer100us32bitEnable: scope=ECU, set at pre-compile, default-value=false  # Enables/disables the GPT Predef Timer 100?s32bit.
      enumeration GptPredefTimer1usEnablingGrade: {GPT_PREDEF_TIMER_1US_16BIT_ENABLED, GPT_PREDEF_TIMER_1US_16_24BIT_ENABLED, GPT_PREDEF_TIMER_1US_16_24_32BIT_ENABLED, GPT_PREDEF_TIMER_1US_DISABLED}, scope=ECU, set at pre-compile, default-value=GPT_PREDEF_TIMER_1US_DISABLED  # Specifies the grade of enabling the GPT Predef Timers with 1?s tick duration.
      boolean GptReportWakeupSource: set at pre-compile, default-value=false  # Enables/Disables wakeup source reporting.
      reference GptEcucPartitionRef [0..*]: scope=ECU, multiplicity set at pre-compile, post-build-variant-multiplicity=true, post-build-variant-value=true, set at pre-compile, destination=EcucPartition  # Maps the GPT driver to zero or multiple ECUC partitions to make the driver API available in the according partition. Depending on the addressed timer resource the interfaces operate as follows: Tags: atp.Status=draft
      reference GptKernelEcucPartitionRef [0..1]: scope=ECU, multiplicity set at pre-compile, post-build-variant-multiplicity=true, post-build-variant-value=true, set at pre-compile, destination=EcucPartition  # Maps the GPT kernel to zero or one ECUC partitions to assign the driver kernel to a certain core. The ECUC partition referenced is a subset of the ECUC partitions where the GPT driver is mapped to. Tags: atp.Status=draft
      container GptClockReferencePoint [1..256]: multiplicity set at pre-compile, requires-index=true  # This container contains the reference point information of the clock source required by the GPT module, which is referenced from the MCU module.
        choice reference GptClockReference: set at pre-compile, destination=[McuClockReferencePoint, CmuClockReferencePoint]  # Reference to a container of the type McuClockReferencePoint, to select an input clock.
    container CommonPublishedInformation  # Common container, aggregated by all modules. It contains published information about vendor and versions.
      integer ArReleaseMajorVersion: 4..4, origin=ChipowerTech, set at published-information, default-value=4  # Major version number of AUTOSAR specification on which the appropriate implementation is based on.
      integer ArReleaseMinorVersion: 0..255, origin=ChipowerTech, set at published-information, default-value=4  # Minor version number of AUTOSAR specification on which the appropriate implementation is based on.
      integer ArReleaseRevisionVersion: 0..255, origin=ChipowerTech, set at published-information, default-value=0  # Revision version number of AUTOSAR specification on which the appropriate implementation is based on.
      integer ModuleId: 100..100, origin=ChipowerTech, set at published-information, default-value=100  # Module ID of this module from Module List. Note: Implementation Specific Parameter
      integer SwMajorVersion: 1..255, origin=ChipowerTech, set at published-information, default-value=1  # Major version number of the vendor specific implementation of the module. The numbering is vendor specific. Note: Implementation Specific Parameter
      integer SwMinorVersion: 0..255, origin=ChipowerTech, set at published-information, default-value=2  # Minor version number of the vendor specific implementation of the module. The numbering is vendor specific. Note: Implementation Specific Parameter
      integer SwPatchVersion: 0..255, origin=ChipowerTech, set at published-information, default-value=0  # Patch level version number of the vendor specific implementation of the module. The numbering is vendor specific. Note: Implementation Specific Parameter
      integer VendorId: 175..175, origin=ChipowerTech, set at published-information, default-value=175  # Vendor ID of the dedicated implementation of this module according to the AUTOSAR vendor list. Note: Implementation Specific Parameter
