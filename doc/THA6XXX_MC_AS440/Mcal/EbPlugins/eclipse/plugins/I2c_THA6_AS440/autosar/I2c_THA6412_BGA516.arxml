AUTOSAR XML (schema 00046)
package /THA6_AS440_FuSa
  ecuc definition collection I2c_EcuParameterDefinition: module=I2c
  module definition I2c [0..*]: post-build-variant-support=true, variants post-build  # Configuration of the I2c (I2c driver) module.
    container I2cGeneral  # This container contains the parameters related to each I2c Driver Unit.
      boolean I2cDevErrorDetect: set at pre-compile, default-value=false  # Switches the Default Error Tracer (Det) detection and notification ON or OFF.
      boolean I2cDeInitApi: set at pre-compile, default-value=false  # Adds / removes the service I2c_DeInit() from the code.
      integer I2cTimeoutDuration: 0..4294967295, set at pre-compile, default-value=65535  # Specifies the maximum number of loops for blocking function until a timeout is raised in short term wait loops
      boolean I2cVersionInfoApi: set at pre-compile, default-value=false  # Switches the I2c_GetVersionInfo function ON or OFF.
      integer I2cIndex: 0..255, set at pre-compile, default-value=0  # Specifies the InstanceId of this module instance. If only one instance is present it shall have the Id 0.
    container I2cGlobalConfig  # This container contains the global configuration parameter of the I2c driver.
      container I2cChannel [1..2]: multiplicity set at pre-compile, requires-index=true  # This container contains the configuration (parameters) of the I2c Controller(s).
        enumeration I2cHwUnit: {I2C0, I2C1}, set at pre-compile, default-value=I2C0  # This parameter selects the SDA and SCL lines for the peripheral.
        integer I2cChannelId: 0..65535, set at pre-compile, default-value=1  # Identifies the I2c channel.
        enumeration I2cBusSpeed: {STANDARD_MODE, FAST_MODE, FASTPLUS_MODE, HIGHSPEED_MODE}, post-build-variant-value=true, set at post-build, default-value=STANDARD_MODE  # This parameter defines the data transfer speed of the external device.
        enumeration I2cDutyCycle: {RATIO_16_9, RATIO_2_1}, post-build-variant-value=true, set at post-build, default-value=RATIO_16_9  # Duty cycle in fast mode or fast plus mode.
        boolean I2cNotification: post-build-variant-value=true, set at post-build, default-value=false  # Specifies whether to enable error status notification
        function name I2cPacketEndNotification [0..1]: multiplicity set at post-build, post-build-variant-multiplicity=true, post-build-variant-value=true, set at post-build, default-value=NULL_PTR  # This parameter is a reference to a notification function.
    container CommonPublishedInformation  # Common container, aggregated by all modules. It contains published information about vendor and versions.
      integer ArReleaseMajorVersion: 0..255, origin=ChipowerTech, set at published-information, default-value=4  # Major version number of AUTOSAR specification on which the appropriate implementation is based on.
      integer ArReleaseMinorVersion: 0..255, origin=ChipowerTech, set at published-information, default-value=4  # Minor version number of AUTOSAR specification on which the appropriate implementation is based on.
      integer ArReleaseRevisionVersion: 0..255, origin=ChipowerTech, set at published-information, default-value=0  # Revision version number of AUTOSAR specification on which the appropriate implementation is based on.
      integer ModuleId: 0..255, origin=ChipowerTech, set at published-information, default-value=255  # Module ID of this module from Module List.
      integer SwMajorVersion: 0..255, origin=ChipowerTech, set at published-information, default-value=1  # Major version number of the vendor specific implementation of the module. The numbering is vendor specific.
      integer SwMinorVersion: 0..255, origin=ChipowerTech, set at published-information, default-value=2  # Minor version number of the vendor specific implementation of the module. The numbering is vendor specific.
      integer SwPatchVersion: 0..255, origin=ChipowerTech, set at published-information, default-value=0  # Patch level version number of the vendor specific implementation of the module. The numbering is vendor specific.
      integer VendorId: 175..175, origin=ChipowerTech, set at published-information, default-value=175  # Vendor ID of the dedicated implementation of this module according to the AUTOSAR vendor list.
