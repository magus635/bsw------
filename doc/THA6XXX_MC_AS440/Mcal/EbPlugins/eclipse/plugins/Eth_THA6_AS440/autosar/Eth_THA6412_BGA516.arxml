AUTOSAR XML (schema 00046)
package /THA6_AS440_FuSa
  ecuc definition collection Eth_EcuParameterDefinition: module=Eth
  module definition Eth [0..*]: post-build-variant-support=true, refined-module-def=Eth, variants post-build  # Configuration of the Eth (Ethernet Driver) module.
    container EthConfigSet  # This container contains the configuration parameters and sub containers of the AUTOSAR Eth module.
      container EthCtrlConfig  # Configuration of the individual controller
        boolean EthCtrlEnableMii: set at pre-compile, default-value=true  # Enables / Disables Media Independent Interface (MII) for transceiver access
        boolean EthCtrlEnableLoopback: origin=ChipowerTech, post-build-variant-value=true, set at post-build, default-value=false  # Enables / Disables Loopback for test
        boolean EthCtrlEnableRxInterrupt: set at pre-compile, default-value=false  # Enables / Disables receive interrupt
        boolean EthCtrlEnableTxInterrupt: set at pre-compile, default-value=false  # Enables / Disables transmit interrupt
        enumeration EthOpMode: {HALFDUPLEX, FULLDUPLEX}, origin=ChipowerTech, post-build-variant-value=true, set at post-build, default-value=FULLDUPLEX  # This parameter selects Half/Full Duplex ethernet operations .
        integer EthSkewTxClockDelay: 0..69, origin=ChipowerTech, post-build-variant-value=true, set at post-build, default-value=0  # Specifies the transmit clock delay in RGMII mode for transmit skew timing.
        integer EthSkewRxClockDelay: 0..69, origin=ChipowerTech, post-build-variant-value=true, set at post-build, default-value=0  # Specifies the receive clock delay in RGMII mode for receive skew timing.
        integer EthCtrlIdx: 0..255, scope=ECU, set at pre-compile, symbolic-name-value=true, default-value=0  # Specifies the instance ID of the configured controller.
        enumeration EthCtrlMacLayerSpeed [0..1]: {ETH_MAC_LAYER_SPEED_10M, ETH_MAC_LAYER_SPEED_100M, ETH_MAC_LAYER_SPEED_1G}, scope=ECU, multiplicity set at post-build, post-build-variant-multiplicity=true, post-build-variant-value=true, set at post-build, default-value=ETH_MAC_LAYER_SPEED_100M  # Defines the baud rate of the MAC layer.
        enumeration EthCtrlMacLayerSubType [0..1]: {REDUCED, STANDARD}, scope=ECU, multiplicity set at post-build, post-build-variant-multiplicity=true, post-build-variant-value=true, set at post-build, default-value=REDUCED  # Defines the MAC layer subtype of a switch port
        enumeration EthCtrlMacLayerType: {ETH_MAC_LAYER_TYPE_XMII, ETH_MAC_LAYER_TYPE_XGMII}, scope=ECU, post-build-variant-value=true, set at post-build, default-value=ETH_MAC_LAYER_TYPE_XMII  # Defines the MAC layer type of the ethernet controller.
        string EthCtrlPhyAddress [0..1]: multiplicity set at post-build, post-build-variant-multiplicity=true, post-build-variant-value=true, set at post-build, default-value=00:DE:AD:00:00:02, max-length=17, min-length=17  # Specifies the unique 48-bit physical address (MAC address) of the controller in network byte order.
        reference EthCtrlEcucPartitionRef [0..1]: scope=ECU, multiplicity set at pre-compile, post-build-variant-multiplicity=true, post-build-variant-value=true, set at pre-compile, destination=EcucPartition  # Maps the Ethernet controller to zero or one ECUC partitions. The ECUC partition referenced is a subset of the ECUC partitions where the Ethernet driver is mapped to. Tags: atp.Status=draft
        container EthCtrlConfigEgress  # Configuration of one Ethernet controler egress behavior.
          reference EthCtrlConfigEgressLastSchedulerRef: post-build-variant-value=true, set at post-build, destination=EthCtrlConfigScheduler  # Reference to the scheduler which is the last in the egress structure.
          container EthCtrlConfigEgressFifo [0..4]: multiplicity set at pre-compile, requires-index=true  # Represents a Fifo at the egress side.
            integer EthCtrlConfigEgressFifoBufLenByte: 0..1522, set at pre-compile, default-value=64  # Length of Fifo elements in bytes. Limits the maximum transmit buffer length (frame length) in bytes. Maximal frame payload is equal to the configured value decreased by 14 bytes that are used for the frame header.
            integer EthCtrlConfigEgressFifoBufTotal: 0..8191, set at pre-compile, default-value=16  # Fifo buffer count.
            integer EthCtrlConfigEgressFifoIdx: 0..3, set at pre-compile, default-value=0  # Egress Fifo index.
            integer EthCtrlConfigEgressFifoPriorityAssignment [0..8]: 0..7, multiplicity set at post-build, post-build-variant-multiplicity=true, post-build-variant-value=true, requires-index=true, set at post-build, default-value=0  # Message egress prority assignment.
          container EthCtrlConfigScheduler  # Controller Configuration Scheduler : Represents a Scheduler on the egress side.
            enumeration EthCtrlConfigSchedulerAlgorithm: {ETH_SCHEDULER_STRICT_PRIORITY, ETH_SCHEDULER_WEIGHTED_ROUND_ROBIN}, origin=ChipowerTech, post-build-variant-value=true, set at post-build, default-value=ETH_SCHEDULER_STRICT_PRIORITY  # Configures the Tx scheduling algorithm at the MTL layer.
            container EthCtrlConfigSchedulerPredecessor [1..4]: multiplicity set at post-build, post-build-variant-multiplicity=true, requires-index=true  # Controller Configuration Scheduler Predecessors: Defines an ordered list of predecessors for this scheduler.
              integer EthCtrlConfigSchedulerPredecessorOrder: 0..18446744073709551615, post-build-variant-value=true, set at post-build, default-value=0  # Defines the order of the scheduler predecessors.
              choice reference EthCtrlConfigSchedulerPredecessorRef: post-build-variant-value=true, set at post-build, destination=[EthCtrlConfigEgressFifo, EthCtrlConfigScheduler, EthCtrlConfigShaper]  # Choice reference to the scheduler predecessor.
          container EthCtrlConfigShaper [0..3.0]: multiplicity set at post-build, post-build-variant-multiplicity=true, requires-index=true  # Controller Configuration Shaper : Represents a Shaper an the egress side.
            integer EthCtrlConfigShaperIdleSlope [0..1]: 0..1000000000, multiplicity set at pre-compile, post-build-variant-value=true, set at post-build, default-value=0  # Defines the increase of credit in bits per second for the AVB shaper.
            integer EthCtrlConfigShaperHiCredit: 0..131072, origin=ChipowerTech, post-build-variant-value=true, set at post-build, default-value=0  # The maximum value that can be accumulated in the credit parameter.
            integer EthCtrlConfigShaperLoCredit: 0..131072, origin=ChipowerTech, post-build-variant-value=true, set at post-build, default-value=0  # The minimum value that can be accumulated in the credit parameter.
            reference EthCtrlConfigShaperPredecessorFifoRef: post-build-variant-value=true, set at post-build, destination=EthCtrlConfigEgressFifo  # Reference to the fifo which is the predecessor for this shaper.
          container EthCtrlConfigDMAArbitration  # Contains the configuration of the arbitration for the transmit DMA channels.
            enumeration EthCtrlConfigDMAArbitrationAlgorithm: {ETH_DMA_ARBITRATION_FIXED_PRIORITY, ETH_DMA_ARBITRATION_WEIGHTED_ROUND_ROBIN, ETH_DMA_ARBITRATION_WEIGHTED_STRICT_PRIORITY}, origin=ChipowerTech, post-build-variant-value=true, set at post-build, default-value=ETH_DMA_ARBITRATION_FIXED_PRIORITY  # Configures the arbitration algorithm for the Tx DMA channels.
            container EthCtrlConfigDMAWeightAssignment [0..4]: multiplicity set at post-build, post-build-variant-multiplicity=true, requires-index=true  # Configuration of the Tx DMA weights mapped to the egress FIFOs.
              integer EthCtrlConfigDMAArbitrationWeight: 1..8, origin=ChipowerTech, post-build-variant-value=true, set at post-build, default-value=1  # Specifies the weight to be configured for a DMA channel that is mapped to an egress FIFO.
              reference EthCtrlConfigDMAEgressFifoRef: origin=ChipowerTech, post-build-variant-value=true, set at post-build, destination=EthCtrlConfigEgressFifo  # Reference to the configured egress FIFO.
        container EthCtrlConfigIngress  # Controller Configuration Ingress : Configuration of one Ethernet controler ingress behavior.
          reference EthCtrlConfigIngressUntaggedPktsFifoRef: origin=ChipowerTech, post-build-variant-value=true, set at post-build, destination=EthCtrlConfigIngressFifo  # Reference to the ingress FIFO to which all the untagged Rx packets are to be routed.
          container EthCtrlConfigIngressFifo [0..4]: multiplicity set at pre-compile, requires-index=true  # Controller Configuration Ingress : Represents a Fifo at the ingress side.
            integer EthCtrlConfigIngressFifoBufLenByte: 0..1522, set at pre-compile, default-value=64  # Length of Fifo elements in bytes. Limits the maximum receive buffer length (frame length) in bytes. To compute the value: the frame payload length shall be extended by 14 bytes for frame header and 4 bytes for the frame CRC, then it shall be increased to a multiple of 16 bytes.
            integer EthCtrlConfigIngressFifoBufTotal: 0..65535, set at pre-compile, default-value=16  # Fifo buffer count.
            integer EthCtrlConfigIngressFifoIdx: 0..3, set at pre-compile, default-value=0  # Ingress Fifo index.
            integer EthCtrlConfigIngressFifoPriorityAssignment [0..8]: 0..7, multiplicity set at post-build, post-build-variant-multiplicity=true, post-build-variant-value=true, requires-index=true, set at post-build, default-value=0  # Message ingress priority assignment.
        container EthDemEventParameterRefs [0..1]: multiplicity set at post-build, post-build-variant-multiplicity=true  # Container for the references to DemEventParameter elements which shall be invoked using the API Dem_ReportErrorStatus in case the corresponding error occurs. The EventId is taken from the referenced DemEventParameter's DemEventId value. The standardized errors are provided in the container and can be extended by vendor specific error references.
          reference ETH_E_ACCESS [0..1]: multiplicity set at post-build, post-build-variant-multiplicity=true, post-build-variant-value=true, set at post-build, requires-symbolic-name-value=true, destination=DemEventParameter  # Reference to the DemEventParameter which shall be issued when the error "Controller access failed" has occured.
          reference ETH_E_ALIGNMENT [0..1]: multiplicity set at post-build, post-build-variant-multiplicity=true, post-build-variant-value=true, set at post-build, requires-symbolic-name-value=true, destination=DemEventParameter  # Reference to the DemEventParameter which shall be issued when the error "Alignment Error" has occured.
          reference ETH_E_CRC [0..1]: multiplicity set at post-build, post-build-variant-multiplicity=true, post-build-variant-value=true, set at post-build, requires-symbolic-name-value=true, destination=DemEventParameter  # Reference to the DemEventParameter which shall be issued when the error "CRC Failure" has occured.
          reference ETH_E_LATECOLLISION [0..1]: multiplicity set at post-build, post-build-variant-multiplicity=true, post-build-variant-value=true, set at post-build, requires-symbolic-name-value=true, destination=DemEventParameter  # Reference to the DemEventParameter which shall be issued when the error "Late Collisions" has occured.
          reference ETH_E_MULTIPLECOLLISION [0..1]: multiplicity set at post-build, post-build-variant-multiplicity=true, post-build-variant-value=true, set at post-build, requires-symbolic-name-value=true, destination=DemEventParameter  # Reference to the DemEventParameter which shall be issued when the error "Multiple Collisions" has occured.
          reference ETH_E_OVERSIZEFRAME [0..1]: multiplicity set at post-build, post-build-variant-multiplicity=true, post-build-variant-value=true, set at post-build, requires-symbolic-name-value=true, destination=DemEventParameter  # Reference to the DemEventParameter which shall be issued when the error "Oversized Frame" has occured.
          reference ETH_E_RX_FRAMES_LOST [0..1]: multiplicity set at post-build, post-build-variant-multiplicity=true, post-build-variant-value=true, set at post-build, requires-symbolic-name-value=true, destination=DemEventParameter  # Reference to the DemEventParameter which shall be issued when the error "receive frames lost" has occured.
          reference ETH_E_SINGLECOLLISION [0..1]: multiplicity set at post-build, post-build-variant-multiplicity=true, post-build-variant-value=true, set at post-build, requires-symbolic-name-value=true, destination=DemEventParameter  # Reference to the DemEventParameter which shall be issued when the error "Single Collisions" has occured.
          reference ETH_E_UNDERSIZEFRAME [0..1]: multiplicity set at post-build, post-build-variant-multiplicity=true, post-build-variant-value=true, set at post-build, requires-symbolic-name-value=true, destination=DemEventParameter  # Reference to the DemEventParameter which shall be issued when the error "Undersized Frame" has occured.
    container EthGeneral  # General configuration of Ethernet Driver module
      boolean EthDevErrorDetect: set at pre-compile, default-value=false  # Switches the Default Error Tracer (Det) detection and notification ON or OFF.
      boolean EthSafetyErrorDetect: origin=ChipowerTech, set at pre-compile, default-value=true  # Switches the Safety Error detection ON or OFF.
      boolean EthGetDropCountApi: set at pre-compile, default-value=false  # Enables / Disables Eth_GetDropCount API.
      boolean EthGetEtherStatsApi: set at pre-compile, default-value=false  # Enables / Disables Eth_GetEtherStats API.
      boolean EthGetTxErrorCounterValuesApi: set at pre-compile, default-value=false  # Enables/Disables Eth_GetTxErrorCounterValues API.
      boolean EthGetTxStatsApi: set at pre-compile, default-value=false  # Enables / Disables Eth_GetTxStats API.
      boolean EthGlobalTimeSupport: set at pre-compile, default-value=false  # Enables/Disables the GlobalTime APIs used amongst others by Global Time Synchronization over Ethernet.
      integer EthIndex: 0..255, set at pre-compile, default-value=0  # Specifies the InstanceId of this module instance. If only one instance is present it shall have the Id 0.
      float EthMainFunctionPeriod: 0.0..INF, set at pre-compile, default-value=0.005  # Specifies the period of main function Eth_MainFunction in seconds. Ethernet driver does not require this information but the BSW scheduler.
      integer EthMaxCtrlsSupported: 1..1, set at pre-compile, default-value=1  # Limits the total number of supported controllers.
      boolean EthVersionInfoApi: set at pre-compile, default-value=false  # Enables / Disables version info API
      reference EthEcucPartitionRef [0..*]: scope=ECU, multiplicity set at pre-compile, post-build-variant-multiplicity=true, post-build-variant-value=true, set at pre-compile, destination=EcucPartition  # Maps the Ethernet driver to zero or multiple ECUC partitions to make the modules API available in this partition. The Ethernet driver will operate as an independent instance in each of the partitions. Tags: atp.Status=draft
      container EthCtrlOffloading  # Configuration of hardware offloading features.
        boolean EthCtrlEnableOffloadChecksumICMP: set at pre-compile, default-value=false  # Enables / Disables hardware offloading for ICMP checksums.
        boolean EthCtrlEnableOffloadChecksumIPv4: set at pre-compile, default-value=false  # Enables / Disables hardware offloading for IPv4 checksums.
        boolean EthCtrlEnableOffloadChecksumTCP: set at pre-compile, default-value=false  # Enables / Disables hardware offloading for TCP checksums.
        boolean EthCtrlEnableOffloadChecksumUDP: set at pre-compile, default-value=false  # Enables / Disables hardware offloading for UDP checksums.
    container CommonPublishedInformation  # Common container, aggregated by all modules. It contains published information about vendor and versions.
      integer ArReleaseMajorVersion: 4..4, origin=ChipowerTech, set at published-information, default-value=4  # Major version number of AUTOSAR specification on which the appropriate implementation is based on.
      integer ArReleaseMinorVersion: 4..4, origin=ChipowerTech, set at published-information, default-value=4  # Minor version number of AUTOSAR specification on which the appropriate implementation is based on.
      integer ArReleaseRevisionVersion: 0..0, origin=ChipowerTech, set at published-information, default-value=0  # Revision version number of AUTOSAR specification on which the appropriate implementation is based on.
      integer ModuleId: 88..88, origin=ChipowerTech, set at published-information, default-value=88  # Module ID of this module from Module List. Note: Implementation Specific Parameter
      integer SwMajorVersion: 1..255, origin=ChipowerTech, set at published-information, default-value=1  # Major version number of the vendor specific implementation of the module. The numbering is vendor specific. Note: Implementation Specific Parameter
      integer SwMinorVersion: 0..255, origin=ChipowerTech, set at published-information, default-value=2  # Minor version number of the vendor specific implementation of the module. The numbering is vendor specific. Note: Implementation Specific Parameter
      integer SwPatchVersion: 0..255, origin=ChipowerTech, set at published-information, default-value=0  # Patch level version number of the vendor specific implementation of the module. The numbering is vendor specific. Note: Implementation Specific Parameter
      integer VendorId: 175..175, origin=ChipowerTech, set at published-information, default-value=175  # Vendor ID of the dedicated implementation of this module according to the AUTOSAR vendor list. Note: Implementation Specific Parameter
