AUTOSAR XML (schema 00046)
package /THA6_AS440_FuSa
  ecuc definition collection Dsadc_EcuParameterDefinition: module=Dsadc
  module definition Dsadc [0..*]: post-build-variant-support=true, variants post-build  # Configuration of the Dsadc (Delta Sigma Analog Digital Conversion) module.
    container DsadcDemEventParameterRefs [0..1]: multiplicity set at pre-compile  # Container for the references to DemEventParameter elements which shall be invoked using the API Dem_ReportErrorStatus API in case the corresponding error occurs. The EventId is taken from the referenced DemEventParameter's DemEventId value. The standardized errors are provided in the container and can be extended by vendor specific error references.
      reference DSADC_E_FIFO_FAILURE [0..1]: multiplicity set at pre-compile, origin=ChipowerTech, set at pre-compile, requires-symbolic-name-value=true, destination=DemEventParameter  # Reference to configured DEM event to report DSADC "FIFO write/read failure". If the reference is not configured the error shall not be reported.
    container DsadcConfigSet  # This container contains the configuration parameters and sub containers of the Dsadc module.
      reference DsadcAnalogClockSource: origin=ChipowerTech, post-build-variant-value=true, set at post-build, destination=McuClockReferencePoint  # This parameter defines DSADC module clock(hz) This parameter is reference from MCU DSADC clock, configure DSADC clock first in MCU Container
      container DsadcChannel [1..10]: multiplicity set at pre-compile, requires-index=true  # This container contains the configuration (parameters) of the Dsadc channels.
        integer DsadcChannelId: 0..9, origin=ChipowerTech, set at pre-compile, symbolic-name-value=true, default-value=0  # Unique identifier(Logical identifier) for each channel.
        enumeration DsadcHwUnitId: {DSADC0, DSADC1, DSADC2, DSADC3, DSADC4, DSADC5, DSADC6, DSADC7, DSADC8, DSADC9}, origin=ChipowerTech, set at pre-compile, default-value=DSADC0  # Numeric ID of the HW Unit. This symbolic name allows accessing HW Unit data.
        enumeration DsadcResultHandlingImplementation: {DSADC_INTERRUPT_MODE, DSADC_POLLING_MODE, DSADC_DMA_MODE}, origin=ChipowerTech, set at pre-compile, default-value=DSADC_INTERRUPT_MODE  # Determines the conversion result handling method for each channel . DSADC_INTERRUPT_MODE: Conversion results are transferred in the ISR. If used it is necessary to configure the interrupt of this HW unit in the INTC module. DSADC_DMA_MODE: Conversion results are transferred using a DMA channel.If used it is necessary to configure the DMA channel of this HW unit in the DMA module. DSADC_POLLING_MODE: Conversion results are trans-ferred using API Dsadc_GetChannelStatus(). If used, Dsadc_GetChannelStatus() needs to be called periodically.
        boolean DsadcChAuxiliaryFilterChainEnable: origin=ChipowerTech, set at pre-compile, default-value=false  # Enables / Disables the auxiliary filter chain for each channel. <h1>Note</h1> This parameter is available only if the parameter DsadcAuxilia-ryFilterChainEnable is set to true.
        boolean DsadcChAuxFilterResultAcquisitionEnable [0..1]: multiplicity set at post-build, origin=ChipowerTech, post-build-variant-multiplicity=true, post-build-variant-value=true, set at post-build, default-value=false  # Enables / Disables the auxiliary filter result acquisition for each channel. <h1>Note</h1> This parameter is available only is the parameter DsadcChAux-iliaryFilterChainEnable is set to true and the parameter Dsad-cAccessMode is set to DSADC_ACCESS_MODE_SINGLE
        enumeration DsadcAccessMode: {DSADC_ACCESS_MODE_SINGLE, DSADC_ACCESS_MODE_STREAMING}, origin=ChipowerTech, post-build-variant-value=true, set at post-build, default-value=DSADC_ACCESS_MODE_SINGLE  # Access mode to channel conversion results. DSADC_ACCESS_MODE_STREAMING: Streaming buffer access mode. DSADC_ACCESS_MODE_SINGLE: Single access mode.
        enumeration DsadcStreamBufferMode: {DSADC_STREAM_BUFFER_CIRCULAR, DSADC_STREAM_BUFFER_LEANER}, origin=ChipowerTech, post-build-variant-value=true, set at post-build, default-value=DSADC_STREAM_BUFFER_CIRCULAR  # Configure streaming buffer as "linear buffer" (i.e. the DSADC Driver stops the conversion as soon as the stream buffer is full) or as "circular buffer" (wraps around if the end of the stream buffer is reached). DSADC_STREAM_BUFFER_CIRCULAR: The DSADC Driver continues the conversion even if the stream buffer is full (number of samples reached) by wrapping around the stream buffer itself. DSADC_STREAM_BUFFER_LEANER: The DSADC Driver stops the conversion as soon as the stream buffer is full (number of samples reached).
        enumeration DsadcTriggerMode: {DSADC_TRIGG_MODE_CONTINUOUS, DSADC_TRIGG_MODE_EXTERNAL}, origin=ChipowerTech, post-build-variant-value=true, set at post-build, default-value=DSADC_TRIGG_MODE_CONTINUOUS  # Type of source event that starts a channel conversion. DSADC_TRIGG_MODE_CONTINUOUS: Conversion result will be trans-ferred to the result buffer if the new result is generated. DSADC_TRIGG_MODE_EXTERNAL: Conversion result will be transferred to the result buffer if the external hardware event is triggered.
        boolean DsadcChTimestampEnable: origin=ChipowerTech, post-build-variant-value=true, set at post-build, default-value=false  # Enables / Disables the timestamp for each channel. <h1>Note</h1> This parameter is available only if the parameter DsadcAccess-Mode is set to DSADC_ACCESS_MODE_SINGLE.
        enumeration DsadcGateActiveLevel: {DSADC_GATE_HIGH_LEVEL, DSADC_GATE_LOW_LEVEL}, origin=ChipowerTech, post-build-variant-value=true, set at post-build, default-value=DSADC_GATE_HIGH_LEVEL  # Determines the active level for the trigger gate single of an external event. <h1>Note</h1> This parameter is available only if the parameter DsadcTrigger-Mode is set to DSADC_TRIGG_MODE_EXTERNAL.
        integer DsadcStreamingNumSamples: 1..255, origin=ChipowerTech, post-build-variant-value=true, set at post-build, default-value=1  # Number of DSADC values to be acquired in streaming access mode. Note: in single access mode this parameter assumes value 1, since only one sample per channel is processed.
        function name DsadcNewResultNotification [0..1]: multiplicity set at post-build, post-build-variant-multiplicity=true, post-build-variant-value=true, set at post-build, default-value=NULL_PTR  # Callback function for each channel, which will be called when the new conversion result of the channel is generated. Note 1. This parameter is available only if the parameter DsadcGrpNotifCapability is set to true. 2. This parameter is available only if the parameter DsadcResultHandlingImplementation is set to 'DSADC_INTERRUPT_MODE'. 3. Notification function must be no return value(type void) and one parameter and the type is Dsadc_ConvChannelType.
        function name DsadcBufferFullNotification [0..1]: multiplicity set at post-build, post-build-variant-multiplicity=true, post-build-variant-value=true, set at post-build, default-value=NULL_PTR  # Callback function for each channel, which will be called when the conversion result buffer is full in the streaming access mode. Note 1. This parameter is available only if the parameter DsadcGrpNotifCapability is set to true. 2. This parameter is available only if the parameter DsadcResultHandlingImplementation is set to 'DSADC_INTERRUPT_MODE'. 3. This parameter is available only if the parameter DsadcAccessMode is set to 'DSADC_ACCESS_MODE_STREAMING'. 4. Notification function must be no return value(type void) and no formal parameters.
        function name DsadcLimitCheckingNotification [0..1]: multiplicity set at post-build, post-build-variant-multiplicity=true, post-build-variant-value=true, set at post-build, default-value=NULL_PTR  # Callback function for each channel, which will be called when the conversion result of the auxiliary filter is below the lower limit or above the upper limit. Note 1. This parameter is available only if the parameter DsadcGrpNotifCapability is set to true. 2. This parameter is available only if the parameter DsadcAuxLimitCheckingEnable is set to true. 3. This parameter is available only if the parameter DsadcChAuxiliaryFilterChainEnable is set to true. 4. This parameter is available only if the parameter DsadcResultHandlingImplementation is set to 'DSADC_INTERRUPT_MODE' or 'DSADC_POLLING_MODE'. 5. Notification function must be no return value(type void) and one parameter and the type is Dsadc_LimitCheckingEventType.
        container DsadcModulatorConfig: multiplicity set at pre-compile, requires-index=true  # This container contains the modulator configuration in each channel.
          boolean DsadcDitheringEnable: origin=ChipowerTech, post-build-variant-value=true, set at post-build, default-value=false  # Enables / Disables the availability of internal dithering functionality for each modulator. true: Internal dithering functionality enabled. false: Internal dithering functionality disabled.
          enumeration DsadcInputGain: {DSADC_INPUT_GAIN_0dB, DSADC_INPUT_GAIN_6dB, DSADC_INPUT_GAIN_12dB}, origin=ChipowerTech, post-build-variant-value=true, set at post-build, default-value=DSADC_INPUT_GAIN_0dB  # Determines the gain factor for the analog input signal.
          enumeration DsadcInputMuxChangeMode: {DSADC_INPUTMUX_CHANGE_PRESET, DSADC_INPUTMUX_CHANGE_SINGLE_STEP}, origin=ChipowerTech, post-build-variant-value=true, set at post-build, default-value=DSADC_INPUTMUX_CHANGE_PRESET  # Determines the control mechanism for input multiplexer. It defines the action to be taken for the input multiplexer upon a trigger event for pin selection. DSADC_INPUTMUX_CHANGE_PRESET: Do not changed. DSADC_INPUTMUX_CHANGE_SINGLE_STEP: Change to another input pin. Note This parameter can only be set to 'DSADC_INPUTMUX_CHANGE_SINGLE_STEP' when the parameter DsadcTriggerMode is set to 'DSADC_TRIGG_MODE_EXTERNAL'.
          enumeration DsadcInputMuxControlMode [0..1]: {DSADC_INPUTMUX_CTRL_SW, DSADC_INPUTMUX_CTRL_RISING_EDGE, DSADC_INPUTMUX_CTRL_FALLING_EDGE, DSADC_INPUTMUX_CTRL_BOTH_EDGES}, multiplicity set at post-build, origin=ChipowerTech, post-build-variant-multiplicity=true, post-build-variant-value=true, set at post-build, default-value=DSADC_INPUTMUX_CTRL_RISING_EDGE  # Determines the control condition for a trigger event to change the input multiplexer. DSADC_INPUTMUX_CTRL_SW: Input multiplexer controlled by software.(Not supported by Dsadc driver) DSADC_INPUTMUX_CTRL_RISING_EDGE: Input multiplexer controlled by rising edge of trigger event. DSADC_INPUTMUX_CTRL_FALLING_EDGE: Input multiplexer controlled by falling edge of trigger event. DSADC_INPUTMUX_CTRL_BOTH_EDGES: Input multiplexer controlled by both the rising edge and falling edge of trigger event. Note This parameter is only available only if the parameter DsadcInputMuxChangeMode is set to 'DSADC_INPUTMUX_CHANGE_SINGLE_STEP'.
          enumeration DsadcInputMuxInitPin: {DSADC_INPUT_PIN_A, DSADC_INPUT_PIN_B, DSADC_INPUT_PIN_C, DSADC_INPUT_PIN_D}, origin=ChipowerTech, post-build-variant-value=true, set at post-build, default-value=DSADC_INPUT_PIN_A  # Determines the initial or permanent setting for the input multiplexer.
          enumeration DsadcNegativeInputLine: {DSADC_NEG_INPUT_COMM_MODE_VOLT, DSADC_NEG_INPUT_PIN, DSADC_NEG_DISABLE}, origin=ChipowerTech, post-build-variant-value=true, set at post-build, default-value=DSADC_NEG_INPUT_COMM_MODE_VOLT  # Determines the modulator internal connection of the negative input.
          enumeration DsadcPositiveInputLine: {DSADC_POS_INPUT_COMM_MODE_VOLT, DSADC_POS_INPUT_PIN, DSADC_POS_DISABLE}, origin=ChipowerTech, post-build-variant-value=true, set at post-build, default-value=DSADC_POS_INPUT_COMM_MODE_VOLT  # Determines the modulator internal connection of the positive input.
          enumeration DsadcCommonModeVoltageSelect: {DSADC_COMM_MODE_VOLT_0, DSADC_COMM_MODE_VOLT_1, DSADC_COMM_MODE_VOLT_2, DSADC_COMM_MODE_VOLT_3}, origin=ChipowerTech, post-build-variant-value=true, set at post-build, default-value=DSADC_COMM_MODE_VOLT_0  # Select the common mode voltage level. DSADC_COMM_MODE_VOLT_0: 1/2 * VREF; DSADC_COMM_MODE_VOLT_1: 1/5 * VREF; DSADC_COMM_MODE_VOLT_2: 4/5 * VREF; DSADC_COMM_MODE_VOLT_3: VREF. Note This parameter is only available when either the DsadcNegativeInputLine or the DsadcPositiveInputLine, or both, are set to INPUT_COMM_MODE_VOLT.
        container DsadcDemodulatorConfig: multiplicity set at pre-compile, requires-index=true  # This container contains the configuration parameters of the demodulator in each channel.
          enumeration DsadcResultDisplayMode: {DSADC_RES_MODE_SIGNED}, origin=ChipowerTech, post-build-variant-value=true, set at post-build, default-value=DSADC_RES_MODE_SIGNED  # Determines the result display modes (Singed or Unsigned). Note Only support the Signed result.
          enumeration DsadcTriggerSelect [0..1]: {DSADC_0_GTM_DSADC_TRIGGER0, DSADC_1_GTM_DSADC_TRIGGER1, DSADC_2_GTM_ADC_TRIGGER0, DSADC_3_GTM_ADC_TRIGGER1, DSADC_10_GTM_ADC_TRIGGER2, DSADC_11_GTM_ADC_TRIGGER3, DSADC_12_GTM_DSADC_TRIGGER2, DSADC_13_GTM_DSADC_TRIGGER3, DSADC_4_P33_0_INPUT_TRIGGER, DSADC_5_P33_4_INPUT_TRIGGER, DSADC_4_P33_1_INPUT_TRIGGER, DSADC_5_P33_5_INPUT_TRIGGER, DSADC_4_P33_2_INPUT_TRIGGER, DSADC_5_P33_6_INPUT_TRIGGER, DSADC_4_P02_8_INPUT_TRIGGER, DSADC_5_P00_9_INPUT_TRIGGER, DSADC_4_P02_7_INPUT_TRIGGER, DSADC_5_P00_6_INPUT_TRIGGER, DSADC_4_P02_6_INPUT_TRIGGER, DSADC_5_P00_3_INPUT_TRIGGER, DSADC_4_P01_0_INPUT_TRIGGER, DSADC_5_P00_5_INPUT_TRIGGER, DSADC_4_P01_4_INPUT_TRIGGER, DSADC_5_P01_3_INPUT_TRIGGER, DSADC_4_P01_1_INPUT_TRIGGER, DSADC_5_P01_7_INPUT_TRIGGER, DSADC_4_P01_11_INPUT_TRIGGER, DSADC_5_P01_10_INPUT_TRIGGER, DSADC_6_EXTI_PDOUT0_TRIGGER, DSADC_6_EXTI_PDOUT1_TRIGGER, DSADC_6_EXTI_PDOUT2_TRIGGER, DSADC_6_EXTI_PDOUT3_TRIGGER, DSADC_6_EXTI_PDOUT4_TRIGGER, DSADC_6_EXTI_PDOUT5_TRIGGER, DSADC_6_EXTI_PDOUT6_TRIGGER, DSADC_6_EXTI_PDOUT7_TRIGGER}, multiplicity set at post-build, origin=ChipowerTech, post-build-variant-multiplicity=true, post-build-variant-value=true, set at post-build, default-value=DSADC_0_GTM_DSADC_TRIGGER0  # Determines the modulator internal connection of the positive input. This parameter is available only if the parameter DsadcTriggerMode is set to DSADC_TRIGG_MODE_EXTERNAL.
          container DsadcTimestampConfig [0..1]: multiplicity set at pre-compile, requires-index=true  # This container contains the configuration parameters of the timestamp functionality in each channel.
            integer DsadcTimestampClockDivider: 0..15, origin=ChipowerTech, post-build-variant-value=true, set at post-build, default-value=1  # Frequency divider factor, which defines the frequency of the timestamp clock, which is derived from the peripheral clock. Note f(timestamp) = f(AHB) / (4 + DsadcTimestampClockDivider * 2). Recommended configuration is 1.
            enumeration DsadcTimestampCounterClockSel: {DSADC_TIMESTAMPCLOCKDIVIDER_1, DSADC_TIMESTAMPCLOCKDIVIDER_2, DSADC_TIMESTAMPCLOCKDIVIDER_4, DSADC_TIMESTAMPCLOCKDIVIDER_8}, origin=ChipowerTech, post-build-variant-value=true, set at post-build, default-value=DSADC_TIMESTAMPCLOCKDIVIDER_1  # Determines the divider factor, which defines the clock used for timestamp counter.
            boolean DsadcInputMuxDispEnable: origin=ChipowerTech, post-build-variant-value=true, set at post-build, default-value=false  # Enables /Disables the analog multiplexer display in the timestamp information.
            enumeration DsadcTimestampTrigSignal: {DSADC_TIMESTAMP_TRIG_NONE, DSADC_TIMESTAMP_TRIG_RISING_EDGE, DSADC_TIMESTAMP_TRIG_FALLING_EDGE, DSADC_TIMESTAMP_TRIG_BOTH_EDGES}, origin=ChipowerTech, post-build-variant-value=true, set at post-build, default-value=DSADC_TIMESTAMP_TRIG_NONE  # Determines the external single level to trigger the timestamp. <h1>Note</h1> This parameter can only be set to DSADC_TIMESTAMP_TRIG_NONE when the parameter DsadcTriggerMode is set to DSADC_TRIGG_MODE_CONTINUOUS.
        container DsadcFilterConfig: multiplicity set at pre-compile, requires-index=true  # This container contains the configuration parameters of the filter in each channel.
          boolean DsadcFilterFIR0Enable: origin=ChipowerTech, post-build-variant-value=true, set at post-build, default-value=true  # Enables / Disables the FIR0 filter of the main filter chain.
          integer DsadcFilterFIR0DecimationRate: 1..2, origin=ChipowerTech, post-build-variant-value=true, set at post-build, default-value=1  # Determines the decimation rate of the FIR0 filter. Note This parameter is available only if the parameter DsadcFilterFIR0Enable is set to true.
          integer DsadcFilterFIR0OutputShift: 0..1, origin=ChipowerTech, post-build-variant-value=true, set at post-build, default-value=0  # Determines the FIR0 filter output shift value. FIR0_SF_GAIN = 0.580078125 * 2^DsadcFilterFIR0OutputShift. Note This parameter is available only if the parameter DsadcFilterFIR0Enable is set to true.
          boolean DsadcFilterFIR1Enable: origin=ChipowerTech, post-build-variant-value=true, set at post-build, default-value=true  # Enables / Disables the FIR1 filter of the main filter chain. Note This parameter is available only if the parameter DsadcFilterFIR0Enable is set to true.
          integer DsadcFilterFIR1DecimationRate: 1..2, origin=ChipowerTech, post-build-variant-value=true, set at post-build, default-value=1  # Determines the decimation rate of the FIR0 filter. Note This parameter is available only if the parameter DsadcFilterFIR1Enable is set to true.
          integer DsadcFilterFIR1OutputShift: 0..3, origin=ChipowerTech, post-build-variant-value=true, set at post-build, default-value=0  # Determines the FIR0 filter output shift value. FIR1_SF_GAIN = 0.642578125 * 2^DsadcFilterFIR1OutputShift. Note This parameter is available only if the parameter DsadcFilterFIR1Enable is set to true.
          boolean DsadcFilterCICEnable: origin=ChipowerTech, post-build-variant-value=true, set at post-build, default-value=true  # Enables / Disables the CIC filter of the main filter chain. <h1>Note</h1> This parameter is available only if the parameter DsadcFilterCICEnable is set to true.
          enumeration DsadcFilterCICSelect: {CIC1, CIC2, CIC3, CIC4}, origin=ChipowerTech, post-build-variant-value=true, set at post-build, default-value=CIC1  # Determines the CIC parallel series of the main filter chain. <h1>Note</h1> This parameter is available only if the parameter DsadcFilterCICEnable is set to true.
          integer DsadcFilterCICSamplingFactor: 4..128, origin=ChipowerTech, post-build-variant-value=true, set at post-build, default-value=128  # Description Determines the decimation factor for the CIC filter of the main filter chain. <h1>Note</h1> This parameter is available only if the parameter DsadcFilterCICEnable is set to true.
          enumeration DsadcFilterOffsetComp: {DSADC_OFFSET_COMP_FILTER_DISABLE, DSADC_OFFSET_COMP_FILTER_CUTOFF_RATE_1, DSADC_OFFSET_COMP_FILTER_CUTOFF_RATE_2, DSADC_OFFSET_COMP_FILTER_CUTOFF_RATE_3, DSADC_OFFSET_COMP_FILTER_CUTOFF_RATE_4, DSADC_OFFSET_COMP_FILTER_CUTOFF_RATE_5, DSADC_OFFSET_COMP_FILTER_CUTOFF_RATE_6, DSADC_OFFSET_COMP_FILTER_CUTOFF_RATE_7}, origin=ChipowerTech, post-build-variant-value=true, set at post-build, default-value=DSADC_OFFSET_COMP_FILTER_DISABLE  # Determines the offset compensation filter parameter (enable and cut-off frequency) for main filter chain.
          boolean DsadcChIntegratorEnable: origin=ChipowerTech, post-build-variant-value=true, set at post-build, default-value=false  # Enables / Disables the integrator of the auxiliary filter.
          enumeration DsadcChMeanMode: {DSADC_SINGLE_CARRIER_MODE, DSADC_MEAN_POINTS_MODE}, origin=ChipowerTech, post-build-variant-value=true, set at post-build, default-value=DSADC_SINGLE_CARRIER_MODE  # Description Determines the mean mode of the integrator. DSADC_SINGLE_CARRIER_MODE: Single-carrier mode. DSADC_MEAN_POINTS_MODE: Mean points configurable. Note This parameter is available only if the parameter DsadcChIntegratorEnable is set to true.
          integer DsadcChMeanPoints: 1..64, origin=ChipowerTech, post-build-variant-value=true, set at post-build, default-value=1  # Determines the mean point length of the integrator. <h1>Note</h1> This parameter is available only if the parameter DsadcChIntegratorEnable is set to true and the parameter DsadcChMeanMode is set to DSADC_MEAN_POINTS_MODE.
          enumeration DsadcChMeanPointShiftLength: {DSADC_MEAN_POINT_2, DSADC_MEAN_POINT_4, DSADC_MEAN_POINT_8, DSADC_MEAN_POINT_16, DSADC_MEAN_POINT_32, DSADC_MEAN_POINT_64}, origin=ChipowerTech, post-build-variant-value=true, set at post-build, default-value=DSADC_MEAN_POINT_2  # Determines the mean shift length of the integrator.. <h1>Note</h1> This parameter is available only if the parameter DsadcChInte-gratorEnable is set to true.
          container DsadcAuxFilterConfig  # This container contains the configuration pa-rameters of the auxiliary filter in each channel. Note This container is available only if the parameter DsadcChAuxiliaryFilterChainEnable for this channel is set to true.
            boolean DsadcAuxFilterCICEnable: origin=ChipowerTech, post-build-variant-value=true, set at post-build, default-value=false  # Enables / Disables the CIC filter of the auxiliary filter chain.
            enumeration DsadcAuxFilterCICSelect: {CIC1, CIC2, CIC3, CIC4}, origin=ChipowerTech, post-build-variant-value=true, set at post-build, default-value=CIC1  # Determines the CIC parallel series of the auxiliary filter chain.
            integer DsadcAuxFilterCICDecimationFactor: 4..32, origin=ChipowerTech, post-build-variant-value=true, set at post-build, default-value=32  # Determines the decimation factor for the CIC filter of the auxiliary filter chain.
          container DsadcLimitCheckingConfig [0..1]: multiplicity set at pre-compile, requires-index=true  # This container contains the configuration parameters for the limit checking of auxiliary filter in each channel. Note This parameter only available when ../DsadcResultHandlingImplementation != 'DSADC_DMA_MODE' and ../DsadcChAuxiliaryFilterChainEnable = 'true' and DsadcGeneral/DsadcAuxLimitCheckingEnable = 'true'
            boolean DsadcLimitCheckingEnable: origin=ChipowerTech, post-build-variant-value=true, set at post-build, default-value=true  # Enables / Disables the limit checking functionality for the auxiliary filter when auxiliary filter is enabled.
            integer DsadcLowerBoundaryValue: -32768..65535, origin=ChipowerTech, post-build-variant-value=true, set at post-build, default-value=0  # Determines the lower boundary value of limit checking.. Note - when using the single-ended mode: the range is 0~65535. - when using the differential mode: the range is -32768~32767.
            integer DsadcUpperBoundaryValue: -32768..65535, origin=ChipowerTech, post-build-variant-value=true, set at post-build, default-value=0  # Determines the upper boundary value of limit checking. Note - when using the single-ended mode: the range is 0~65535. - when using the differential mode: the range is -32768~32767.
            boolean DsadcBelowLowerLimitEventEnable: origin=ChipowerTech, post-build-variant-value=true, set at post-build, default-value=false  # Enables / Disables the conversion result below the lower limit interrupt event.
            boolean DsadcAboveUpperLimitEventEnable: origin=ChipowerTech, post-build-variant-value=true, set at post-build, default-value=false  # Enables / Disables the conversion result above the upper limit interrupt event.
        container DsadcCalibCompConfig [0..1]: multiplicity set at pre-compile, requires-index=true  # This container contains the configuration parameters of the calibration compensation in each channel.
          integer DsadcDcCompensationOffset: 0..65536, origin=ChipowerTech, post-build-variant-value=true, set at post-build, default-value=0  # Determines the DC compensation offset value. 16-bit signed integer, fixed-point number with S1.15.
          integer DsadcGainCompensationOffset: 0..65536, origin=ChipowerTech, post-build-variant-value=true, set at post-build, default-value=0  # Determines the gain compensation offset value. 16-bit signed integer, fixed-point number with S2.14. Note This parameter cannot be set to 0.
      container DsadcCarrierGenerator: multiplicity set at pre-compile  # This container contains the configuration parameters of the carrier generator.
        enumeration DsadcCarrierSignalMode: {DSADC_CARRIER_STOPPED, DSADC_CARRIER_SINE, DSADC_CARRIER_TRIANGLE, DSADC_CARRIER_SQUARE}, origin=ChipowerTech, post-build-variant-value=true, requires-index=true, set at post-build, default-value=DSADC_CARRIER_STOPPED  # Determines the carrier signal to be generated. DSADC_CARRIER_STOPPED: Carrier generator is not used. DSADC_CARRIER_SINE: Carrier generator output sine wave. DSADC_CARRIER_TRIANGLE: Carrier generator output triangle wave. DSADC_CARRIER_SQUARE: Carrier generator output square wave.
        boolean DsadcPCMEnable: origin=ChipowerTech, post-build-variant-value=true, set at post-build, default-value=false  # Enables / Disables the PCM mode for output carrier signal. This parameter is available only if the parameter DsadcCarrierSignalMode is not set to 'DSADC_CARRIER_STOPPED'.
        enumeration DsadcCarrierGenerationMode: {DSADC_NORMAL_MODE, DSADC_BIT_REVERSE_MODE}, origin=ChipowerTech, post-build-variant-value=true, set at post-build, default-value=DSADC_BIT_REVERSE_MODE  # This parameter defines the mode in which the Carrier Generator signal is generated. This parameter is available only if the parameter DsadcCarrierSignalMode is not set to 'DSADC_CARRIER_STOPPED'.
        boolean DsadcSetCarrierSyncParamApi: origin=ChipowerTech, set at pre-compile, default-value=false  # Adds / removes the service Dsadc_SetCarrierSyncValue() from the code. This parameter is available only if the parameter DsadcCarrierSignalMode is not set to 'DSADC_CARRIER_STOPPED'.
        boolean DsadcGetCarrierDelayValueApi: origin=ChipowerTech, set at pre-compile, default-value=false  # Adds / removes the service Dsadc_GetCarrierDelayValue() from the code. This parameter is available only if the parameter DsadcCarrierSignalMode is not set to 'DSADC_CARRIER_STOPPED'.
    container DsadcGeneral  # General configuration (parameters) of the DSADC Driver software module.
      boolean DsadcDevErrorDetect: origin=ChipowerTech, set at pre-compile, default-value=false  # Switches the Default Error Tracer (Det) detection ON or OFF.
      boolean DsadcSafetyErrorDetect: origin=ChipowerTech, set at pre-compile, default-value=true  # Switches the safety error detection ON or OFF.
      boolean DsadcDeInitApi: origin=ChipowerTech, set at pre-compile, default-value=false  # Adds / removes the service Dsadc_DeInit() from the code.
      boolean DsadcGetStreamLastPointerApi: origin=ChipowerTech, set at pre-compile, default-value=false  # Adds / removes the service Dsadc_GetStreamLastPointer() from the code.
      boolean DsadcVersionInfoApi: origin=ChipowerTech, set at pre-compile, default-value=false  # Adds / removes the service Dsadc_GetVersionInfo() from the code.
      boolean DsadcNotifCapability: origin=ChipowerTech, set at pre-compile, default-value=false  # Determines, if the notification mechanism (the functions to enable and disable the notifications) is available at runtime.
      boolean DsadcTimestampEnable: origin=ChipowerTech, set at pre-compile, default-value=false  # Enables / Disables the timestamp for all HW units.
      boolean DsadcClockSyncEnable: origin=ChipowerTech, set at pre-compile, default-value=false  # Enables / Disables the clock synchronization for all DSADC HW units.
      boolean DsadcIntegratorEnable: origin=ChipowerTech, set at pre-compile, default-value=false  # Enables / Disables the integrator for all DSADC HW units.
      boolean DsadcAuxiliaryFilterChainEnable: origin=ChipowerTech, set at pre-compile, default-value=false  # Enables / Disables the auxiliary filter chain functionality.
      boolean DsadcAuxLimitCheckingEnable: origin=ChipowerTech, set at pre-compile, default-value=false  # Enables / Disables the limit checking for auxiliary conversion channel.
      boolean DsadcInitSyncEnableHWUnit: origin=ChipowerTech, set at pre-compile, default-value=true  # Enables / Disables all DSADC HW units when the master core calls API Dsadc_Init(). Note true: all DSADC HW units will be synchronous enabled when the master core calls API Dsadc_Init(). false: all DSADC HW units will be not enabled when the master core calls API Dsadc_Init(). Caution For the THA6206 Revision C, if the hardware RDC is used, it must be enabled together with the DSADC. Refer to the ERRATA for details. If this parameter is set to false, the DSADC hardware units must be enabled by writing to the GLOBSYNC register. For details, refer to the Chip User Manual.
    container CommonPublishedInformation  # Common container, aggregated by all modules. It contains published information about vendor and versions.
      integer ArReleaseMajorVersion: 0..255, origin=ChipowerTech, set at published-information, default-value=4  # Major version number of AUTOSAR specification on which the appropriate implementation is based on.
      integer ArReleaseMinorVersion: 0..255, origin=ChipowerTech, set at published-information, default-value=4  # Minor version number of AUTOSAR specification on which the appropriate implementation is based on.
      integer ArReleaseRevisionVersion: 0..255, origin=ChipowerTech, set at published-information, default-value=0  # Revision version number of AUTOSAR specification on which the appropriate implementation is based on.
      integer ModuleId: 0..255, origin=ChipowerTech, set at published-information, default-value=255  # Module ID of this module from Module List.
      integer SwMajorVersion: 0..255, origin=ChipowerTech, set at published-information, default-value=1  # Major version number of the vendor specific implementation of the module. The numbering is vendor specific.
      integer SwMinorVersion: 0..255, origin=ChipowerTech, set at published-information, default-value=2  # Minor version number of the vendor specific implementation of the module. The numbering is vendor specific.
      integer SwPatchVersion: 0..255, origin=ChipowerTech, set at published-information, default-value=0  # Patch level version number of the vendor specific implementation of the module. The numbering is vendor specific.
      integer VendorId: 175..175, origin=ChipowerTech, set at published-information, default-value=175  # Vendor ID of the dedicated implementation of this module according to the AUTOSAR vendor list.
