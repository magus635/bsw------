; --------------------------------------------------------------------------------
; @Title: Tracing ARTI Hooks via selective Data Trace
; @Description:
;   This script sets up the data trace to trace the events generated by the
;   TRACE32 specific instrumentation of ARTI trace. In particular, tracing
;   of the variables arti_rte_trace and arti_os_trace is set.
;
; @Keywords: AUTOSAR ASAM ARTI
; @Author: DIE
; @Copyright: (C) 1989-2023 Lauterbach GmbH, licensed for use with TRACE32(R) only
; @Props: NoWelcome, NoIndex
; --------------------------------------------------------------------------------
; $Id: arti_data_trace.cmm 21082 2023-06-30 11:38:26Z rdienstbeck $

; IMPORTANT: Please read the readme.txt file in the common/arti_t32_data_trace directory

; Check if variables exist
IF !Var.EXIST(arti_os_trace)
(
    PRINT %ERROR "Variable arti_os_trace does not exist!"
    ENDDO
)

; Check if Trace is available
IF !Analyzer()&&!CAnalyzer()&&!Onchip()
(
  PRINT %ERROR "No Trace available!"
  ENDDO
)

; Clear all trace breakpoints
Break.Delete /TraceEnable
Break.Delete /TraceData
IF STRING.MID(CORENAME(),0,7)!="CORTEXM"
( ; TraceON/OFF/Trigger may not be available
  Break.Delete /TraceON
  Break.Delete /TraceOFF
  Break.Delete /TraceTrigger
)

; Set data trace breakpoints

; Try to set single breakpoints

ON ERROR GOTO TooManyOnchipBreakpoints
Break.Set Var.RANGE(arti_os_trace) /Write /TraceEnable
IF Var.EXIST(arti_rte_trace)
    Break.Set Var.RANGE(arti_rte_trace) /Write /TraceEnable
IF Var.EXIST(arti_sc_trace)
    Break.Set Var.RANGE(arti_sc_trace) /Write /TraceEnable
PRINT "Trace points set on ARTI variables."
ON ERROR

Trace.Init

ENDDO


; Try to set range breakpoint

TooManyOnchipBreakpoints:
Break.Delete /TraceEnable
ON ERROR
PRIVATE &AddrRange
&AddrRange=Var.RANGE(arti_os_trace)
GOSUB ExtendTraceAddressRange "&AddrRange" "arti_rte_trace"
RETURNVALUES &AddrRange
GOSUB ExtendTraceAddressRange "&AddrRange" "arti_sc_trace"
RETURNVALUES &AddrRange
Break.Set &AddrRange /Write /TraceEnable
PRINT %WARNING "Trace range set on ARTI variables"

Trace.Init

ENDDO


; Subroutine that extends the tracing range to include an additional variable
ExtendTraceAddressRange:
(
  PARAMETERS &range &variable
  PRIVATE &low_range &high_range &result
  PRIVATE &var_begin &var_end &var_access

  &low_range=ADDRESS.OFFSET(ADDRESS.RANGE.BEGIN(&range))
  &high_range=ADDRESS.OFFSET(ADDRESS.RANGE.END(&range))
  &result=&range

  IF Var.EXIST(&variable)
  (
    &var_begin=ADDRESS.OFFSET(Var.ADDRESS(&variable))
    &var_end=ADDRESS.OFFSET(Var.END(&variable))

    IF "&range"!=""
        &var_access=ADDRESS.STRACCESS(ADDRESS.RANGE.BEGIN(&range))
    IF "&var_access"==""
        &var_access=ATTRESS.STRACCESS(&variable)

    IF &var_begin<&low_range||&low_range==0
        &low_range=&var_begin

    IF &var_end>&high_range||&high_range==0
        &high_range=&var_end

    &result=&var_access&low_range--&high_range
  )
  RETURN "&result"
)
