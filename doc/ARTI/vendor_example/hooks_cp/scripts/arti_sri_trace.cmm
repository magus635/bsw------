; --------------------------------------------------------------------------------
; @Title: Tracing ARTI Hooks via SRI Trace
; @Description:
;   This script sets up MCDS to trace the events generated by the TRACE32
;   specific instrumentation of ARTI. In particular, tracing of the
;   variables arti_os_trace, arti_rte_trace and arti_sc_trace is set.
;
; @Keywords: AURIX, AURIX2G, AURIX3G, Infineon, multi-core, TriCore
; @Author: RAI, DIE, HDA
; @Chip: TC2*, TC3*, TC4*
; @Copyright: (C) 1989-2026 Lauterbach GmbH, licensed for use with TRACE32(R) only
; @Props: NoWelcome, NoIndex
; --------------------------------------------------------------------------------
; $Id: arti_sri_trace.cmm 26266 2026-03-13 11:32:29Z hdammak $


; *** IMPORTANT: Please read the readme.txt file in the ARTI/Source/arti_t32_tcxx_* directory

LOCAL &AddrStart &AddrRange &CTLAgent &Offset

;Check TRACE32 Software version
IF CPUFAMILY()!="TRICORE"
(
  PRINT %ERROR "Only for TriCore devices!"
  ENDDO
)

; Check TRACE32 Software version: Release 2023/02 or newer is required
IF VERSION.BUILD.BASE()<156181.
(
  PRINT %ERROR "Please update your TRACE32 software version!"
  ENDDO
)

; Check if MCDS module is available
IF MCDS.Module.NAME()=="<none>"
(
  PRINT %ERROR "No Trace (MCDS) available!"
  ENDDO
)

; Check if variables exist
IF !Var.EXIST(arti_os_trace)
(
  PRINT %ERROR "Variable arti_os_trace does not exist!"
  ENDDO
)

; Set Trace Method
IF Analyzer()
  Trace.METHOD Analyzer
ELSE IF CAnalyzer()
  Trace.METHOD CAnalyzer
ELSE IF Onchip()
  Trace.METHOD Onchip
ELSE
(
  PRINT %ERROR "No SRI trace available!"
  ENDDO
)
Trace.AutoInit ON

; All traced variables are meant to stay close together and all in LMU or OLDA

&AddrRange=Var.RANGE(arti_os_trace)

GOSUB ExtendTraceAddressRange "&AddrRange" "arti_rte_trace"
RETURNVALUES &AddrRange

GOSUB ExtendTraceAddressRange "&AddrRange" "arti_sc_trace"
RETURNVALUES &AddrRange

&AddrStart=ADDRESS.OFFSET(ADDRESS.RANGE.BEGIN(&AddrRange))

; Disable any active Break Program
Break.CLEAR

; Clear all Trace Breakpoints
Break.Delete /TraceEnable
Break.Delete /TraceData
Break.Delete /TraceON
Break.Delete /TraceOFF
Break.Delete /WATCH
Break.Delete /TraceTrigger

; Reset MCDS and clear all trace agents/sources
MCDS.RESet
MCDS.TraceAgents.CLEAR

; Enable generation of MCDS timestamps
MCDS.TImeMode MCDS

; enable automatic computation of clock frequencies
; on custom boards, setting the correct oscillator frequency is required
//CLOCK.OSCillator 20.0MHz ; default on Infineon TriBoards
CLOCK.ON

IF CPUIS(TC4*)
(
  ; OLDA starts at 0x8FE00000 (cached) and 0xAFE00000 (uncached)
  IF (&AddrStart&0xDFF00000)==0x8FE00000
  (
    ; SRI slave for OLDA
    &CTLAgent="SRI-OLDA::"
  )
  ELSE
  (
    PRINT %ERROR "Wrong memory used"
    ENDDO
  )
)
ELSE IF CPUIS(TC3*)
(
  ; OLDA starts at 0x8FE00000 (cached) and 0xAFE00000 (uncached)
  ; LMU0 LMURAM starts at 0x90040000 (cached) and 0xB0040000 (uncached)
  IF (&AddrStart&0xDFF00000)==0x8FE00000
  (
    ; SRI slave for OLDA
    &CTLAgent="SRI-OLDA::"
  )
  ELSE IF ((&AddrStart&0xDF000000)==0x90000000)
  (
    IF (MCDS.Module.NAME()=="miniMCDS")&&CPUIS(TC37*)
    (
      PRINT %ERROR "miniMCDS of AURIX TC37x is not suitable for LMU0 LMURAM trace"
      ENDDO
    )

    &Offset=&AddrStart&0x0FFFFFFF
    IF (&Offset<0x40000)||(&Offset>0x7FFFF)
    (
      PRINT %ERROR "&AddrStart is not a valid LMU0 LMURAM address"
      ENDDO
    )
    ; SRI slave for LMU0 LMURAM
    &CTLAgent="SRI-LMU0::"
  )
  ELSE
  (
    PRINT %ERROR "Wrong memory used"
    ENDDO
  )
)
ELSE IF CPUIS(TC2*)
(
  IF MCDS.Module.NAME()=="MCDS"
  (
    ; LMU SRAM starts at 0x90000000 (cached) and 0xB0000000 (uncached)
    ; OLDA starts at 0x8FE70000 (cached) and 0xAFE70000 (uncached)
    IF ((&AddrStart&0xDFFF0000)!=0x8FE70000)&&((&AddrStart&0xDFFF0000)!=0x90000000)
      PRINT %ERROR "Wrong memory used"

    ; SRI slave for all non-core RAM
    &CTLAgent="SRI-LMU::"
  )
  ELSE
  (
    PRINT %ERROR "miniMCDS of AURIX TC2xx is not suitable for slave trace"
    ENDDO
  )
)
ELSE
(
  PRINT %ERROR "Script only for AURIX TC2xx or AURIX TC3xx"
  ENDDO
)

; Activate the CTL program for enabling selective write access to
; above calculated address range
Break.ReProgram
(&+
  &CTLAgent
    IF Write(&AddrRange)
      TraceData Write Address Data
)

ENDDO

; Subroutine that extends the tracing range to include an additional variable
ExtendTraceAddressRange:
(
  PRIVATE &low_range &high_range &var_begin &var_end &result
  PARAMETERS &range &variable

  &low_range=ADDRESS.OFFSET(ADDRESS.RANGE.BEGIN(&range))
  &high_range=ADDRESS.OFFSET(ADDRESS.RANGE.END(&range))
  &result=&range

  IF Var.EXIST(&variable)
  (
    &var_begin=ADDRESS.OFFSET(Var.ADDRESS(&variable))
    &var_end=ADDRESS.OFFSET(Var.END(&variable))

    IF &var_begin<&low_range||&low_range==0
    (
      &low_range=&var_begin
    )

    IF &var_end>&high_range||&high_range==0
    (
      &high_range=&var_end
    )
    &result=C:&low_range--&high_range
  )
  RETURN "&result"
)
