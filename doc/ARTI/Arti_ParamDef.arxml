AUTOSAR XML (schema 00047)
package /AUTOSAR/EcucDefs
  module definition Arti [0..1]: post-build-variant-support=true, variants link-time/post-build/pre-compile  # The Arti Module serves as a superordinate container collecting all information and parameters concerning ARTI.
    container ArtiGeneric [0..1]: multiplicity set at pre-compile  # The ArtiGeneric container contains definitions for generic objects, i.e. not belonging to a standard AUTOSAR module.
      container ArtiGenericComponentClass [0..*]: multiplicity set at pre-compile  # The class definition describes the layout of the object (similar to a "class" definition in C++).
        string ArtiGenericComponentClassName: scope=ECU, set at pre-compile  # Name of the class.
        container ArtiGenericComponentClassParameter [0..*]: multiplicity set at pre-compile  # Parameter definition of a class.
          string ArtiGenericComponentClassParameterName: scope=ECU, set at pre-compile  # Name of the parameter.
          reference ArtiGenericComponentClassParameterTypeMapRef [0..1]: scope=ECU, multiplicity set at pre-compile, set at pre-compile, destination=ArtiParameterTypeMap  # Refers to a parameter type to interpret the parameter value.
      container ArtiGenericComponentInstance [0..*]: multiplicity set at pre-compile  # The instance definition describes a specific instantiated object.
        string ArtiGenericComponentInstanceName: scope=ECU, set at pre-compile  # Name of the instance.
        reference ArtiGenericComponentInstanceClassRef: scope=ECU, set at pre-compile, destination=ArtiGenericComponentClass  # Refers to a ArtGenericClass of which this object is instantiated.
        container ArtiGenericComponentInstanceParameter [0..*]: multiplicity set at pre-compile  # Parameter definition of an instance.
          reference ArtiGenericComponentInstanceParameterClassParameterRef [0..*]: scope=ECU, multiplicity set at pre-compile, set at pre-compile, destination=ArtiGenericComponentClassParameter  # Refers to an ArtiGenericComponentClassParameter that defines this parameter.
          reference ArtiGenericComponentInstanceParameterConstantRef [0..1]: scope=ECU, multiplicity set at pre-compile, set at pre-compile, destination=ArtiConstant  # Refers to an ArtiConstant that represents the value of this parameter.
          reference ArtiGenericComponentInstanceParameterExpressionRef [0..1]: scope=ECU, multiplicity set at pre-compile, set at pre-compile, destination=ArtiExpression  # Refers to an ArtiExpression that evaluates the value of this parameter.
          reference ArtiGenericComponentInstanceParameterHookRef [0..1]: scope=ECU, multiplicity set at pre-compile, set at pre-compile, destination=ArtiHook  # Refers to a hook that records this parameter.
    container ArtiHardware [0..1]: multiplicity set at pre-compile in variant pre-compile / post-build in variant post-build, post-build-variant-multiplicity=true  # The ArtiHardware container contains ARTI extensions to the EcucHardware module.
      container ArtiHardwareCoreClass [0..1]: multiplicity set at pre-compile in variant pre-compile / post-build in variant post-build, post-build-variant-multiplicity=true  # Contains the layout of an ARTI "Core" object, extending the EcucCoreDefinition.
        reference ArtiHardwareCoreClassCurrentApplicationRef: scope=ECU, post-build-variant-value=true, set at pre-compile in variant pre-compile / post-build in variant post-build, destination=ArtiObjectClassParameter  # Refers to the ArtiObjectClassParameter that defines the ArtiCurrentApplicationInstance parameter.
        reference ArtiHardwareCoreClassCurrentIsrRef [0..1]: scope=ECU, post-build-variant-value=true, set at pre-compile in variant pre-compile / post-build in variant post-build, destination=ArtiObjectClassParameter  # Refers to the ArtiObjectClassParameter that defines the ArtiCurrentIsrInstance parameter.
        reference ArtiHardwareCoreClassCurrentTaskRef: scope=ECU, post-build-variant-value=true, set at pre-compile in variant pre-compile / post-build in variant post-build, destination=ArtiObjectClassParameter  # Refers to the ArtiObjectClassParameter that defines the ArtiCurrentTaskInstance parameter.
        reference ArtiHardwareCoreClassGenericComponentRef [0..1]: scope=ECU, multiplicity set at pre-compile in variant pre-compile / post-build in variant post-build, post-build-variant-multiplicity=true, post-build-variant-value=true, set at pre-compile in variant pre-compile / post-build in variant post-build, destination=ArtiGenericComponentClass  # Refers to an ArtiGenericComponentClass that extends the core description.
        reference ArtiHardwareCoreClassLastErrorRef [0..1]: scope=ECU, multiplicity set at pre-compile in variant pre-compile / post-build in variant post-build, post-build-variant-multiplicity=true, post-build-variant-value=true, set at pre-compile in variant pre-compile / post-build in variant post-build, destination=ArtiObjectClassParameter  # Refers to the ArtiObjectClassParameter that defines the ArtiLastErrorInstance parameter.
        reference ArtiHardwareCoreClassRunningTaskPriorityRef [0..1]: scope=ECU, multiplicity set at pre-compile in variant pre-compile / post-build in variant post-build, post-build-variant-multiplicity=true, post-build-variant-value=true, set at pre-compile in variant pre-compile / post-build in variant post-build, destination=ArtiObjectClassParameter  # Refers to the ArtiObjectClassParameter that defines the ArtiHwCoreInstanceRunningTaskPriority parameter.
      container ArtiHardwareCoreInstance [0..*]: multiplicity set at pre-compile in variant pre-compile / post-build in variant post-build, post-build-variant-multiplicity=true  # Represents an instance of an ARTI "Core" object, extending the EcucCoreDefinition. When using ARTI for debugging or hardware based tracing, this is mandatory (i.e. multiplicity 1..*), else optional.
        integer ArtiHardwareCoreInstanceCoreId: 0..18446744073709551615, scope=ECU, post-build-variant-value=true, set at pre-compile in variant pre-compile / post-build in variant post-build  # This parameter represents the "CoreID" as given by the OS, returned by GetCoreID().
        reference ArtiHardwareCoreInstanceCurrentApplicationRef: scope=ECU, post-build-variant-value=true, set at pre-compile in variant pre-compile / post-build in variant post-build, destination=ArtiObjectInstanceParameter  # Refers to the ArtiObjectInstanceParameter that contains the evaluation for the "current application" that is running on this core.
        reference ArtiHardwareCoreInstanceCurrentIsrRef [0..1]: scope=ECU, multiplicity set at pre-compile in variant pre-compile / post-build in variant post-build, post-build-variant-multiplicity=true, post-build-variant-value=true, set at pre-compile in variant pre-compile / post-build in variant post-build, destination=ArtiObjectInstanceParameter  # Refers to the ArtiObjectInstanceParameter that contains the evaluation for the "current ISR" that is running on this core.
        reference ArtiHardwareCoreInstanceCurrentTaskRef: scope=ECU, post-build-variant-value=true, set at pre-compile in variant pre-compile / post-build in variant post-build, destination=ArtiObjectInstanceParameter  # Refers to the ArtiObjectInstanceParameter that contains the evaluation for the "current task" that is running on this core.
        reference ArtiHardwareCoreInstanceEcucCoreRef: scope=ECU, post-build-variant-value=true, set at pre-compile in variant pre-compile / post-build in variant post-build, destination=EcucCoreDefinition  # Refers to the EcucCoreDefinition of this core.
        reference ArtiHardwareCoreInstanceGenericComponentRef [0..1]: scope=ECU, multiplicity set at pre-compile in variant pre-compile / post-build in variant post-build, post-build-variant-multiplicity=true, post-build-variant-value=true, set at pre-compile in variant pre-compile / post-build in variant post-build, destination=ArtiGenericComponentInstance  # Refers to an ArtiGenericComponentInstance that extends a core.
        reference ArtiHardwareCoreInstanceLastErrorRef [0..1]: scope=ECU, multiplicity set at pre-compile in variant pre-compile / post-build in variant post-build, post-build-variant-multiplicity=true, post-build-variant-value=true, set at pre-compile in variant pre-compile / post-build in variant post-build, destination=ArtiObjectInstanceParameter  # Refers to the ArtiObjectInstanceParameter that contains the evaluation for the "last error" that happened on this core.
        reference ArtiHardwareCoreInstanceRunningTaskPriorityRef [0..1]: scope=ECU, multiplicity set at pre-compile in variant pre-compile / post-build in variant post-build, post-build-variant-multiplicity=true, post-build-variant-value=true, set at pre-compile in variant pre-compile / post-build in variant post-build, destination=ArtiObjectInstanceParameter  # Refers to the ArtiObjectInstanceParameter that contains the evaluation for the "running task priority" that is on this core.
        reference ArtiHardwareCoreInstanceValidRef [0..1]: scope=ECU, multiplicity set at pre-compile in variant pre-compile / link in variant link-time, set at pre-compile in variant pre-compile / link in variant link-time, destination=ArtiObjectInstanceParameter  # Refers to the ArtiObjectInstanceParameter that contains the evaluation for the "validity" of this ArtiHwCoreInstance.
    container ArtiOs [0..1]: multiplicity set at pre-compile in variant pre-compile / link in variant link-time, post-build-variant-multiplicity=true  # The ArtiOs container contains ARTI extensions to the EcucDefs/Os module.
      reference ArtiOsGenericComponentRef [0..*]: scope=ECU, multiplicity set at pre-compile in variant pre-compile / link in variant link-time, set at pre-compile in variant pre-compile / link in variant link-time, destination=ArtiGenericComponentClass  # Refers to an ArtiGenericComponentClass that relates to the OS.
      container ArtiOsAlarmClass [0..1]: multiplicity set at pre-compile in variant pre-compile / link in variant link-time  # Contains the layout of an ArtiOsAlarm object.
        reference ArtiOsAlarmClassGenericComponentClassRef [0..1]: scope=ECU, multiplicity set at pre-compile in variant pre-compile / link in variant link-time, set at pre-compile in variant pre-compile / link in variant link-time, destination=ArtiGenericComponentClass  # Refers to an ArtiGenericComponentClass that extends the ArtiOsAlarmClass.
        reference ArtiOsAlarmClassStateRef [0..1]: scope=ECU, multiplicity set at pre-compile in variant pre-compile / link in variant link-time, set at pre-compile in variant pre-compile / link in variant link-time, destination=ArtiObjectClassParameter  # Refers to the ArtiObjectClassParameter that declares the attribute ArtiOsAlarmStateRef in ArtiOsAlarmInstances. This attribute specifies if an alarm is "RUNNING" or "STOPPED".
      container ArtiOsAlarmInstance [0..*]: multiplicity set at pre-compile in variant pre-compile / link in variant link-time  # Represents an instance of an ArtiOsAlarm object, extending the EcuC OsTaskAlarm.
        string ArtiOsAlarmInstanceAction [0..1]: scope=ECU, multiplicity set at pre-compile in variant pre-compile / link in variant link-time, set at pre-compile in variant pre-compile / link in variant link-time  # This attribute provides a string containing the action of this alarm.
        string ArtiOsAlarmInstanceCounter [0..1]: scope=ECU, multiplicity set at pre-compile in variant pre-compile / link in variant link-time, set at pre-compile in variant pre-compile / link in variant link-time  # This attribute provides a string containing the name of the counter used by this alarm.
        reference ArtiOsAlarmInstanceAlarmTimeRef [0..1]: scope=ECU, multiplicity set at pre-compile in variant pre-compile / link in variant link-time, set at pre-compile in variant pre-compile / link in variant link-time, destination=ArtiObjectInstanceParameter  # This attribute specifies how to evaluate the time until the alarm expires next. The time should be represented in seconds.
        reference ArtiOsAlarmInstanceCycleTimeRef [0..1]: scope=ECU, multiplicity set at pre-compile in variant pre-compile / link in variant link-time, set at pre-compile in variant pre-compile / link in variant link-time, destination=ArtiObjectInstanceParameter  # This attribute specifies how to evaluate the cycle time for cyclic alarms. The value of "cycle time" is 0 for non-cyclic alarms.
        reference ArtiOsAlarmInstanceEcuCRef [0..1]: scope=ECU, multiplicity set at pre-compile in variant pre-compile / link in variant link-time, set at pre-compile in variant pre-compile / link in variant link-time, destination=OsAlarm  # Refers to an EcuC OsAlarm that is beeing extended.
        reference ArtiOsAlarmInstanceGenericComponentInstanceRef [0..1]: scope=ECU, multiplicity set at pre-compile in variant pre-compile / link in variant link-time, set at pre-compile in variant pre-compile / link in variant link-time, destination=ArtiGenericComponentInstance  # Refers to an ArtiGenericComponentInstance that extends the ArtiOsAlarmInstance.
        reference ArtiOsAlarmInstanceStateRef [0..1]: scope=ECU, multiplicity set at pre-compile in variant pre-compile / link in variant link-time, set at pre-compile in variant pre-compile / link in variant link-time, destination=ArtiObjectInstanceParameter  # Refers to the ArtiObjectInstanceParameter that contains the evaluation for the "state" of this alarm.
        reference ArtiOsAlarmInstanceValidRef [0..1]: scope=ECU, multiplicity set at pre-compile in variant pre-compile / link in variant link-time, set at pre-compile in variant pre-compile / link in variant link-time, destination=ArtiObjectInstanceParameter  # Refers to the ArtiObjectInstanceParameter that contains the evaluation for the "validity" of this alarm.
      container ArtiOsClass [0..1]: multiplicity set at pre-compile in variant pre-compile / link in variant link-time  # Contains the layout of an ARTI "Os" object, extending the EcuC OsOS.
        reference ArtiOsClassAppModeRef: scope=ECU, set at pre-compile in variant pre-compile / link in variant link-time, destination=ArtiObjectClassParameter  # Refers to the ArtiObjectClassParameter that defines the application mode of this OS.
        reference ArtiOsClassGenericComponentRef [0..1]: scope=ECU, multiplicity set at pre-compile in variant pre-compile / link in variant link-time, set at pre-compile in variant pre-compile / link in variant link-time, destination=ArtiGenericComponentClass  # Refers to an ArtiGenericComponentClass that extends the OS.
        reference ArtiOsClassServiceTraceRef [0..1]: scope=ECU, multiplicity set at pre-compile in variant pre-compile / link in variant link-time, set at pre-compile in variant pre-compile / link in variant link-time, destination=ArtiObjectClassParameter  # Refers to the ArtiObjectClassParameter that defines the ArtiOsInstanceServiceTrace parameter. This attribute indicates the entry or exit of a service routine and the ID of this service routine.
      container ArtiOsContextClass [0..1]: multiplicity set at pre-compile in variant pre-compile / link in variant link-time  # Contains the layout of an ARTI "OsContext" object.
        reference ArtiOsContextClassGenericComponentClassRef [0..1]: scope=ECU, multiplicity set at pre-compile in variant pre-compile / link in variant link-time, set at pre-compile in variant pre-compile / link in variant link-time, destination=ArtiGenericComponentClass  # Refers to an ArtiGenericComponentClass that extends the ArtiOsContext.
      container ArtiOsContextInstance [0..*]: multiplicity set at pre-compile in variant pre-compile / link in variant link-time  # Represents an instance of an "ArtiContext" object.
        reference ArtiOsContextInstanceAddressRef [0..1]: scope=ECU, multiplicity set at pre-compile in variant pre-compile / link in variant link-time, set at pre-compile in variant pre-compile / link in variant link-time, destination=ArtiObjectInstanceParameter  # Refers to the ArtiObjectInstanceParameter that contains the evaluation for the "address" of this ArtiOsContext.
        reference ArtiOsContextInstanceGenericComponentInstanceRef [0..1]: scope=ECU, multiplicity set at pre-compile in variant pre-compile / link in variant link-time, set at pre-compile in variant pre-compile / link in variant link-time, destination=ArtiGenericComponentInstance  # Refers to an ArtiGenericComponentInstance that extends the ArtiOsContext.
        reference ArtiOsContextInstanceSizeRef [0..1]: scope=ECU, multiplicity set at pre-compile in variant pre-compile / link in variant link-time, set at pre-compile in variant pre-compile / link in variant link-time, destination=ArtiObjectInstanceParameter  # Refers to the ArtiObjectInstanceParameter that contains the evaluation for the "size" of this ArtiOsContext.
        reference ArtiOsContextInstanceValidRef [0..1]: scope=ECU, multiplicity set at pre-compile in variant pre-compile / link in variant link-time, set at pre-compile in variant pre-compile / link in variant link-time, destination=ArtiObjectInstanceParameter  # Refers to the ArtiObjectInstanceParameter that contains the evaluation for the "validity" of this ArtiOsContextInstance.
      container ArtiOsInstance [0..1]: multiplicity set at pre-compile in variant pre-compile / link in variant link-time  # Represents an instance of an ARTI "Os" object, extending the EcuC OsOS.
        reference ArtiOsInstanceAppModeRef: scope=ECU, set at pre-compile in variant pre-compile / link in variant link-time, destination=ArtiObjectInstanceParameter  # Refers to the ArtiObjectInstanceParameter that contains the evaluation for the "application mode" of this OS.
        reference ArtiOsInstanceEcucRef: scope=ECU, set at pre-compile in variant pre-compile / link in variant link-time, destination=OsOS  # Refers to the EcucDefs/Os/OsOS of this OS.
        reference ArtiOsInstanceGenericComponentRef [0..1]: scope=ECU, multiplicity set at pre-compile in variant pre-compile / link in variant link-time, set at pre-compile in variant pre-compile / link in variant link-time, destination=ArtiGenericComponentInstance  # Refers to an ArtiGenericComponentInstance that extends the OS.
        reference ArtiOsInstanceHookRef [0..*]: scope=ECU, multiplicity set at pre-compile in variant pre-compile / link in variant link-time, set at pre-compile in variant pre-compile / link in variant link-time, destination=ArtiHook  # Refers to a hook defined in the OS.
        reference ArtiOsInstanceServiceTraceRef [0..1]: scope=ECU, multiplicity set at pre-compile in variant pre-compile / link in variant link-time, set at pre-compile in variant pre-compile / link in variant link-time, destination=ArtiObjectInstanceParameter  # Refers to a hook defined in the OS.
        reference ArtiOsInstanceValidRef [0..1]: scope=ECU, multiplicity set at pre-compile in variant pre-compile / link in variant link-time, set at pre-compile in variant pre-compile / link in variant link-time, destination=ArtiObjectInstanceParameter  # Refers to the ArtiObjectInstanceParameter that contains the evaluation for the "validity" of this ArtiOsInstance.
      container ArtiOsIsrClass [0..1]: multiplicity set at pre-compile in variant pre-compile / link in variant link-time  # Contains the layout of an ARTI "OsIsr" object, extending the EcuC OsIsr.
        reference ArtiOsIsrClassGenericComponentRef [0..1]: scope=ECU, multiplicity set at pre-compile in variant pre-compile / link in variant link-time, set at pre-compile in variant pre-compile / link in variant link-time, destination=ArtiGenericComponentClass  # Refers to an ArtiGenericComponentClass that extends the OsIsr.
      container ArtiOsIsrInstance [0..*]: multiplicity set at pre-compile in variant pre-compile / link in variant link-time  # Represents an instance of an ARTI "OsIsr" object, extending the EcuC OsIsr.
        enumeration ArtiOsIsrInstanceCategory [0..1]: {CATEGORY_1, CATEGORY_2}, scope=ECU, multiplicity set at pre-compile, set at pre-compile  # Specifies category of this ISR. If omitted the instance is related to a CATEGORY_2.
        function name ArtiOsIsrInstanceFunction [0..1]: scope=ECU, multiplicity set at pre-compile in variant pre-compile / link in variant link-time, set at pre-compile in variant pre-compile / link in variant link-time  # This parameter represents the C function name of the ISR routine.
        integer ArtiOsIsrInstanceId: 0..18446744073709551615, scope=ECU, set at pre-compile in variant pre-compile / link in variant link-time  # This parameter represents the "ISRID" as given by the OS, returned by GetISRID().
        reference ArtiOsIsrInstanceEcucRef [0..1]: scope=ECU, multiplicity set at pre-compile, set at pre-compile in variant pre-compile / link in variant link-time, destination=OsIsr  # Refers to the EcucDefs/Os/OsIsr of this ISR.
        reference ArtiOsIsrInstanceGenericComponentRef [0..1]: scope=ECU, multiplicity set at pre-compile in variant pre-compile / link in variant link-time, set at pre-compile in variant pre-compile / link in variant link-time, destination=ArtiGenericComponentInstance  # Refers to an ArtiGenericComponentInstance that extends the OsIsr.
        reference ArtiOsIsrInstanceValidRef [0..1]: scope=ECU, multiplicity set at pre-compile in variant pre-compile / link in variant link-time, set at pre-compile in variant pre-compile / link in variant link-time, destination=ArtiObjectInstanceParameter  # Refers to the ArtiObjectInstanceParameter that contains the evaluation for the "validity" of this ArtiOsIsrInstance.
      container ArtiOsMessageContainerClass [0..1]: multiplicity set at pre-compile in variant pre-compile / link in variant link-time  # Contains the layout of an ARTI "OsMessageContainer" object. The "OsMessageContainer" object represents an existing combination of OSEK messages.
        reference ArtiOsMessageContainerClassGenericComponentClassRef [0..1]: scope=ECU, multiplicity set at pre-compile in variant pre-compile / link in variant link-time, set at pre-compile in variant pre-compile / link in variant link-time, destination=ArtiGenericComponentClass  # Refers to an ArtiGenericComponentClass that extends the ArtiOsMessageContainerClass.
      container ArtiOsMessageContainerInstance [0..*]: multiplicity set at pre-compile in variant pre-compile / link in variant link-time  # Represents an instance of an "ArtiMessageContainer" object.
        string ArtiOsMessageContainerInstanceMsgName [0..1]: scope=ECU, multiplicity set at pre-compile in variant pre-compile / link in variant link-time, set at pre-compile in variant pre-compile / link in variant link-time  # Name of the message.
        string ArtiOsMessageContainerInstanceMsgType [0..1]: scope=ECU, multiplicity set at pre-compile in variant pre-compile / link in variant link-time, set at pre-compile in variant pre-compile / link in variant link-time  # Type of the message.
        reference ArtiOsMessageContainerInstanceFirstElementRef [0..1]: scope=ECU, multiplicity set at pre-compile in variant pre-compile / link in variant link-time, set at pre-compile in variant pre-compile / link in variant link-time, destination=ArtiObjectInstanceParameter  # Refers to the first element of the message queue. This message will be received next.
        reference ArtiOsMessageContainerInstanceGenericComponentInstanceRef [0..1]: scope=ECU, multiplicity set at pre-compile in variant pre-compile / link in variant link-time, set at pre-compile in variant pre-compile / link in variant link-time, destination=ArtiGenericComponentInstance  # Refers to an ArtiGenericComponentInstance that extends the ArtiOsMessageContainerInstance.
        reference ArtiOsMessageContainerInstanceQueueCountRef [0..1]: scope=ECU, multiplicity set at pre-compile in variant pre-compile / link in variant link-time, set at pre-compile in variant pre-compile / link in variant link-time, destination=ArtiObjectInstanceParameter  # Refers to the ArtiObjectInstanceParameter that contains the evaluation for the "queuecount" of this ArtiOsMessageContainer.
        reference ArtiOsMessageContainerInstanceQueueSizeRef [0..1]: scope=ECU, multiplicity set at pre-compile in variant pre-compile / link in variant link-time, set at pre-compile in variant pre-compile / link in variant link-time, destination=ArtiObjectInstanceParameter  # Refers to the ArtiObjectInstanceParameter that contains the evaluation for the "queuesize" of this ArtiOsMessageContainer.
        reference ArtiOsMessageContainerInstanceValidRef [0..1]: scope=ECU, multiplicity set at pre-compile in variant pre-compile / link in variant link-time, set at pre-compile in variant pre-compile / link in variant link-time, destination=ArtiObjectInstanceParameter  # Refers to the ArtiObjectInstanceParameter that contains the evaluation for the "validity" of this ArtiOsMessageContainerInstance.
      container ArtiOsResourceClass [0..1]: multiplicity set at pre-compile in variant pre-compile / link in variant link-time  # Contains the layout of an ArtiOsResource object. The ArtiOsResource object represents an OSEK resource.
        reference ArtiOsResourceClassGenericComponentClassRef [0..1]: scope=ECU, multiplicity set at pre-compile in variant pre-compile / link in variant link-time, set at pre-compile in variant pre-compile / link in variant link-time, destination=ArtiGenericComponentClass  # Refers to an ArtiGenericComponentClass that extends the ArtiOsResourceClass.
        reference ArtiOsResourceClassLockerRef [0..1]: scope=ECU, multiplicity set at pre-compile in variant pre-compile / link in variant link-time, set at pre-compile in variant pre-compile / link in variant link-time, destination=ArtiObjectClassParameter  # Refers to the ArtiObjectClassParameter that declares the attribute ArtiOsResourceLockerRef in ArtiOsResourceInstances.
        reference ArtiOsResourceClassStateRef [0..1]: scope=ECU, multiplicity set at pre-compile in variant pre-compile / link in variant link-time, set at pre-compile in variant pre-compile / link in variant link-time, destination=ArtiObjectClassParameter  # Refers to the ArtiObjectClassParameter that declares the attribute ArtiOsResourceStateRef in ArtiOsResourceInstances.
      container ArtiOsResourceInstance [0..*]: multiplicity set at pre-compile in variant pre-compile / link in variant link-time  # Represents an instance of an ArtiOsResource object.
        string ArtiOsResourceInstancePriority [0..1]: scope=ECU, multiplicity set at pre-compile in variant pre-compile / link in variant link-time, set at pre-compile in variant pre-compile / link in variant link-time  # This attribute has two components that state: that the RESOURCE is used by TASKs only or by TASKs and ISRs, and the priority that will be used when locking the RESOURCE.
        reference ArtiOsResourceInstanceEcuCRef [0..1]: scope=ECU, multiplicity set at pre-compile in variant pre-compile / link in variant link-time, set at pre-compile in variant pre-compile / link in variant link-time, destination=OsResource  # Refers to an EcuC OsResource that is being extended.
        reference ArtiOsResourceInstanceGenericComponentInstanceRef [0..1]: scope=ECU, multiplicity set at pre-compile in variant pre-compile / link in variant link-time, set at pre-compile in variant pre-compile / link in variant link-time, destination=ArtiGenericComponentInstance  # Refers to an ArtiGenericComponentInstance that extends the ArtiOsResourceInstance.
        reference ArtiOsResourceInstanceLockerRef [0..1]: scope=ECU, multiplicity set at pre-compile in variant pre-compile / link in variant link-time, set at pre-compile in variant pre-compile / link in variant link-time, destination=ArtiObjectInstanceParameter  # Refers to the ArtiObjectInstanceParameter that contains the evaluation for the "locker" of this ArtiOsResource.
        reference ArtiOsResourceInstanceStateRef [0..1]: scope=ECU, multiplicity set at pre-compile in variant pre-compile / link in variant link-time, set at pre-compile in variant pre-compile / link in variant link-time, destination=ArtiObjectInstanceParameter  # Refers to the ArtiObjectInstanceParameter that contains the evaluation for the "state" of this ArtiOsResource.
        reference ArtiOsResourceInstanceValidRef [0..1]: scope=ECU, multiplicity set at pre-compile in variant pre-compile / link in variant link-time, set at pre-compile in variant pre-compile / link in variant link-time, destination=ArtiObjectInstanceParameter  # Refers to the ArtiObjectInstanceParameter that contains the evaluation for the "validity" of this ArtiOsResourceInstance.
      container ArtiOsStackClass [0..1]: multiplicity set at pre-compile in variant pre-compile / link in variant link-time  # Contains the layout of an ArtiOsStack object. The ArtiOsStack object defines the memory area of any stack in the system.
        reference ArtiOsStackClassGenericComponentClassRef [0..1]: scope=ECU, multiplicity set at pre-compile in variant pre-compile / link in variant link-time, set at pre-compile in variant pre-compile / link in variant link-time, destination=ArtiGenericComponentClass  # Refers to an ArtiGenericComponentClass that extends the ArtiOsStackClass.
      container ArtiOsStackInstance [0..*]: multiplicity set at pre-compile in variant pre-compile / link in variant link-time  # Represents an instance of an ArtiOsStack object.
        string ArtiOsStackInstanceDirection [0..1]: scope=ECU, multiplicity set at pre-compile in variant pre-compile / link in variant link-time, set at pre-compile in variant pre-compile / link in variant link-time  # This attribute specifies the direction of stack growth and may have either "UP" or "DOWN" as its value.
        reference ArtiOsStackInstanceBaseAddressRef [0..1]: scope=ECU, multiplicity set at pre-compile in variant pre-compile / link in variant link-time, set at pre-compile in variant pre-compile / link in variant link-time, destination=ArtiObjectInstanceParameter  # Refers to the ArtiObjectInstanceParameter that contains the evaluation for the "base address" of this ArtiOsStack.
        reference ArtiOsStackInstanceFillPatternRef [0..1]: scope=ECU, multiplicity set at pre-compile in variant pre-compile / link in variant link-time, set at pre-compile in variant pre-compile / link in variant link-time, destination=ArtiObjectInstanceParameter  # Refers to the ArtiObjectInstanceParameter that contains the evaluation for the "fillpattern" of this ArtiOsStack.
        reference ArtiOsStackInstanceGenericComponentInstanceRef [0..1]: scope=ECU, multiplicity set at pre-compile in variant pre-compile / link in variant link-time, set at pre-compile in variant pre-compile / link in variant link-time, destination=ArtiGenericComponentInstance  # Refers to an ArtiGenericComponentInstance that extends the ArtiOsStackInstance.
        reference ArtiOsStackInstanceSizeRef [0..1]: scope=ECU, multiplicity set at pre-compile in variant pre-compile / link in variant link-time, set at pre-compile in variant pre-compile / link in variant link-time, destination=ArtiObjectInstanceParameter  # Refers to the ArtiObjectInstanceParameter that contains the evaluation for the "size" of this ArtiOsStack.
        reference ArtiOsStackInstanceValidRef [0..1]: scope=ECU, multiplicity set at pre-compile in variant pre-compile / link in variant link-time, set at pre-compile in variant pre-compile / link in variant link-time, destination=ArtiObjectInstanceParameter  # Refers to the ArtiObjectInstanceParameter that contains the evaluation for the "validity" of this ArtiOsStack.
      container ArtiOsTaskClass [0..1]: multiplicity set at pre-compile in variant pre-compile / link in variant link-time  # Contains the layout of an ARTI "OsTask" object, extending the EcuC OsTask.
        reference ArtiOsTaskClassClassGenericComponentRef [0..1]: scope=ECU, multiplicity set at pre-compile in variant pre-compile / link in variant link-time, set at pre-compile in variant pre-compile / link in variant link-time, destination=ArtiGenericComponentClass  # Refers to an ArtiGenericComponentClass that extends the OsTask.
        reference ArtiOsTaskClassContextRef [0..1]: scope=ECU, multiplicity set at pre-compile in variant pre-compile / link in variant link-time, set at pre-compile in variant pre-compile / link in variant link-time, destination=ArtiObjectClassParameter  # Declares the attribute ArtiOsTaskContextRef in ArtiOsTaskInstances: a reference to the context object that the task is currently using.
        reference ArtiOsTaskClassCurrentTaskStateRef [0..1]: scope=ECU, multiplicity set at pre-compile in variant pre-compile / link in variant link-time, set at pre-compile in variant pre-compile / link in variant link-time, destination=ArtiObjectClassParameter  # Refers to the ArtiObjectClassParameter that defines the ArtiCurrentTaskStateInstance parameter including the task state mapping.
        reference ArtiOsTaskClassPriorityRef [0..1]: scope=ECU, multiplicity set at pre-compile in variant pre-compile / link in variant link-time, set at pre-compile in variant pre-compile / link in variant link-time, destination=ArtiObjectClassParameter  # Declares the attribute ArtiOsTaskPriorityRef in ArtiOsTaskInstances: the current priority of the TASK object.
        reference ArtiOsTaskClassStackRef [0..1]: scope=ECU, multiplicity set at pre-compile in variant pre-compile / link in variant link-time, set at pre-compile in variant pre-compile / link in variant link-time, destination=ArtiObjectClassParameter  # Declares the attribute ArtiOsTaskStackRef in ArtiOsTaskInstances: a reference to the stack object that the task is currently using.
      container ArtiOsTaskInstance [0..*]: multiplicity set at pre-compile in variant pre-compile / link in variant link-time  # Represents an instance of an ARTI "OsTask" object, extending the EcuC OsTask.
        function name ArtiOsTaskInstanceFunction [0..1]: scope=ECU, multiplicity set at pre-compile in variant pre-compile / link in variant link-time, set at pre-compile in variant pre-compile / link in variant link-time  # This parameter represents the C function name of the task body.
        integer ArtiOsTaskInstanceId: 0..18446744073709551615, scope=ECU, set at pre-compile in variant pre-compile / link in variant link-time  # This parameter represents the "TaskID" as given by the OSEK OS, returned by GetTaskID().
        reference ArtiOsTaskInstanceContextRef [0..1]: scope=ECU, multiplicity set at pre-compile in variant pre-compile / link in variant link-time, set at pre-compile in variant pre-compile / link in variant link-time, destination=ArtiObjectInstanceParameter  # Refers to the ArtiObjectInstanceParameter that contains the evaluation for the ArtiOsContext of this ArtiOsTask.
        reference ArtiOsTaskInstanceCurrentActivationsRef [0..1]: scope=ECU, multiplicity set at pre-compile in variant pre-compile / link in variant link-time, set at pre-compile in variant pre-compile / link in variant link-time, destination=ArtiObjectInstanceParameter  # Refers to the ArtiObjectInstanceParameter that contains the evaluation for the "current activations" of this task.
        reference ArtiOsTaskInstanceCurrentTaskStateRef [0..1]: scope=ECU, multiplicity set at pre-compile in variant pre-compile / link in variant link-time, set at pre-compile in variant pre-compile / link in variant link-time, destination=ArtiObjectInstanceParameter  # Refers to the ArtiObjectInstanceParameter that contains the evaluation for the "current state" of this task.
        reference ArtiOsTaskInstanceEcucRef: scope=ECU, set at pre-compile in variant pre-compile / link in variant link-time, destination=OsTask  # Refers to the EcuC OsTask that is being extended.
        reference ArtiOsTaskInstanceGenericComponentRef [0..1]: scope=ECU, multiplicity set at pre-compile in variant pre-compile / link in variant link-time, set at pre-compile in variant pre-compile / link in variant link-time, destination=ArtiGenericComponentInstance  # Refers to an ArtiGenericComponentInstance that extends the OsTask.
        reference ArtiOsTaskInstancePriorityRef [0..1]: scope=ECU, multiplicity set at pre-compile in variant pre-compile / link in variant link-time, set at pre-compile in variant pre-compile / link in variant link-time, destination=ArtiObjectInstanceParameter  # Refers to the ArtiObjectInstanceParameter that contains the evaluation for the "task priority" of this task.
        reference ArtiOsTaskInstanceStackRef [0..1]: scope=ECU, multiplicity set at pre-compile in variant pre-compile / link in variant link-time, set at pre-compile in variant pre-compile / link in variant link-time, destination=ArtiObjectInstanceParameter  # Refers to the ArtiObjectInstanceParameter that contains the evaluation for the ArtiOsStack of this ArtiOsTask.
        reference ArtiOsTaskInstanceValidRef [0..1]: scope=ECU, multiplicity set at pre-compile in variant pre-compile / link in variant link-time, set at pre-compile in variant pre-compile / link in variant link-time, destination=ArtiObjectInstanceParameter  # Refers to the ArtiObjectInstanceParameter that contains the evaluation for the "validity" of this ArtiOsTaskInstance.
    container ArtiValues [0..*]: multiplicity set at pre-compile  # The ArtiValues container collects all parameter values for ARTI that are filled by the generators (OS, RTE, ...)
      container ArtiConstant [0..*]: multiplicity set at pre-compile  # This container holds a constant value.
        string ArtiConstantString: scope=ECU, set at pre-compile  # This is the constant value for a specific parameter.
      container ArtiExpression [0..*]: multiplicity set at pre-compile  # This container holds a C like expression that a debugger can evaluate. This is similar to what is already done in ORTI.
        string ArtiExpressionString: scope=ECU, post-build-variant-value=true, set at pre-compile  # This string represents a C like expression that a debugger can evaluate.
      container ArtiHook [0..*]: multiplicity set at pre-compile  # This container represents an ARTI hook that is present in the module.
        function name ArtiHookAssociatedFunction [0..1]: multiplicity set at pre-compile, set at pre-compile  # Name of the C function that is associated with this hook.
        string ArtiHookClass: scope=ECU, set at pre-compile  # Name of the (schedule) class of macros. Classes can be one of the predefined classes or user defined.
        string ArtiHookContext: scope=ECU, set at pre-compile  # Name of the execution context. One of NOSUSP, SPRVSR, or USER. See also chapter "ARTI Tracing Macro".
        string ArtiHookEventName: scope=ECU, set at pre-compile  # The name of the event as defined for a particular class, or an arbitrary name for generic classes.
        string ArtiHookFileName [0..1]: scope=ECU, multiplicity set at pre-compile, set at pre-compile  # File name (possibly with path) where this ArtiHook is implemented.
        string ArtiHookInstance: scope=ECU, set at pre-compile  # Name of an instance of the (schedule) class.
        foreign reference ArtiHookEntryRef [0..1]: multiplicity set at pre-compile, set at pre-compile, destination-type=BSW-MODULE-ENTRY  # Reference to the BswModuleEntry that describes the parameters of this hook.
        reference ArtiHookEventParameterTypeRef [0..1]: scope=ECU, multiplicity set at pre-compile, set at pre-compile, destination=ArtiParameterTypeMap  # Refers to a parameter type to interpret the hook event number.
        reference ArtiHookInstanceParameterTypeRef [0..1]: scope=ECU, multiplicity set at pre-compile, set at pre-compile, destination=ArtiParameterTypeMap  # Refers to a parameter type to interpret the hook instance number.
      container ArtiObjectClassParameter [0..*]: multiplicity set at pre-compile  # This container represents a parameter of an Arti object class definition.
        reference ArtiObjectClassParameterTypeMapRef [0..1]: scope=ECU, multiplicity set at pre-compile, set at pre-compile, destination=ArtiParameterTypeMap  # Refers to a parameter type to interpret the instance parameter value.
      container ArtiObjectInstanceParameter [0..*]: multiplicity set at pre-compile  # This container represents a parameter of an Arti object instance.
        reference ArtiObjectInstanceParameterConstantRef [0..1]: scope=ECU, multiplicity set at pre-compile, set at pre-compile, destination=ArtiConstant  # Refers to a constant representing the value of this parameter.
        reference ArtiObjectInstanceParameterExpressionRef [0..1]: scope=ECU, multiplicity set at pre-compile, set at pre-compile, destination=ArtiExpression  # Refers to an expression that evaluates the value of this parameter.
        reference ArtiObjectInstanceParameterHookRef [0..1]: scope=ECU, multiplicity set at pre-compile, set at pre-compile, destination=ArtiHook  # Refers to a hook that records this parameter.
      container ArtiParameterTypeMap [0..*]: multiplicity set at pre-compile  # A map of key/value pairs to map a parameter value to a display string and/or an Arti or EcuC object.
        container ArtiParameterTypeMapPair [1..*]: multiplicity set at pre-compile  # A key/value pair to map a parameter value to a display string and/or an Arti or EcuC object.
          integer ArtiParameterTypeMapPairInput [0..1]: 0..18446744073709551615, scope=ECU, multiplicity set at pre-compile, set at pre-compile  # The numerical value given by a parameter to translate. When used with ArtiHooks, this parameter is mandatory (multiplicity 1) and its value is limited to the range of 0..65535. This parameter may be used to map the values given by "instanceParameter" and/or the "eventParameter" of the ARTI_TRACE macro.
          string ArtiParameterTypeMapPairOutput [0..1]: scope=ECU, multiplicity set at pre-compile, set at pre-compile  # The string to display for the Input value.
          reference ArtiParameterTypeMapPairInputExpressionRef [0..1]: scope=ECU, multiplicity set at pre-compile, set at pre-compile, destination=ArtiExpression  # Refers to an expression that evaluates to a numerical value to translate.
          choice reference ArtiParameterTypeMapPairOutputRef [0..1]: scope=ECU, multiplicity set at pre-compile, set at pre-compile, destination=[ArtiOsContextInstance, ArtiOsIsrInstance, ArtiOsStackInstance, ArtiOsTaskInstance, ArtiStatesScheduleTableState, ArtiStatesSpinlockOwnerType, ArtiStatesSpinlockState, ArtiStatesTaskState, OsAppMode]  # Choice Reference to ArtiOsTaskInstance, ArtiOsIsrInstance, ArtiStatesTaskState, OsAppMode, ArtiOsContextInstance, or ArtiOsStackInstance.
      container ArtiStates [0..*]: multiplicity set at pre-compile  # This container contains all states of tasks, isrs... that the EcuC uses.
        boolean ArtiStatesTaskEnhanced: set at pre-compile  # Set to true, if the OS provides an "enhanced" state model with "READY" split to "Activated", "Preempted", "Released".
        container ArtiStatesScheduleTableState [0..*]: multiplicity set at pre-compile  # Each state used by the OsScheduleTable has to be listed as ArtiStatesScheduleTableState parameter with a choice of the states.
          enumeration ArtiStatesScheduleTableStateEnum: {ArtiScheduleTableStateNext, ArtiScheduleTableStateRunning, ArtiScheduleTableStateRunningAndSynchronous, ArtiScheduleTableStateStopped, ArtiScheduleTableStateWaiting}, set at pre-compile  # ArtiStatesScheduleTableState choice of the states.
        container ArtiStatesSpinlockOwnerType [0..*]: multiplicity set at pre-compile  # Each owner type used by the OsSpinlock has to be listed as ArtiStatesSpinlockOwnerType parameter with a choice of the states.
          enumeration ArtiStatesSpinlockOwnerTypeEnum: {ArtiSpinlockOwnerTypeIsr2, ArtiSpinlockOwnerTypeTask}, set at pre-compile  # ArtiStatesSpinlockOwnerType choice of the states.
        container ArtiStatesSpinlockState [0..*]: multiplicity set at pre-compile  # Each state used by the OsSpinlock has to be listed as ArtiStatesSpinlockState parameter with a choice of the states.
          enumeration ArtiStatesSpinlockStateEnum: {ArtiSpinlockStateLocked, ArtiSpinlockStateUnlocked}, set at pre-compile  # ArtiStatesSpinlockState choice of the states.
        container ArtiStatesTaskState [0..*]: multiplicity set at pre-compile  # Each state used by the OS has to be listed as ArtiStatesTaskState Parameter with a choice of the states.
          enumeration ArtiStatesTaskStateEnum: {ArtiTaskStateActivated, ArtiTaskStatePreempted, ArtiTaskStateReady, ArtiTaskStateReleased, ArtiTaskStateRunning, ArtiTaskStateSuspended, ArtiTaskStateWaiting}, set at pre-compile  # ArtiStatesTaskState choice of the states.
