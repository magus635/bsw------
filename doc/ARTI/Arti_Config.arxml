AUTOSAR XML (schema 4-4-0)
package /Arti
  module config Arti: implementation-config-variant=VARIANT-PRE-COMPILE
    ArtiValues
      ArtiStates: ArtiStatesTaskEnhanced=true
        7 x ArtiStatesTaskState:
          S_TaskRunning: ArtiStatesTaskStateEnum=ArtiTaskStateRunning
          S_TaskReady: ArtiStatesTaskStateEnum=ArtiTaskStateReady
          S_TaskWaiting: ArtiStatesTaskStateEnum=ArtiTaskStateWaiting
          S_TaskSuspended: ArtiStatesTaskStateEnum=ArtiTaskStateSuspended
          S_TaskActivated: ArtiStatesTaskStateEnum=ArtiTaskStateActivated
          S_TaskPreempted: ArtiStatesTaskStateEnum=ArtiTaskStatePreempted
          S_TaskReleased: ArtiStatesTaskStateEnum=ArtiTaskStateReleased
      24 x ArtiParameterTypeMap:
        TM_TaskId
          14 x ArtiParameterTypeMapPair:
            Idle_Task_Core0: ArtiParameterTypeMapPairInput=0, ArtiParameterTypeMapPairOutput=Idle_Task_Core0, ArtiParameterTypeMapPairOutputRef=ArtiOs/Idle_Task_Core0
            Default_BSW_Sync_Task: ArtiParameterTypeMapPairInput=1, ArtiParameterTypeMapPairOutput=Default_BSW_Sync_Task, ArtiParameterTypeMapPairOutputRef=ArtiOs/Default_BSW_Sync_Task
            Default_RTE_Mode_switch_Task: ArtiParameterTypeMapPairInput=2, ArtiParameterTypeMapPairOutput=Default_RTE_Mode_switch_Task, ArtiParameterTypeMapPairOutputRef=ArtiOs/Default_RTE_Mode_switch_Task
            StartApplication_Appl_Init_Task: ArtiParameterTypeMapPairInput=3, ArtiParameterTypeMapPairOutput=StartApplication_Appl_Init_Task, ArtiParameterTypeMapPairOutputRef=ArtiOs/StartApplication_Appl_Init_Task
            Default_Init_Task: ArtiParameterTypeMapPairInput=4, ArtiParameterTypeMapPairOutput=Default_Init_Task, ArtiParameterTypeMapPairOutputRef=ArtiOs/Default_Init_Task
            Default_Init_Task_Trusted: ArtiParameterTypeMapPairInput=5, ArtiParameterTypeMapPairOutput=Default_Init_Task_Trusted, ArtiParameterTypeMapPairOutputRef=ArtiOs/Default_Init_Task_Trusted
            Idle_Task_Core1: ArtiParameterTypeMapPairInput=6, ArtiParameterTypeMapPairOutput=Idle_Task_Core1, ArtiParameterTypeMapPairOutputRef=ArtiOs/Idle_Task_Core1
            Default_BSW_Async_Task_Core0: ArtiParameterTypeMapPairInput=7, ArtiParameterTypeMapPairOutput=Default_BSW_Async_Task_Core0, ArtiParameterTypeMapPairOutputRef=ArtiOs/Default_BSW_Async_Task_Core0
            Default_BSW_Async_Task_Core1: ArtiParameterTypeMapPairInput=8, ArtiParameterTypeMapPairOutput=Default_BSW_Async_Task_Core1, ArtiParameterTypeMapPairOutputRef=ArtiOs/Default_BSW_Async_Task_Core1
            StartApplication_Appl_Task_Core0: ArtiParameterTypeMapPairInput=9, ArtiParameterTypeMapPairOutput=StartApplication_Appl_Task_Core0, ArtiParameterTypeMapPairOutputRef=ArtiOs/StartApplication_Appl_Task_Core0
            StartApplication_Appl_Task_Core1: ArtiParameterTypeMapPairInput=10, ArtiParameterTypeMapPairOutput=StartApplication_Appl_Task_Core1, ArtiParameterTypeMapPairOutputRef=ArtiOs/StartApplication_Appl_Task_Core1
            Default_Init_Task_Core1: ArtiParameterTypeMapPairInput=11, ArtiParameterTypeMapPairOutput=Default_Init_Task_Core1, ArtiParameterTypeMapPairOutputRef=ArtiOs/Default_Init_Task_Core1
            Default_Init_Task_Core1_Trusted: ArtiParameterTypeMapPairInput=12, ArtiParameterTypeMapPairOutput=Default_Init_Task_Core1_Trusted, ArtiParameterTypeMapPairOutputRef=ArtiOs/Default_Init_Task_Core1_Trusted
            NO_TASK: ArtiParameterTypeMapPairInput=13, ArtiParameterTypeMapPairOutput=NO_TASK
        TM_TaskPriority
          14 x ArtiParameterTypeMapPair:
            Idle_Task_Core0: ArtiParameterTypeMapPairInput=0, ArtiParameterTypeMapPairOutput=4294967295
            Default_BSW_Sync_Task: ArtiParameterTypeMapPairInput=1, ArtiParameterTypeMapPairOutput=40
            Default_RTE_Mode_switch_Task: ArtiParameterTypeMapPairInput=2, ArtiParameterTypeMapPairOutput=10
            StartApplication_Appl_Init_Task: ArtiParameterTypeMapPairInput=3, ArtiParameterTypeMapPairOutput=45
            Default_Init_Task: ArtiParameterTypeMapPairInput=4, ArtiParameterTypeMapPairOutput=50
            Default_Init_Task_Trusted: ArtiParameterTypeMapPairInput=5, ArtiParameterTypeMapPairOutput=49
            Idle_Task_Core1: ArtiParameterTypeMapPairInput=6, ArtiParameterTypeMapPairOutput=4294967295
            Default_BSW_Async_Task_Core0: ArtiParameterTypeMapPairInput=7, ArtiParameterTypeMapPairOutput=30
            Default_BSW_Async_Task_Core1: ArtiParameterTypeMapPairInput=8, ArtiParameterTypeMapPairOutput=30
            StartApplication_Appl_Task_Core0: ArtiParameterTypeMapPairInput=9, ArtiParameterTypeMapPairOutput=5
            StartApplication_Appl_Task_Core1: ArtiParameterTypeMapPairInput=10, ArtiParameterTypeMapPairOutput=5
            Default_Init_Task_Core1: ArtiParameterTypeMapPairInput=11, ArtiParameterTypeMapPairOutput=50
            Default_Init_Task_Core1_Trusted: ArtiParameterTypeMapPairInput=12, ArtiParameterTypeMapPairOutput=49
            NO_TASK: ArtiParameterTypeMapPairInput=13, ArtiParameterTypeMapPairOutput=-
        TM_Isr2Id
          8 x ArtiParameterTypeMapPair:
            CAN_00_RXFIFO_ISR: ArtiParameterTypeMapPairInput=0, ArtiParameterTypeMapPairOutput=CAN_00_RXFIFO_ISR, ArtiParameterTypeMapPairOutputRef=ArtiOs/CAN_00_RXFIFO_ISR
            CAN_00_TX_ISR: ArtiParameterTypeMapPairInput=1, ArtiParameterTypeMapPairOutput=CAN_00_TX_ISR, ArtiParameterTypeMapPairOutputRef=ArtiOs/CAN_00_TX_ISR
            CAN_00_RX_ISR: ArtiParameterTypeMapPairInput=2, ArtiParameterTypeMapPairOutput=CAN_00_RX_ISR, ArtiParameterTypeMapPairOutputRef=ArtiOs/CAN_00_RX_ISR
            CounterIsr_SystemTimer_core0: ArtiParameterTypeMapPairInput=3, ArtiParameterTypeMapPairOutput=CounterIsr_SystemTimer_core0, ArtiParameterTypeMapPairOutputRef=ArtiOs/CounterIsr_SystemTimer_core0
            CounterIsr_SystemTimer_core1: ArtiParameterTypeMapPairInput=4, ArtiParameterTypeMapPairOutput=CounterIsr_SystemTimer_core1, ArtiParameterTypeMapPairOutputRef=ArtiOs/CounterIsr_SystemTimer_core1
            XSignalIsr_OsCore1: ArtiParameterTypeMapPairInput=5, ArtiParameterTypeMapPairOutput=XSignalIsr_OsCore1, ArtiParameterTypeMapPairOutputRef=ArtiOs/XSignalIsr_OsCore1
            XSignalIsr_OsCore0: ArtiParameterTypeMapPairInput=6, ArtiParameterTypeMapPairOutput=XSignalIsr_OsCore0, ArtiParameterTypeMapPairOutputRef=ArtiOs/XSignalIsr_OsCore0
            NO_ISR: ArtiParameterTypeMapPairInput=7, ArtiParameterTypeMapPairOutput=NO_ISR
        TM_TaskState
          4 x ArtiParameterTypeMapPair:
            RUNNING: ArtiParameterTypeMapPairInput=0, ArtiParameterTypeMapPairOutput=RUNNING, ArtiParameterTypeMapPairOutputRef=S_TaskRunning
            READY: ArtiParameterTypeMapPairInput=1, ArtiParameterTypeMapPairOutput=READY, ArtiParameterTypeMapPairOutputRef=S_TaskReady
            WAITING: ArtiParameterTypeMapPairInput=2, ArtiParameterTypeMapPairOutput=WAITING, ArtiParameterTypeMapPairOutputRef=S_TaskWaiting
            SUSPENDED: ArtiParameterTypeMapPairInput=3, ArtiParameterTypeMapPairOutput=SUSPENDED, ArtiParameterTypeMapPairOutputRef=S_TaskSuspended
        TM_AppMode
          OS_APPMODE_ANY (ArtiParameterTypeMapPair): ArtiParameterTypeMapPairInput=1, ArtiParameterTypeMapPairOutput=OS_APPMODE_ANY, ArtiParameterTypeMapPairOutputRef=OS_APPMODE_ANY
        TM_ApplicationId
          5 x ArtiParameterTypeMapPair:
            SystemApplication_OsCore0: ArtiParameterTypeMapPairInput=0, ArtiParameterTypeMapPairOutput=SystemApplication_OsCore0
            OsApplication_Trusted_Core0: ArtiParameterTypeMapPairInput=1, ArtiParameterTypeMapPairOutput=OsApplication_Trusted_Core0
            SystemApplication_OsCore1: ArtiParameterTypeMapPairInput=2, ArtiParameterTypeMapPairOutput=SystemApplication_OsCore1
            OsApplication_Trusted_Core1: ArtiParameterTypeMapPairInput=3, ArtiParameterTypeMapPairOutput=OsApplication_Trusted_Core1
            NO_APPLICATION: ArtiParameterTypeMapPairInput=4, ArtiParameterTypeMapPairOutput=NO_APPLICATION
        TM_TaskStack
          13 x ArtiParameterTypeMapPair:
            Idle_Task_Core0: ArtiParameterTypeMapPairOutput=Idle_Task_Core0, ArtiParameterTypeMapPairInputExpressionRef=E_Idle_Task_Core0_StackBase, ArtiParameterTypeMapPairOutputRef=Idle_Task_Core0_stack
            Default_BSW_Sync_Task: ArtiParameterTypeMapPairOutput=Default_BSW_Sync_Task, ArtiParameterTypeMapPairInputExpressionRef=E_Default_BSW_Sync_Task_StackBase, ArtiParameterTypeMapPairOutputRef=Default_BSW_Sync_Task_stack
            Default_RTE_Mode_switch_Task: ArtiParameterTypeMapPairOutput=Default_RTE_Mode_switch_Task, ArtiParameterTypeMapPairInputExpressionRef=E_Default_RTE_Mode_switch_Task_StackBase, ArtiParameterTypeMapPairOutputRef=Default_RTE_Mode_switch_Task_stack
            StartApplication_Appl_Init_Task: ArtiParameterTypeMapPairOutput=StartApplication_Appl_Init_Task, ArtiParameterTypeMapPairInputExpressionRef=E_StartApplication_Appl_Init_Task_StackBase, ArtiParameterTypeMapPairOutputRef=StartApplication_Appl_Init_Task_stack
            Default_Init_Task: ArtiParameterTypeMapPairOutput=Default_Init_Task, ArtiParameterTypeMapPairInputExpressionRef=E_Default_Init_Task_StackBase, ArtiParameterTypeMapPairOutputRef=Default_Init_Task_stack
            Default_Init_Task_Trusted: ArtiParameterTypeMapPairOutput=Default_Init_Task_Trusted, ArtiParameterTypeMapPairInputExpressionRef=E_Default_Init_Task_Trusted_StackBase, ArtiParameterTypeMapPairOutputRef=Default_Init_Task_Trusted_stack
            Idle_Task_Core1: ArtiParameterTypeMapPairOutput=Idle_Task_Core1, ArtiParameterTypeMapPairInputExpressionRef=E_Idle_Task_Core1_StackBase, ArtiParameterTypeMapPairOutputRef=Idle_Task_Core1_stack
            Default_BSW_Async_Task_Core0: ArtiParameterTypeMapPairOutput=Default_BSW_Async_Task_Core0, ArtiParameterTypeMapPairInputExpressionRef=E_Default_BSW_Async_Task_Core0_StackBase, ArtiParameterTypeMapPairOutputRef=Default_BSW_Async_Task_Core0_stack
            Default_BSW_Async_Task_Core1: ArtiParameterTypeMapPairOutput=Default_BSW_Async_Task_Core1, ArtiParameterTypeMapPairInputExpressionRef=E_Default_BSW_Async_Task_Core1_StackBase, ArtiParameterTypeMapPairOutputRef=Default_BSW_Async_Task_Core1_stack
            StartApplication_Appl_Task_Core0: ArtiParameterTypeMapPairOutput=StartApplication_Appl_Task_Core0, ArtiParameterTypeMapPairInputExpressionRef=E_StartApplication_Appl_Task_Core0_StackBase, ArtiParameterTypeMapPairOutputRef=StartApplication_Appl_Task_Core0_stack
            StartApplication_Appl_Task_Core1: ArtiParameterTypeMapPairOutput=StartApplication_Appl_Task_Core1, ArtiParameterTypeMapPairInputExpressionRef=E_StartApplication_Appl_Task_Core1_StackBase, ArtiParameterTypeMapPairOutputRef=StartApplication_Appl_Task_Core1_stack
            Default_Init_Task_Core1: ArtiParameterTypeMapPairOutput=Default_Init_Task_Core1, ArtiParameterTypeMapPairInputExpressionRef=E_Default_Init_Task_Core1_StackBase, ArtiParameterTypeMapPairOutputRef=Default_Init_Task_Core1_stack
            Default_Init_Task_Core1_Trusted: ArtiParameterTypeMapPairOutput=Default_Init_Task_Core1_Trusted, ArtiParameterTypeMapPairInputExpressionRef=E_Default_Init_Task_Core1_Trusted_StackBase, ArtiParameterTypeMapPairOutputRef=Default_Init_Task_Core1_Trusted_stack
        TM_TaskContext
          13 x ArtiParameterTypeMapPair:
            Idle_Task_Core0: ArtiParameterTypeMapPairOutput=Idle_Task_Core0, ArtiParameterTypeMapPairInputExpressionRef=E_Idle_Task_Core0_Context, ArtiParameterTypeMapPairOutputRef=Idle_Task_Core0_ContextInfo
            Default_BSW_Sync_Task: ArtiParameterTypeMapPairOutput=Default_BSW_Sync_Task, ArtiParameterTypeMapPairInputExpressionRef=E_Default_BSW_Sync_Task_Context, ArtiParameterTypeMapPairOutputRef=Default_BSW_Sync_Task_ContextInfo
            Default_RTE_Mode_switch_Task: ArtiParameterTypeMapPairOutput=Default_RTE_Mode_switch_Task, ArtiParameterTypeMapPairInputExpressionRef=E_Default_RTE_Mode_switch_Task_Context, ArtiParameterTypeMapPairOutputRef=Default_RTE_Mode_switch_Task_ContextInfo
            StartApplication_Appl_Init_Task: ArtiParameterTypeMapPairOutput=StartApplication_Appl_Init_Task, ArtiParameterTypeMapPairInputExpressionRef=E_StartApplication_Appl_Init_Task_Context, ArtiParameterTypeMapPairOutputRef=StartApplication_Appl_Init_Task_ContextInfo
            Default_Init_Task: ArtiParameterTypeMapPairOutput=Default_Init_Task, ArtiParameterTypeMapPairInputExpressionRef=E_Default_Init_Task_Context, ArtiParameterTypeMapPairOutputRef=Default_Init_Task_ContextInfo
            Default_Init_Task_Trusted: ArtiParameterTypeMapPairOutput=Default_Init_Task_Trusted, ArtiParameterTypeMapPairInputExpressionRef=E_Default_Init_Task_Trusted_Context, ArtiParameterTypeMapPairOutputRef=Default_Init_Task_Trusted_ContextInfo
            Idle_Task_Core1: ArtiParameterTypeMapPairOutput=Idle_Task_Core1, ArtiParameterTypeMapPairInputExpressionRef=E_Idle_Task_Core1_Context, ArtiParameterTypeMapPairOutputRef=Idle_Task_Core1_ContextInfo
            Default_BSW_Async_Task_Core0: ArtiParameterTypeMapPairOutput=Default_BSW_Async_Task_Core0, ArtiParameterTypeMapPairInputExpressionRef=E_Default_BSW_Async_Task_Core0_Context, ArtiParameterTypeMapPairOutputRef=Default_BSW_Async_Task_Core0_ContextInfo
            Default_BSW_Async_Task_Core1: ArtiParameterTypeMapPairOutput=Default_BSW_Async_Task_Core1, ArtiParameterTypeMapPairInputExpressionRef=E_Default_BSW_Async_Task_Core1_Context, ArtiParameterTypeMapPairOutputRef=Default_BSW_Async_Task_Core1_ContextInfo
            StartApplication_Appl_Task_Core0: ArtiParameterTypeMapPairOutput=StartApplication_Appl_Task_Core0, ArtiParameterTypeMapPairInputExpressionRef=E_StartApplication_Appl_Task_Core0_Context, ArtiParameterTypeMapPairOutputRef=StartApplication_Appl_Task_Core0_ContextInfo
            StartApplication_Appl_Task_Core1: ArtiParameterTypeMapPairOutput=StartApplication_Appl_Task_Core1, ArtiParameterTypeMapPairInputExpressionRef=E_StartApplication_Appl_Task_Core1_Context, ArtiParameterTypeMapPairOutputRef=StartApplication_Appl_Task_Core1_ContextInfo
            Default_Init_Task_Core1: ArtiParameterTypeMapPairOutput=Default_Init_Task_Core1, ArtiParameterTypeMapPairInputExpressionRef=E_Default_Init_Task_Core1_Context, ArtiParameterTypeMapPairOutputRef=Default_Init_Task_Core1_ContextInfo
            Default_Init_Task_Core1_Trusted: ArtiParameterTypeMapPairOutput=Default_Init_Task_Core1_Trusted, ArtiParameterTypeMapPairInputExpressionRef=E_Default_Init_Task_Core1_Trusted_Context, ArtiParameterTypeMapPairOutputRef=Default_Init_Task_Core1_Trusted_ContextInfo
        TM_AlarmState
          ALARM_ENABLED (ArtiParameterTypeMapPair): ArtiParameterTypeMapPairInput=0, ArtiParameterTypeMapPairOutput=ALARM_ENABLED
          ALARM_DISABLED (ArtiParameterTypeMapPair): ArtiParameterTypeMapPairInput=1, ArtiParameterTypeMapPairOutput=ALARM_DISABLED
        TM_ResourceState
          UNLOCKED (ArtiParameterTypeMapPair): ArtiParameterTypeMapPairInput=0, ArtiParameterTypeMapPairOutput=UNLOCKED
          LOCKED (ArtiParameterTypeMapPair): ArtiParameterTypeMapPairInput=1, ArtiParameterTypeMapPairOutput=LOCKED
        TM_ObjectOwner
          21 x ArtiParameterTypeMapPair:
            Task_Idle_Task_Core0: ArtiParameterTypeMapPairInput=0, ArtiParameterTypeMapPairOutput=Task Idle_Task_Core0
            ISR_CounterIsr_SystemTimer_core0: ArtiParameterTypeMapPairInput=1, ArtiParameterTypeMapPairOutput=ISR CounterIsr_SystemTimer_core0
            ISR_XSignalIsr_OsCore0: ArtiParameterTypeMapPairInput=2, ArtiParameterTypeMapPairOutput=ISR XSignalIsr_OsCore0
            Task_Default_BSW_Sync_Task: ArtiParameterTypeMapPairInput=6, ArtiParameterTypeMapPairOutput=Task Default_BSW_Sync_Task
            Task_Default_RTE_Mode_switch_Task: ArtiParameterTypeMapPairInput=7, ArtiParameterTypeMapPairOutput=Task Default_RTE_Mode_switch_Task
            Task_StartApplication_Appl_Init_Task: ArtiParameterTypeMapPairInput=8, ArtiParameterTypeMapPairOutput=Task StartApplication_Appl_Init_Task
            Task_Default_Init_Task: ArtiParameterTypeMapPairInput=9, ArtiParameterTypeMapPairOutput=Task Default_Init_Task
            Task_Default_Init_Task_Trusted: ArtiParameterTypeMapPairInput=10, ArtiParameterTypeMapPairOutput=Task Default_Init_Task_Trusted
            Task_Default_BSW_Async_Task_Core0: ArtiParameterTypeMapPairInput=11, ArtiParameterTypeMapPairOutput=Task Default_BSW_Async_Task_Core0
            Task_StartApplication_Appl_Task_Core0: ArtiParameterTypeMapPairInput=12, ArtiParameterTypeMapPairOutput=Task StartApplication_Appl_Task_Core0
            ISR_CAN_00_RX_ISR: ArtiParameterTypeMapPairInput=13, ArtiParameterTypeMapPairOutput=ISR CAN_00_RX_ISR
            ISR_CAN_00_RXFIFO_ISR: ArtiParameterTypeMapPairInput=14, ArtiParameterTypeMapPairOutput=ISR CAN_00_RXFIFO_ISR
            ISR_CAN_00_TX_ISR: ArtiParameterTypeMapPairInput=15, ArtiParameterTypeMapPairOutput=ISR CAN_00_TX_ISR
            Task_Idle_Task_Core1: ArtiParameterTypeMapPairInput=22, ArtiParameterTypeMapPairOutput=Task Idle_Task_Core1
            ISR_CounterIsr_SystemTimer_core1: ArtiParameterTypeMapPairInput=23, ArtiParameterTypeMapPairOutput=ISR CounterIsr_SystemTimer_core1
            ISR_XSignalIsr_OsCore1: ArtiParameterTypeMapPairInput=24, ArtiParameterTypeMapPairOutput=ISR XSignalIsr_OsCore1
            Task_Default_BSW_Async_Task_Core1: ArtiParameterTypeMapPairInput=28, ArtiParameterTypeMapPairOutput=Task Default_BSW_Async_Task_Core1
            Task_StartApplication_Appl_Task_Core1: ArtiParameterTypeMapPairInput=29, ArtiParameterTypeMapPairOutput=Task StartApplication_Appl_Task_Core1
            Task_Default_Init_Task_Core1: ArtiParameterTypeMapPairInput=30, ArtiParameterTypeMapPairOutput=Task Default_Init_Task_Core1
            Task_Default_Init_Task_Core1_Trusted: ArtiParameterTypeMapPairInput=31, ArtiParameterTypeMapPairOutput=Task Default_Init_Task_Core1_Trusted
            NONE: ArtiParameterTypeMapPairInput=4294967295, ArtiParameterTypeMapPairOutput=-
        TM_TaskType
          BASIC (ArtiParameterTypeMapPair): ArtiParameterTypeMapPairInput=0, ArtiParameterTypeMapPairOutput=BASIC
          EXTENDED (ArtiParameterTypeMapPair): ArtiParameterTypeMapPairInput=1, ArtiParameterTypeMapPairOutput=EXTENDED
        TM_AlarmAction
          4 x ArtiParameterTypeMapPair:
            ALARM_ACTIVATETASK: ArtiParameterTypeMapPairInput=0, ArtiParameterTypeMapPairOutput=ALARM_ACTIVATETASK
            ALARM_SETEVENT: ArtiParameterTypeMapPairInput=1, ArtiParameterTypeMapPairOutput=ALARM_SETEVENT
            ALARM_CALLBACK: ArtiParameterTypeMapPairInput=2, ArtiParameterTypeMapPairOutput=ALARM_CALLBACK
            ALARM_INCREMENTCOUNTER: ArtiParameterTypeMapPairInput=3, ArtiParameterTypeMapPairOutput=ALARM_INCREMENTCOUNTER
        TM_LockedByTask
          OsResource (ArtiParameterTypeMapPair): ArtiParameterTypeMapPairOutput=OsResource, ArtiParameterTypeMapPairInputExpressionRef=E_LockAddr_OsResource
          NONE (ArtiParameterTypeMapPair): ArtiParameterTypeMapPairInput=0, ArtiParameterTypeMapPairOutput=-
        TM_LockedByResource
          OsResource (ArtiParameterTypeMapPair): ArtiParameterTypeMapPairOutput=OsResource, ArtiParameterTypeMapPairInputExpressionRef=E_LockAddr_OsResource
          NONE (ArtiParameterTypeMapPair): ArtiParameterTypeMapPairInput=4294967295, ArtiParameterTypeMapPairOutput=-
        TM_LastError
          28 x ArtiParameterTypeMapPair:
            E_OK: ArtiParameterTypeMapPairInput=0, ArtiParameterTypeMapPairOutput=E_OK
            E_OS_ACCESS: ArtiParameterTypeMapPairInput=1, ArtiParameterTypeMapPairOutput=E_OS_ACCESS
            E_OS_CALLEVEL: ArtiParameterTypeMapPairInput=2, ArtiParameterTypeMapPairOutput=E_OS_CALLEVEL
            E_OS_ID: ArtiParameterTypeMapPairInput=3, ArtiParameterTypeMapPairOutput=E_OS_ID
            E_OS_LIMIT: ArtiParameterTypeMapPairInput=4, ArtiParameterTypeMapPairOutput=E_OS_LIMIT
            E_OS_NOFUNC: ArtiParameterTypeMapPairInput=5, ArtiParameterTypeMapPairOutput=E_OS_NOFUNC
            E_OS_RESOURCE: ArtiParameterTypeMapPairInput=6, ArtiParameterTypeMapPairOutput=E_OS_RESOURCE
            E_OS_STATE: ArtiParameterTypeMapPairInput=7, ArtiParameterTypeMapPairOutput=E_OS_STATE
            E_OS_VALUE: ArtiParameterTypeMapPairInput=8, ArtiParameterTypeMapPairOutput=E_OS_VALUE
            E_OS_SERVICEID: ArtiParameterTypeMapPairInput=9, ArtiParameterTypeMapPairOutput=E_OS_SERVICEID
            E_OS_ILLEGAL_ADDRESS: ArtiParameterTypeMapPairInput=10, ArtiParameterTypeMapPairOutput=E_OS_ILLEGAL_ADDRESS
            E_OS_MISSINGEND: ArtiParameterTypeMapPairInput=11, ArtiParameterTypeMapPairOutput=E_OS_MISSINGEND
            E_OS_DISABLEDINT: ArtiParameterTypeMapPairInput=12, ArtiParameterTypeMapPairOutput=E_OS_DISABLEDINT
            E_OS_STACKFAULT: ArtiParameterTypeMapPairInput=13, ArtiParameterTypeMapPairOutput=E_OS_STACKFAULT
            E_OS_PROTECTION_MEMORY: ArtiParameterTypeMapPairInput=14, ArtiParameterTypeMapPairOutput=E_OS_PROTECTION_MEMORY
            E_OS_PROTECTION_TIME: ArtiParameterTypeMapPairInput=15, ArtiParameterTypeMapPairOutput=E_OS_PROTECTION_TIME
            E_OS_PROTECTION_ARRIVAL: ArtiParameterTypeMapPairInput=16, ArtiParameterTypeMapPairOutput=E_OS_PROTECTION_ARRIVAL
            E_OS_PROTECTION_LOCKED: ArtiParameterTypeMapPairInput=17, ArtiParameterTypeMapPairOutput=E_OS_PROTECTION_LOCKED
            E_OS_PROTECTION_EXCEPTION: ArtiParameterTypeMapPairInput=18, ArtiParameterTypeMapPairOutput=E_OS_PROTECTION_EXCEPTION
            E_OS_SPINLOCK: ArtiParameterTypeMapPairInput=19, ArtiParameterTypeMapPairOutput=E_OS_SPINLOCK
            E_OS_INTERFERENCE_DEADLOCK: ArtiParameterTypeMapPairInput=20, ArtiParameterTypeMapPairOutput=E_OS_INTERFERENCE_DEADLOCK
            E_OS_NESTING_DEADLOCK: ArtiParameterTypeMapPairInput=21, ArtiParameterTypeMapPairOutput=E_OS_NESTING_DEADLOCK
            E_OS_CORE: ArtiParameterTypeMapPairInput=22, ArtiParameterTypeMapPairOutput=E_OS_CORE
            E_OS_PARAM_POINTER: ArtiParameterTypeMapPairInput=23, ArtiParameterTypeMapPairOutput=E_OS_PARAM_POINTER
            E_OS_SYS_API_ERROR: ArtiParameterTypeMapPairInput=24, ArtiParameterTypeMapPairOutput=E_OS_SYS_API_ERROR
            E_OS_STATUS_ACCESSRIGHTS: ArtiParameterTypeMapPairInput=25, ArtiParameterTypeMapPairOutput=E_OS_STATUS_ACCESSRIGHTS
            E_OS_SYS_UNDEFINED_IRQ: ArtiParameterTypeMapPairInput=32, ArtiParameterTypeMapPairOutput=E_OS_SYS_UNDEFINED_IRQ
            E_OS_NO_PRE_TASK: ArtiParameterTypeMapPairInput=33, ArtiParameterTypeMapPairOutput=E_OS_NO_PRE_TASK
        TM_ServiceId
          84 x ArtiParameterTypeMapPair:
            NOSERVICE: ArtiParameterTypeMapPairInput=0, ArtiParameterTypeMapPairOutput=NOSERVICE
            GETAPPLICATIONID: ArtiParameterTypeMapPairInput=2, ArtiParameterTypeMapPairOutput=GETAPPLICATIONID
            GETISRID: ArtiParameterTypeMapPairInput=4, ArtiParameterTypeMapPairOutput=GETISRID
            CALLTRUSTEDFUNCTION: ArtiParameterTypeMapPairInput=6, ArtiParameterTypeMapPairOutput=CALLTRUSTEDFUNCTION
            CHECKISRMEMORYACCESS: ArtiParameterTypeMapPairInput=8, ArtiParameterTypeMapPairOutput=CHECKISRMEMORYACCESS
            CHECKTASKMEMORYACCESS: ArtiParameterTypeMapPairInput=10, ArtiParameterTypeMapPairOutput=CHECKTASKMEMORYACCESS
            CHECKOBJECTACCESS: ArtiParameterTypeMapPairInput=12, ArtiParameterTypeMapPairOutput=CHECKOBJECTACCESS
            CHECKOBJECTOWNERSHIP: ArtiParameterTypeMapPairInput=14, ArtiParameterTypeMapPairOutput=CHECKOBJECTOWNERSHIP
            STARTSCHEDULETABLEREL: ArtiParameterTypeMapPairInput=16, ArtiParameterTypeMapPairOutput=STARTSCHEDULETABLEREL
            STARTSCHEDULETABLEABS: ArtiParameterTypeMapPairInput=18, ArtiParameterTypeMapPairOutput=STARTSCHEDULETABLEABS
            STOPSCHEDULETABLE: ArtiParameterTypeMapPairInput=20, ArtiParameterTypeMapPairOutput=STOPSCHEDULETABLE
            NEXTSCHEDULETABLE: ArtiParameterTypeMapPairInput=22, ArtiParameterTypeMapPairOutput=NEXTSCHEDULETABLE
            STARTSCHEDULETABLESYNCHRON: ArtiParameterTypeMapPairInput=24, ArtiParameterTypeMapPairOutput=STARTSCHEDULETABLESYNCHRON
            SYNCSCHEDULETABLE: ArtiParameterTypeMapPairInput=26, ArtiParameterTypeMapPairOutput=SYNCSCHEDULETABLE
            SETSCHEDULETABLEASYNC: ArtiParameterTypeMapPairInput=28, ArtiParameterTypeMapPairOutput=SETSCHEDULETABLEASYNC
            GETSCHEDULETABLESTATUS: ArtiParameterTypeMapPairInput=30, ArtiParameterTypeMapPairOutput=GETSCHEDULETABLESTATUS
            INCREMENTCOUNTER: ArtiParameterTypeMapPairInput=32, ArtiParameterTypeMapPairOutput=INCREMENTCOUNTER
            GETCOUNTERVALUE: ArtiParameterTypeMapPairInput=34, ArtiParameterTypeMapPairOutput=GETCOUNTERVALUE
            GETELAPSEDVALUE: ArtiParameterTypeMapPairInput=36, ArtiParameterTypeMapPairOutput=GETELAPSEDVALUE
            TERMINATEAPPLICATION: ArtiParameterTypeMapPairInput=38, ArtiParameterTypeMapPairOutput=TERMINATEAPPLICATION
            ALLOWACCESS: ArtiParameterTypeMapPairInput=40, ArtiParameterTypeMapPairOutput=ALLOWACCESS
            GETAPPLICATIONSTATE: ArtiParameterTypeMapPairInput=42, ArtiParameterTypeMapPairOutput=GETAPPLICATIONSTATE
            GETNUMBEROFACTIVATEDCORES: ArtiParameterTypeMapPairInput=44, ArtiParameterTypeMapPairOutput=GETNUMBEROFACTIVATEDCORES
            GETCOREID: ArtiParameterTypeMapPairInput=46, ArtiParameterTypeMapPairOutput=GETCOREID
            STARTCORE: ArtiParameterTypeMapPairInput=48, ArtiParameterTypeMapPairOutput=STARTCORE
            GETSPINLOCK: ArtiParameterTypeMapPairInput=52, ArtiParameterTypeMapPairOutput=GETSPINLOCK
            RELEASESPINLOCK: ArtiParameterTypeMapPairInput=54, ArtiParameterTypeMapPairOutput=RELEASESPINLOCK
            TRYTOGETSPINLOCK: ArtiParameterTypeMapPairInput=56, ArtiParameterTypeMapPairOutput=TRYTOGETSPINLOCK
            SHUTDOWNALLCORES: ArtiParameterTypeMapPairInput=58, ArtiParameterTypeMapPairOutput=SHUTDOWNALLCORES
            CONTROLIDLE: ArtiParameterTypeMapPairInput=60, ArtiParameterTypeMapPairOutput=CONTROLIDLE
            IOCSENDIOCIDSENDERID: ArtiParameterTypeMapPairInput=62, ArtiParameterTypeMapPairOutput=IOCSENDIOCIDSENDERID
            IOCWRITEIOCIDSENDERID: ArtiParameterTypeMapPairInput=64, ArtiParameterTypeMapPairOutput=IOCWRITEIOCIDSENDERID
            IOCSENDGROUPIOCID: ArtiParameterTypeMapPairInput=66, ArtiParameterTypeMapPairOutput=IOCSENDGROUPIOCID
            IOCWRITEGROUPIOCID: ArtiParameterTypeMapPairInput=68, ArtiParameterTypeMapPairOutput=IOCWRITEGROUPIOCID
            IOCRECEIVEIOCID: ArtiParameterTypeMapPairInput=70, ArtiParameterTypeMapPairOutput=IOCRECEIVEIOCID
            IOCREADIOCIDRECEIVERID: ArtiParameterTypeMapPairInput=72, ArtiParameterTypeMapPairOutput=IOCREADIOCIDRECEIVERID
            IOCRECEIVEGROUPIOCID: ArtiParameterTypeMapPairInput=74, ArtiParameterTypeMapPairOutput=IOCRECEIVEGROUPIOCID
            IOCREADGROUPIOCID: ArtiParameterTypeMapPairInput=76, ArtiParameterTypeMapPairOutput=IOCREADGROUPIOCID
            IOCEMPTYQUEUE: ArtiParameterTypeMapPairInput=78, ArtiParameterTypeMapPairOutput=IOCEMPTYQUEUE
            GETCURRENTAPPLICATIONID: ArtiParameterTypeMapPairInput=80, ArtiParameterTypeMapPairOutput=GETCURRENTAPPLICATIONID
            READPERIPHERAL8: ArtiParameterTypeMapPairInput=82, ArtiParameterTypeMapPairOutput=READPERIPHERAL8
            READPERIPHERAL16: ArtiParameterTypeMapPairInput=84, ArtiParameterTypeMapPairOutput=READPERIPHERAL16
            READPERIPHERAL32: ArtiParameterTypeMapPairInput=86, ArtiParameterTypeMapPairOutput=READPERIPHERAL32
            WRITEPERIPHERAL8: ArtiParameterTypeMapPairInput=88, ArtiParameterTypeMapPairOutput=WRITEPERIPHERAL8
            WRITEPERIPHERAL16: ArtiParameterTypeMapPairInput=90, ArtiParameterTypeMapPairOutput=WRITEPERIPHERAL16
            WRITEPERIPHERAL32: ArtiParameterTypeMapPairInput=92, ArtiParameterTypeMapPairOutput=WRITEPERIPHERAL32
            MODIFYPERIPHERAL8: ArtiParameterTypeMapPairInput=94, ArtiParameterTypeMapPairOutput=MODIFYPERIPHERAL8
            MODIFYPERIPHERAL32: ArtiParameterTypeMapPairInput=96, ArtiParameterTypeMapPairOutput=MODIFYPERIPHERAL32
            DISABLEINTERRUPTSOURCE: ArtiParameterTypeMapPairInput=98, ArtiParameterTypeMapPairOutput=DISABLEINTERRUPTSOURCE
            ENABLEINTERRUPTSOURCE: ArtiParameterTypeMapPairInput=100, ArtiParameterTypeMapPairOutput=ENABLEINTERRUPTSOURCE
            CLEARPENDINGINTERRUPT: ArtiParameterTypeMapPairInput=102, ArtiParameterTypeMapPairOutput=CLEARPENDINGINTERRUPT
            ACTIVATETASKASYN: ArtiParameterTypeMapPairInput=104, ArtiParameterTypeMapPairOutput=ACTIVATETASKASYN
            SETEVENTASYN: ArtiParameterTypeMapPairInput=106, ArtiParameterTypeMapPairOutput=SETEVENTASYN
            MODIFYPERIPHERAL16: ArtiParameterTypeMapPairInput=108, ArtiParameterTypeMapPairOutput=MODIFYPERIPHERAL16
            ISOSSTARTED: ArtiParameterTypeMapPairInput=110, ArtiParameterTypeMapPairOutput=ISOSSTARTED
            STARTOS: ArtiParameterTypeMapPairInput=418, ArtiParameterTypeMapPairOutput=STARTOS
            GETACTIVATEAPPLICATIONMODE: ArtiParameterTypeMapPairInput=422, ArtiParameterTypeMapPairOutput=GETACTIVATEAPPLICATIONMODE
            DISABLEALLINTERRUPTS: ArtiParameterTypeMapPairInput=424, ArtiParameterTypeMapPairOutput=DISABLEALLINTERRUPTS
            ENABLEALLINTERRUPTS: ArtiParameterTypeMapPairInput=426, ArtiParameterTypeMapPairOutput=ENABLEALLINTERRUPTS
            SUSPENDALLINTERRUPTS: ArtiParameterTypeMapPairInput=428, ArtiParameterTypeMapPairOutput=SUSPENDALLINTERRUPTS
            RESUMEALLINTERRUPTS: ArtiParameterTypeMapPairInput=430, ArtiParameterTypeMapPairOutput=RESUMEALLINTERRUPTS
            SUSPENDOSINTERRUPTS: ArtiParameterTypeMapPairInput=432, ArtiParameterTypeMapPairOutput=SUSPENDOSINTERRUPTS
            RESUMEOSINTERRUPTS: ArtiParameterTypeMapPairInput=434, ArtiParameterTypeMapPairOutput=RESUMEOSINTERRUPTS
            ACTIVATETASK: ArtiParameterTypeMapPairInput=436, ArtiParameterTypeMapPairOutput=ACTIVATETASK
            TERMINATETASK: ArtiParameterTypeMapPairInput=438, ArtiParameterTypeMapPairOutput=TERMINATETASK
            CHAINTASK: ArtiParameterTypeMapPairInput=440, ArtiParameterTypeMapPairOutput=CHAINTASK
            GETTASKID: ArtiParameterTypeMapPairInput=442, ArtiParameterTypeMapPairOutput=GETTASKID
            GETTASKSTATE: ArtiParameterTypeMapPairInput=444, ArtiParameterTypeMapPairOutput=GETTASKSTATE
            SCHEDULE: ArtiParameterTypeMapPairInput=446, ArtiParameterTypeMapPairOutput=SCHEDULE
            SETEVENT: ArtiParameterTypeMapPairInput=448, ArtiParameterTypeMapPairOutput=SETEVENT
            CLEAREVENT: ArtiParameterTypeMapPairInput=450, ArtiParameterTypeMapPairOutput=CLEAREVENT
            GETEVENT: ArtiParameterTypeMapPairInput=452, ArtiParameterTypeMapPairOutput=GETEVENT
            WAITEVENT: ArtiParameterTypeMapPairInput=454, ArtiParameterTypeMapPairOutput=WAITEVENT
            GETALARMBASE: ArtiParameterTypeMapPairInput=456, ArtiParameterTypeMapPairOutput=GETALARMBASE
            GETALARM: ArtiParameterTypeMapPairInput=458, ArtiParameterTypeMapPairOutput=GETALARM
            SETRELALARM: ArtiParameterTypeMapPairInput=460, ArtiParameterTypeMapPairOutput=SETRELALARM
            SETABSALARM: ArtiParameterTypeMapPairInput=462, ArtiParameterTypeMapPairOutput=SETABSALARM
            CANCELALARM: ArtiParameterTypeMapPairInput=464, ArtiParameterTypeMapPairOutput=CANCELALARM
            GETRESOURCE: ArtiParameterTypeMapPairInput=466, ArtiParameterTypeMapPairOutput=GETRESOURCE
            RELEASERESOURCE: ArtiParameterTypeMapPairInput=468, ArtiParameterTypeMapPairOutput=RELEASERESOURCE
            POSTISR: ArtiParameterTypeMapPairInput=470, ArtiParameterTypeMapPairOutput=POSTISR
            IOCCALLCALLBACK: ArtiParameterTypeMapPairInput=472, ArtiParameterTypeMapPairOutput=IOCCALLCALLBACK
            DOALARM: ArtiParameterTypeMapPairInput=474, ArtiParameterTypeMapPairOutput=DOALARM
            SHUTDOWNOS: ArtiParameterTypeMapPairInput=476, ArtiParameterTypeMapPairOutput=SHUTDOWNOS
        TM_ArtiCoreIndex
          Core0 (ArtiParameterTypeMapPair): ArtiParameterTypeMapPairInput=0, ArtiParameterTypeMapPairOutput=Core0
          Core1 (ArtiParameterTypeMapPair): ArtiParameterTypeMapPairInput=1, ArtiParameterTypeMapPairOutput=Core1
        TM_ProtectionReaction
          5 x ArtiParameterTypeMapPair:
            PRO_IGNORE: ArtiParameterTypeMapPairInput=0, ArtiParameterTypeMapPairOutput=PRO_IGNORE
            PRO_TERMINATETASKISR: ArtiParameterTypeMapPairInput=1, ArtiParameterTypeMapPairOutput=PRO_TERMINATETASKISR
            PRO_TERMINATEAPPL: ArtiParameterTypeMapPairInput=2, ArtiParameterTypeMapPairOutput=PRO_TERMINATEAPPL
            PRO_TERMINATEAPPL_RESTART: ArtiParameterTypeMapPairInput=3, ArtiParameterTypeMapPairOutput=PRO_TERMINATEAPPL_RESTART
            PRO_SHUTDOWN: ArtiParameterTypeMapPairInput=4, ArtiParameterTypeMapPairOutput=PRO_SHUTDOWN
        TM_SpinlockId
          INVALID_SPINLOCK (ArtiParameterTypeMapPair): ArtiParameterTypeMapPairInput=0, ArtiParameterTypeMapPairOutput=INVALID_SPINLOCK
        TM_AlarmId
          8 x ArtiParameterTypeMapPair:
            Rte_Al_TE_StartApplication_StartApplication_Cyclic1000ms: ArtiParameterTypeMapPairInput=0, ArtiParameterTypeMapPairOutput=Rte_Al_TE_StartApplication_StartApplication_Cyclic1000ms
            Rte_Al_TE_StartApplication_StartApplication_Cyclic10ms: ArtiParameterTypeMapPairInput=1, ArtiParameterTypeMapPairOutput=Rte_Al_TE_StartApplication_StartApplication_Cyclic10ms
            Rte_Al_TE_StartApplication_StartApplication_Cyclic1ms: ArtiParameterTypeMapPairInput=2, ArtiParameterTypeMapPairOutput=Rte_Al_TE_StartApplication_StartApplication_Cyclic1ms
            Rte_Al_TE_StartApplication_StartApplication_Cyclic250ms: ArtiParameterTypeMapPairInput=3, ArtiParameterTypeMapPairOutput=Rte_Al_TE_StartApplication_StartApplication_Cyclic250ms
            Rte_Al_TE2_Default_BSW_Async_Task_Core0_0_10ms: ArtiParameterTypeMapPairInput=4, ArtiParameterTypeMapPairOutput=Rte_Al_TE2_Default_BSW_Async_Task_Core0_0_10ms
            Rte_Al_TE2_EcuM_EcuM_MainFunction: ArtiParameterTypeMapPairInput=5, ArtiParameterTypeMapPairOutput=Rte_Al_TE2_EcuM_EcuM_MainFunction
            Rte_Al_TE_StartApplication_Appl_Task_Core0_0_100ms: ArtiParameterTypeMapPairInput=6, ArtiParameterTypeMapPairOutput=Rte_Al_TE_StartApplication_Appl_Task_Core0_0_100ms
            INVALID_ALARM: ArtiParameterTypeMapPairInput=7, ArtiParameterTypeMapPairOutput=INVALID_ALARM
        TM_CounterId
          3 x ArtiParameterTypeMapPair:
            SystemTimer_core1: ArtiParameterTypeMapPairInput=0, ArtiParameterTypeMapPairOutput=SystemTimer_core1
            SystemTimer_core0: ArtiParameterTypeMapPairInput=1, ArtiParameterTypeMapPairOutput=SystemTimer_core0
            INVALID_COUNTER: ArtiParameterTypeMapPairInput=2, ArtiParameterTypeMapPairOutput=INVALID_COUNTER
        TM_ScheduleTableId
          INVALID_SCHEDULETABLE (ArtiParameterTypeMapPair): ArtiParameterTypeMapPairInput=0, ArtiParameterTypeMapPairOutput=INVALID_SCHEDULETABLE
        TM_ResourceId
          OsResource (ArtiParameterTypeMapPair): ArtiParameterTypeMapPairInput=0, ArtiParameterTypeMapPairOutput=OsResource
          INVALID_RESOURCE (ArtiParameterTypeMapPair): ArtiParameterTypeMapPairInput=1, ArtiParameterTypeMapPairOutput=INVALID_RESOURCE
      13 x ArtiObjectClassParameter:
        CP_CurrentTask: ArtiObjectClassParameterTypeMapRef=TM_TaskId
        CP_CurrentIsr: ArtiObjectClassParameterTypeMapRef=TM_Isr2Id
        CP_CurrentApplication: ArtiObjectClassParameterTypeMapRef=TM_ApplicationId
        CP_LastError: ArtiObjectClassParameterTypeMapRef=TM_LastError
        CP_RunningTaskPriority: ArtiObjectClassParameterTypeMapRef=TM_TaskPriority
        CP_AppMode: ArtiObjectClassParameterTypeMapRef=TM_AppMode
        CP_ServiceTrace: ArtiObjectClassParameterTypeMapRef=TM_ServiceId
        CP_TaskState: ArtiObjectClassParameterTypeMapRef=TM_TaskState
        CP_TaskPriority
        CP_TaskStack: ArtiObjectClassParameterTypeMapRef=TM_TaskStack
        CP_TaskContext: ArtiObjectClassParameterTypeMapRef=TM_TaskContext
        CP_AlarmState: ArtiObjectClassParameterTypeMapRef=TM_AlarmState
        CP_ResourceState: ArtiObjectClassParameterTypeMapRef=TM_ResourceState
      K_StackFillPattern (ArtiConstant): ArtiConstantString=0x00000000
      IP_StackFillPattern (ArtiObjectInstanceParameter): ArtiObjectInstanceParameterConstantRef=K_StackFillPattern
      E_AppMode (ArtiExpression): ArtiExpressionString=Os_OrtiRunningData[0].CurrentAppMode
      IP_AppMode (ArtiObjectInstanceParameter): ArtiObjectInstanceParameterExpressionRef=E_AppMode
      E_Core0_RunningTask (ArtiExpression): ArtiExpressionString=Os_OrtiRunningData[0].RunningTaskType
      IP_Core0_RunningTask (ArtiObjectInstanceParameter): ArtiObjectInstanceParameterExpressionRef=E_Core0_RunningTask
      E_Core0_RunningIsr (ArtiExpression): ArtiExpressionString=Os_OrtiRunningData[0].RunningISRType
      IP_Core0_RunningIsr (ArtiObjectInstanceParameter): ArtiObjectInstanceParameterExpressionRef=E_Core0_RunningIsr
      E_Core0_LastError (ArtiExpression): ArtiExpressionString=Os_OrtiRunningData[0].LastError
      IP_Core0_LastError (ArtiObjectInstanceParameter): ArtiObjectInstanceParameterExpressionRef=E_Core0_LastError
      E_Core0_CurrentApplication (ArtiExpression): ArtiExpressionString=Os_AppRunningTimeData_Core0.Current_ApplicationID
      IP_Core0_CurrentApplication (ArtiObjectInstanceParameter): ArtiObjectInstanceParameterExpressionRef=E_Core0_CurrentApplication
      E_Core0_ServiceId (ArtiExpression): ArtiExpressionString=Os_OrtiRunningData[0].ServiceId
      IP_Core0_ServiceId (ArtiObjectInstanceParameter): ArtiObjectInstanceParameterExpressionRef=E_Core0_ServiceId
      E_Core1_RunningTask (ArtiExpression): ArtiExpressionString=Os_OrtiRunningData[1].RunningTaskType
      IP_Core1_RunningTask (ArtiObjectInstanceParameter): ArtiObjectInstanceParameterExpressionRef=E_Core1_RunningTask
      E_Core1_RunningIsr (ArtiExpression): ArtiExpressionString=Os_OrtiRunningData[1].RunningISRType
      IP_Core1_RunningIsr (ArtiObjectInstanceParameter): ArtiObjectInstanceParameterExpressionRef=E_Core1_RunningIsr
      E_Core1_LastError (ArtiExpression): ArtiExpressionString=Os_OrtiRunningData[1].LastError
      IP_Core1_LastError (ArtiObjectInstanceParameter): ArtiObjectInstanceParameterExpressionRef=E_Core1_LastError
      E_Core1_CurrentApplication (ArtiExpression): ArtiExpressionString=Os_AppRunningTimeData_Core1.Current_ApplicationID
      IP_Core1_CurrentApplication (ArtiObjectInstanceParameter): ArtiObjectInstanceParameterExpressionRef=E_Core1_CurrentApplication
      E_Core1_ServiceId (ArtiExpression): ArtiExpressionString=Os_OrtiRunningData[1].ServiceId
      IP_Core1_ServiceId (ArtiObjectInstanceParameter): ArtiObjectInstanceParameterExpressionRef=E_Core1_ServiceId
      E_Idle_Task_Core0_State (ArtiExpression): ArtiExpressionString=Idle_Task_Core0_RunningData.State
      IP_Idle_Task_Core0_State (ArtiObjectInstanceParameter): ArtiObjectInstanceParameterExpressionRef=E_Idle_Task_Core0_State
      E_Idle_Task_Core0_Activations (ArtiExpression): ArtiExpressionString=Idle_Task_Core0_RunningData.ActivationCount
      IP_Idle_Task_Core0_Activations (ArtiObjectInstanceParameter): ArtiObjectInstanceParameterExpressionRef=E_Idle_Task_Core0_Activations
      E_Idle_Task_Core0_StackBase (ArtiExpression): ArtiExpressionString=&Idle_Task_Core0_stack[0]
      IP_Idle_Task_Core0_StackBase (ArtiObjectInstanceParameter): ArtiObjectInstanceParameterExpressionRef=E_Idle_Task_Core0_StackBase
      E_Idle_Task_Core0_Context (ArtiExpression): ArtiExpressionString=&Idle_Task_Core0_ContextInfo
      IP_Idle_Task_Core0_Context (ArtiObjectInstanceParameter): ArtiObjectInstanceParameterExpressionRef=E_Idle_Task_Core0_Context
      K_Idle_Task_Core0_StackSize (ArtiConstant): ArtiConstantString=1024
      IP_Idle_Task_Core0_StackSize (ArtiObjectInstanceParameter): ArtiObjectInstanceParameterConstantRef=K_Idle_Task_Core0_StackSize
      K_Idle_Task_Core0_Priority (ArtiConstant): ArtiConstantString=4294967295
      IP_Idle_Task_Core0_Priority (ArtiObjectInstanceParameter): ArtiObjectInstanceParameterConstantRef=K_Idle_Task_Core0_Priority
      E_Default_BSW_Sync_Task_State (ArtiExpression): ArtiExpressionString=Default_BSW_Sync_Task_RunningData.State
      IP_Default_BSW_Sync_Task_State (ArtiObjectInstanceParameter): ArtiObjectInstanceParameterExpressionRef=E_Default_BSW_Sync_Task_State
      E_Default_BSW_Sync_Task_Activations (ArtiExpression): ArtiExpressionString=Default_BSW_Sync_Task_RunningData.ActivationCount
      IP_Default_BSW_Sync_Task_Activations (ArtiObjectInstanceParameter): ArtiObjectInstanceParameterExpressionRef=E_Default_BSW_Sync_Task_Activations
      E_Default_BSW_Sync_Task_StackBase (ArtiExpression): ArtiExpressionString=&Default_BSW_Sync_Task_stack[0]
      IP_Default_BSW_Sync_Task_StackBase (ArtiObjectInstanceParameter): ArtiObjectInstanceParameterExpressionRef=E_Default_BSW_Sync_Task_StackBase
      E_Default_BSW_Sync_Task_Context (ArtiExpression): ArtiExpressionString=&Default_BSW_Sync_Task_ContextInfo
      IP_Default_BSW_Sync_Task_Context (ArtiObjectInstanceParameter): ArtiObjectInstanceParameterExpressionRef=E_Default_BSW_Sync_Task_Context
      K_Default_BSW_Sync_Task_StackSize (ArtiConstant): ArtiConstantString=1024
      IP_Default_BSW_Sync_Task_StackSize (ArtiObjectInstanceParameter): ArtiObjectInstanceParameterConstantRef=K_Default_BSW_Sync_Task_StackSize
      K_Default_BSW_Sync_Task_Priority (ArtiConstant): ArtiConstantString=40
      IP_Default_BSW_Sync_Task_Priority (ArtiObjectInstanceParameter): ArtiObjectInstanceParameterConstantRef=K_Default_BSW_Sync_Task_Priority
      E_Default_RTE_Mode_switch_Task_State (ArtiExpression): ArtiExpressionString=Default_RTE_Mode_switch_Task_RunningData.State
      IP_Default_RTE_Mode_switch_Task_State (ArtiObjectInstanceParameter): ArtiObjectInstanceParameterExpressionRef=E_Default_RTE_Mode_switch_Task_State
      E_Default_RTE_Mode_switch_Task_Activations (ArtiExpression): ArtiExpressionString=Default_RTE_Mode_switch_Task_RunningData.ActivationCount
      IP_Default_RTE_Mode_switch_Task_Activations (ArtiObjectInstanceParameter): ArtiObjectInstanceParameterExpressionRef=E_Default_RTE_Mode_switch_Task_Activations
      E_Default_RTE_Mode_switch_Task_StackBase (ArtiExpression): ArtiExpressionString=&Default_RTE_Mode_switch_Task_stack[0]
      IP_Default_RTE_Mode_switch_Task_StackBase (ArtiObjectInstanceParameter): ArtiObjectInstanceParameterExpressionRef=E_Default_RTE_Mode_switch_Task_StackBase
      E_Default_RTE_Mode_switch_Task_Context (ArtiExpression): ArtiExpressionString=&Default_RTE_Mode_switch_Task_ContextInfo
      IP_Default_RTE_Mode_switch_Task_Context (ArtiObjectInstanceParameter): ArtiObjectInstanceParameterExpressionRef=E_Default_RTE_Mode_switch_Task_Context
      K_Default_RTE_Mode_switch_Task_StackSize (ArtiConstant): ArtiConstantString=1024
      IP_Default_RTE_Mode_switch_Task_StackSize (ArtiObjectInstanceParameter): ArtiObjectInstanceParameterConstantRef=K_Default_RTE_Mode_switch_Task_StackSize
      K_Default_RTE_Mode_switch_Task_Priority (ArtiConstant): ArtiConstantString=10
      IP_Default_RTE_Mode_switch_Task_Priority (ArtiObjectInstanceParameter): ArtiObjectInstanceParameterConstantRef=K_Default_RTE_Mode_switch_Task_Priority
      E_StartApplication_Appl_Init_Task_State (ArtiExpression): ArtiExpressionString=StartApplication_Appl_Init_Task_RunningData.State
      IP_StartApplication_Appl_Init_Task_State (ArtiObjectInstanceParameter): ArtiObjectInstanceParameterExpressionRef=E_StartApplication_Appl_Init_Task_State
      E_StartApplication_Appl_Init_Task_Activations (ArtiExpression): ArtiExpressionString=StartApplication_Appl_Init_Task_RunningData.ActivationCount
      IP_StartApplication_Appl_Init_Task_Activations (ArtiObjectInstanceParameter): ArtiObjectInstanceParameterExpressionRef=E_StartApplication_Appl_Init_Task_Activations
      E_StartApplication_Appl_Init_Task_StackBase (ArtiExpression): ArtiExpressionString=&StartApplication_Appl_Init_Task_stack[0]
      IP_StartApplication_Appl_Init_Task_StackBase (ArtiObjectInstanceParameter): ArtiObjectInstanceParameterExpressionRef=E_StartApplication_Appl_Init_Task_StackBase
      E_StartApplication_Appl_Init_Task_Context (ArtiExpression): ArtiExpressionString=&StartApplication_Appl_Init_Task_ContextInfo
      IP_StartApplication_Appl_Init_Task_Context (ArtiObjectInstanceParameter): ArtiObjectInstanceParameterExpressionRef=E_StartApplication_Appl_Init_Task_Context
      K_StartApplication_Appl_Init_Task_StackSize (ArtiConstant): ArtiConstantString=1024
      IP_StartApplication_Appl_Init_Task_StackSize (ArtiObjectInstanceParameter): ArtiObjectInstanceParameterConstantRef=K_StartApplication_Appl_Init_Task_StackSize
      K_StartApplication_Appl_Init_Task_Priority (ArtiConstant): ArtiConstantString=45
      IP_StartApplication_Appl_Init_Task_Priority (ArtiObjectInstanceParameter): ArtiObjectInstanceParameterConstantRef=K_StartApplication_Appl_Init_Task_Priority
      E_Default_Init_Task_State (ArtiExpression): ArtiExpressionString=Default_Init_Task_RunningData.State
      IP_Default_Init_Task_State (ArtiObjectInstanceParameter): ArtiObjectInstanceParameterExpressionRef=E_Default_Init_Task_State
      E_Default_Init_Task_Activations (ArtiExpression): ArtiExpressionString=Default_Init_Task_RunningData.ActivationCount
      IP_Default_Init_Task_Activations (ArtiObjectInstanceParameter): ArtiObjectInstanceParameterExpressionRef=E_Default_Init_Task_Activations
      E_Default_Init_Task_StackBase (ArtiExpression): ArtiExpressionString=&Default_Init_Task_stack[0]
      IP_Default_Init_Task_StackBase (ArtiObjectInstanceParameter): ArtiObjectInstanceParameterExpressionRef=E_Default_Init_Task_StackBase
      E_Default_Init_Task_Context (ArtiExpression): ArtiExpressionString=&Default_Init_Task_ContextInfo
      IP_Default_Init_Task_Context (ArtiObjectInstanceParameter): ArtiObjectInstanceParameterExpressionRef=E_Default_Init_Task_Context
      K_Default_Init_Task_StackSize (ArtiConstant): ArtiConstantString=1024
      IP_Default_Init_Task_StackSize (ArtiObjectInstanceParameter): ArtiObjectInstanceParameterConstantRef=K_Default_Init_Task_StackSize
      K_Default_Init_Task_Priority (ArtiConstant): ArtiConstantString=50
      IP_Default_Init_Task_Priority (ArtiObjectInstanceParameter): ArtiObjectInstanceParameterConstantRef=K_Default_Init_Task_Priority
      E_Default_Init_Task_Trusted_State (ArtiExpression): ArtiExpressionString=Default_Init_Task_Trusted_RunningData.State
      IP_Default_Init_Task_Trusted_State (ArtiObjectInstanceParameter): ArtiObjectInstanceParameterExpressionRef=E_Default_Init_Task_Trusted_State
      E_Default_Init_Task_Trusted_Activations (ArtiExpression): ArtiExpressionString=Default_Init_Task_Trusted_RunningData.ActivationCount
      IP_Default_Init_Task_Trusted_Activations (ArtiObjectInstanceParameter): ArtiObjectInstanceParameterExpressionRef=E_Default_Init_Task_Trusted_Activations
      E_Default_Init_Task_Trusted_StackBase (ArtiExpression): ArtiExpressionString=&Default_Init_Task_Trusted_stack[0]
      IP_Default_Init_Task_Trusted_StackBase (ArtiObjectInstanceParameter): ArtiObjectInstanceParameterExpressionRef=E_Default_Init_Task_Trusted_StackBase
      E_Default_Init_Task_Trusted_Context (ArtiExpression): ArtiExpressionString=&Default_Init_Task_Trusted_ContextInfo
      IP_Default_Init_Task_Trusted_Context (ArtiObjectInstanceParameter): ArtiObjectInstanceParameterExpressionRef=E_Default_Init_Task_Trusted_Context
      K_Default_Init_Task_Trusted_StackSize (ArtiConstant): ArtiConstantString=1024
      IP_Default_Init_Task_Trusted_StackSize (ArtiObjectInstanceParameter): ArtiObjectInstanceParameterConstantRef=K_Default_Init_Task_Trusted_StackSize
      K_Default_Init_Task_Trusted_Priority (ArtiConstant): ArtiConstantString=49
      IP_Default_Init_Task_Trusted_Priority (ArtiObjectInstanceParameter): ArtiObjectInstanceParameterConstantRef=K_Default_Init_Task_Trusted_Priority
      E_Idle_Task_Core1_State (ArtiExpression): ArtiExpressionString=Idle_Task_Core1_RunningData.State
      IP_Idle_Task_Core1_State (ArtiObjectInstanceParameter): ArtiObjectInstanceParameterExpressionRef=E_Idle_Task_Core1_State
      E_Idle_Task_Core1_Activations (ArtiExpression): ArtiExpressionString=Idle_Task_Core1_RunningData.ActivationCount
      IP_Idle_Task_Core1_Activations (ArtiObjectInstanceParameter): ArtiObjectInstanceParameterExpressionRef=E_Idle_Task_Core1_Activations
      E_Idle_Task_Core1_StackBase (ArtiExpression): ArtiExpressionString=&Idle_Task_Core1_stack[0]
      IP_Idle_Task_Core1_StackBase (ArtiObjectInstanceParameter): ArtiObjectInstanceParameterExpressionRef=E_Idle_Task_Core1_StackBase
      E_Idle_Task_Core1_Context (ArtiExpression): ArtiExpressionString=&Idle_Task_Core1_ContextInfo
      IP_Idle_Task_Core1_Context (ArtiObjectInstanceParameter): ArtiObjectInstanceParameterExpressionRef=E_Idle_Task_Core1_Context
      K_Idle_Task_Core1_StackSize (ArtiConstant): ArtiConstantString=1024
      IP_Idle_Task_Core1_StackSize (ArtiObjectInstanceParameter): ArtiObjectInstanceParameterConstantRef=K_Idle_Task_Core1_StackSize
      K_Idle_Task_Core1_Priority (ArtiConstant): ArtiConstantString=4294967295
      IP_Idle_Task_Core1_Priority (ArtiObjectInstanceParameter): ArtiObjectInstanceParameterConstantRef=K_Idle_Task_Core1_Priority
      E_Default_BSW_Async_Task_Core0_State (ArtiExpression): ArtiExpressionString=Default_BSW_Async_Task_Core0_RunningData.State
      IP_Default_BSW_Async_Task_Core0_State (ArtiObjectInstanceParameter): ArtiObjectInstanceParameterExpressionRef=E_Default_BSW_Async_Task_Core0_State
      E_Default_BSW_Async_Task_Core0_Activations (ArtiExpression): ArtiExpressionString=Default_BSW_Async_Task_Core0_RunningData.ActivationCount
      IP_Default_BSW_Async_Task_Core0_Activations (ArtiObjectInstanceParameter): ArtiObjectInstanceParameterExpressionRef=E_Default_BSW_Async_Task_Core0_Activations
      E_Default_BSW_Async_Task_Core0_StackBase (ArtiExpression): ArtiExpressionString=&Default_BSW_Async_Task_Core0_stack[0]
      IP_Default_BSW_Async_Task_Core0_StackBase (ArtiObjectInstanceParameter): ArtiObjectInstanceParameterExpressionRef=E_Default_BSW_Async_Task_Core0_StackBase
      E_Default_BSW_Async_Task_Core0_Context (ArtiExpression): ArtiExpressionString=&Default_BSW_Async_Task_Core0_ContextInfo
      IP_Default_BSW_Async_Task_Core0_Context (ArtiObjectInstanceParameter): ArtiObjectInstanceParameterExpressionRef=E_Default_BSW_Async_Task_Core0_Context
      K_Default_BSW_Async_Task_Core0_StackSize (ArtiConstant): ArtiConstantString=8192
      IP_Default_BSW_Async_Task_Core0_StackSize (ArtiObjectInstanceParameter): ArtiObjectInstanceParameterConstantRef=K_Default_BSW_Async_Task_Core0_StackSize
      K_Default_BSW_Async_Task_Core0_Priority (ArtiConstant): ArtiConstantString=30
      IP_Default_BSW_Async_Task_Core0_Priority (ArtiObjectInstanceParameter): ArtiObjectInstanceParameterConstantRef=K_Default_BSW_Async_Task_Core0_Priority
      E_Default_BSW_Async_Task_Core1_State (ArtiExpression): ArtiExpressionString=Default_BSW_Async_Task_Core1_RunningData.State
      IP_Default_BSW_Async_Task_Core1_State (ArtiObjectInstanceParameter): ArtiObjectInstanceParameterExpressionRef=E_Default_BSW_Async_Task_Core1_State
      E_Default_BSW_Async_Task_Core1_Activations (ArtiExpression): ArtiExpressionString=Default_BSW_Async_Task_Core1_RunningData.ActivationCount
      IP_Default_BSW_Async_Task_Core1_Activations (ArtiObjectInstanceParameter): ArtiObjectInstanceParameterExpressionRef=E_Default_BSW_Async_Task_Core1_Activations
      E_Default_BSW_Async_Task_Core1_StackBase (ArtiExpression): ArtiExpressionString=&Default_BSW_Async_Task_Core1_stack[0]
      IP_Default_BSW_Async_Task_Core1_StackBase (ArtiObjectInstanceParameter): ArtiObjectInstanceParameterExpressionRef=E_Default_BSW_Async_Task_Core1_StackBase
      E_Default_BSW_Async_Task_Core1_Context (ArtiExpression): ArtiExpressionString=&Default_BSW_Async_Task_Core1_ContextInfo
      IP_Default_BSW_Async_Task_Core1_Context (ArtiObjectInstanceParameter): ArtiObjectInstanceParameterExpressionRef=E_Default_BSW_Async_Task_Core1_Context
      K_Default_BSW_Async_Task_Core1_StackSize (ArtiConstant): ArtiConstantString=1024
      IP_Default_BSW_Async_Task_Core1_StackSize (ArtiObjectInstanceParameter): ArtiObjectInstanceParameterConstantRef=K_Default_BSW_Async_Task_Core1_StackSize
      K_Default_BSW_Async_Task_Core1_Priority (ArtiConstant): ArtiConstantString=30
      IP_Default_BSW_Async_Task_Core1_Priority (ArtiObjectInstanceParameter): ArtiObjectInstanceParameterConstantRef=K_Default_BSW_Async_Task_Core1_Priority
      E_StartApplication_Appl_Task_Core0_State (ArtiExpression): ArtiExpressionString=StartApplication_Appl_Task_Core0_RunningData.State
      IP_StartApplication_Appl_Task_Core0_State (ArtiObjectInstanceParameter): ArtiObjectInstanceParameterExpressionRef=E_StartApplication_Appl_Task_Core0_State
      E_StartApplication_Appl_Task_Core0_Activations (ArtiExpression): ArtiExpressionString=StartApplication_Appl_Task_Core0_RunningData.ActivationCount
      IP_StartApplication_Appl_Task_Core0_Activations (ArtiObjectInstanceParameter): ArtiObjectInstanceParameterExpressionRef=E_StartApplication_Appl_Task_Core0_Activations
      E_StartApplication_Appl_Task_Core0_StackBase (ArtiExpression): ArtiExpressionString=&StartApplication_Appl_Task_Core0_stack[0]
      IP_StartApplication_Appl_Task_Core0_StackBase (ArtiObjectInstanceParameter): ArtiObjectInstanceParameterExpressionRef=E_StartApplication_Appl_Task_Core0_StackBase
      E_StartApplication_Appl_Task_Core0_Context (ArtiExpression): ArtiExpressionString=&StartApplication_Appl_Task_Core0_ContextInfo
      IP_StartApplication_Appl_Task_Core0_Context (ArtiObjectInstanceParameter): ArtiObjectInstanceParameterExpressionRef=E_StartApplication_Appl_Task_Core0_Context
      K_StartApplication_Appl_Task_Core0_StackSize (ArtiConstant): ArtiConstantString=2048
      IP_StartApplication_Appl_Task_Core0_StackSize (ArtiObjectInstanceParameter): ArtiObjectInstanceParameterConstantRef=K_StartApplication_Appl_Task_Core0_StackSize
      K_StartApplication_Appl_Task_Core0_Priority (ArtiConstant): ArtiConstantString=5
      IP_StartApplication_Appl_Task_Core0_Priority (ArtiObjectInstanceParameter): ArtiObjectInstanceParameterConstantRef=K_StartApplication_Appl_Task_Core0_Priority
      E_StartApplication_Appl_Task_Core1_State (ArtiExpression): ArtiExpressionString=StartApplication_Appl_Task_Core1_RunningData.State
      IP_StartApplication_Appl_Task_Core1_State (ArtiObjectInstanceParameter): ArtiObjectInstanceParameterExpressionRef=E_StartApplication_Appl_Task_Core1_State
      E_StartApplication_Appl_Task_Core1_Activations (ArtiExpression): ArtiExpressionString=StartApplication_Appl_Task_Core1_RunningData.ActivationCount
      IP_StartApplication_Appl_Task_Core1_Activations (ArtiObjectInstanceParameter): ArtiObjectInstanceParameterExpressionRef=E_StartApplication_Appl_Task_Core1_Activations
      E_StartApplication_Appl_Task_Core1_StackBase (ArtiExpression): ArtiExpressionString=&StartApplication_Appl_Task_Core1_stack[0]
      IP_StartApplication_Appl_Task_Core1_StackBase (ArtiObjectInstanceParameter): ArtiObjectInstanceParameterExpressionRef=E_StartApplication_Appl_Task_Core1_StackBase
      E_StartApplication_Appl_Task_Core1_Context (ArtiExpression): ArtiExpressionString=&StartApplication_Appl_Task_Core1_ContextInfo
      IP_StartApplication_Appl_Task_Core1_Context (ArtiObjectInstanceParameter): ArtiObjectInstanceParameterExpressionRef=E_StartApplication_Appl_Task_Core1_Context
      K_StartApplication_Appl_Task_Core1_StackSize (ArtiConstant): ArtiConstantString=1024
      IP_StartApplication_Appl_Task_Core1_StackSize (ArtiObjectInstanceParameter): ArtiObjectInstanceParameterConstantRef=K_StartApplication_Appl_Task_Core1_StackSize
      K_StartApplication_Appl_Task_Core1_Priority (ArtiConstant): ArtiConstantString=5
      IP_StartApplication_Appl_Task_Core1_Priority (ArtiObjectInstanceParameter): ArtiObjectInstanceParameterConstantRef=K_StartApplication_Appl_Task_Core1_Priority
      E_Default_Init_Task_Core1_State (ArtiExpression): ArtiExpressionString=Default_Init_Task_Core1_RunningData.State
      IP_Default_Init_Task_Core1_State (ArtiObjectInstanceParameter): ArtiObjectInstanceParameterExpressionRef=E_Default_Init_Task_Core1_State
      E_Default_Init_Task_Core1_Activations (ArtiExpression): ArtiExpressionString=Default_Init_Task_Core1_RunningData.ActivationCount
      IP_Default_Init_Task_Core1_Activations (ArtiObjectInstanceParameter): ArtiObjectInstanceParameterExpressionRef=E_Default_Init_Task_Core1_Activations
      E_Default_Init_Task_Core1_StackBase (ArtiExpression): ArtiExpressionString=&Default_Init_Task_Core1_stack[0]
      IP_Default_Init_Task_Core1_StackBase (ArtiObjectInstanceParameter): ArtiObjectInstanceParameterExpressionRef=E_Default_Init_Task_Core1_StackBase
      E_Default_Init_Task_Core1_Context (ArtiExpression): ArtiExpressionString=&Default_Init_Task_Core1_ContextInfo
      IP_Default_Init_Task_Core1_Context (ArtiObjectInstanceParameter): ArtiObjectInstanceParameterExpressionRef=E_Default_Init_Task_Core1_Context
      K_Default_Init_Task_Core1_StackSize (ArtiConstant): ArtiConstantString=1024
      IP_Default_Init_Task_Core1_StackSize (ArtiObjectInstanceParameter): ArtiObjectInstanceParameterConstantRef=K_Default_Init_Task_Core1_StackSize
      K_Default_Init_Task_Core1_Priority (ArtiConstant): ArtiConstantString=50
      IP_Default_Init_Task_Core1_Priority (ArtiObjectInstanceParameter): ArtiObjectInstanceParameterConstantRef=K_Default_Init_Task_Core1_Priority
      E_Default_Init_Task_Core1_Trusted_State (ArtiExpression): ArtiExpressionString=Default_Init_Task_Core1_Trusted_RunningData.State
      IP_Default_Init_Task_Core1_Trusted_State (ArtiObjectInstanceParameter): ArtiObjectInstanceParameterExpressionRef=E_Default_Init_Task_Core1_Trusted_State
      E_Default_Init_Task_Core1_Trusted_Activations (ArtiExpression): ArtiExpressionString=Default_Init_Task_Core1_Trusted_RunningData.ActivationCount
      IP_Default_Init_Task_Core1_Trusted_Activations (ArtiObjectInstanceParameter): ArtiObjectInstanceParameterExpressionRef=E_Default_Init_Task_Core1_Trusted_Activations
      E_Default_Init_Task_Core1_Trusted_StackBase (ArtiExpression): ArtiExpressionString=&Default_Init_Task_Core1_Trusted_stack[0]
      IP_Default_Init_Task_Core1_Trusted_StackBase (ArtiObjectInstanceParameter): ArtiObjectInstanceParameterExpressionRef=E_Default_Init_Task_Core1_Trusted_StackBase
      E_Default_Init_Task_Core1_Trusted_Context (ArtiExpression): ArtiExpressionString=&Default_Init_Task_Core1_Trusted_ContextInfo
      IP_Default_Init_Task_Core1_Trusted_Context (ArtiObjectInstanceParameter): ArtiObjectInstanceParameterExpressionRef=E_Default_Init_Task_Core1_Trusted_Context
      K_Default_Init_Task_Core1_Trusted_StackSize (ArtiConstant): ArtiConstantString=1024
      IP_Default_Init_Task_Core1_Trusted_StackSize (ArtiObjectInstanceParameter): ArtiObjectInstanceParameterConstantRef=K_Default_Init_Task_Core1_Trusted_StackSize
      K_Default_Init_Task_Core1_Trusted_Priority (ArtiConstant): ArtiConstantString=49
      IP_Default_Init_Task_Core1_Trusted_Priority (ArtiObjectInstanceParameter): ArtiObjectInstanceParameterConstantRef=K_Default_Init_Task_Core1_Trusted_Priority
      E_CAN_00_RXFIFO_ISR_StackBase (ArtiExpression): ArtiExpressionString=&CAN_00_RXFIFO_ISR_stack[0]
      IP_CAN_00_RXFIFO_ISR_StackBase (ArtiObjectInstanceParameter): ArtiObjectInstanceParameterExpressionRef=E_CAN_00_RXFIFO_ISR_StackBase
      E_CAN_00_RXFIFO_ISR_Context (ArtiExpression): ArtiExpressionString=&CAN_00_RXFIFO_ISR_ContextInfo
      IP_CAN_00_RXFIFO_ISR_Context (ArtiObjectInstanceParameter): ArtiObjectInstanceParameterExpressionRef=E_CAN_00_RXFIFO_ISR_Context
      K_CAN_00_RXFIFO_ISR_StackSize (ArtiConstant): ArtiConstantString=1024
      IP_CAN_00_RXFIFO_ISR_StackSize (ArtiObjectInstanceParameter): ArtiObjectInstanceParameterConstantRef=K_CAN_00_RXFIFO_ISR_StackSize
      E_CAN_00_TX_ISR_StackBase (ArtiExpression): ArtiExpressionString=&CAN_00_TX_ISR_stack[0]
      IP_CAN_00_TX_ISR_StackBase (ArtiObjectInstanceParameter): ArtiObjectInstanceParameterExpressionRef=E_CAN_00_TX_ISR_StackBase
      E_CAN_00_TX_ISR_Context (ArtiExpression): ArtiExpressionString=&CAN_00_TX_ISR_ContextInfo
      IP_CAN_00_TX_ISR_Context (ArtiObjectInstanceParameter): ArtiObjectInstanceParameterExpressionRef=E_CAN_00_TX_ISR_Context
      K_CAN_00_TX_ISR_StackSize (ArtiConstant): ArtiConstantString=1024
      IP_CAN_00_TX_ISR_StackSize (ArtiObjectInstanceParameter): ArtiObjectInstanceParameterConstantRef=K_CAN_00_TX_ISR_StackSize
      E_CAN_00_RX_ISR_StackBase (ArtiExpression): ArtiExpressionString=&CAN_00_RX_ISR_stack[0]
      IP_CAN_00_RX_ISR_StackBase (ArtiObjectInstanceParameter): ArtiObjectInstanceParameterExpressionRef=E_CAN_00_RX_ISR_StackBase
      E_CAN_00_RX_ISR_Context (ArtiExpression): ArtiExpressionString=&CAN_00_RX_ISR_ContextInfo
      IP_CAN_00_RX_ISR_Context (ArtiObjectInstanceParameter): ArtiObjectInstanceParameterExpressionRef=E_CAN_00_RX_ISR_Context
      K_CAN_00_RX_ISR_StackSize (ArtiConstant): ArtiConstantString=1024
      IP_CAN_00_RX_ISR_StackSize (ArtiObjectInstanceParameter): ArtiObjectInstanceParameterConstantRef=K_CAN_00_RX_ISR_StackSize
      E_CounterIsr_SystemTimer_core0_StackBase (ArtiExpression): ArtiExpressionString=&CounterIsr_SystemTimer_core0_stack[0]
      IP_CounterIsr_SystemTimer_core0_StackBase (ArtiObjectInstanceParameter): ArtiObjectInstanceParameterExpressionRef=E_CounterIsr_SystemTimer_core0_StackBase
      E_CounterIsr_SystemTimer_core0_Context (ArtiExpression): ArtiExpressionString=&CounterIsr_SystemTimer_core0_ContextInfo
      IP_CounterIsr_SystemTimer_core0_Context (ArtiObjectInstanceParameter): ArtiObjectInstanceParameterExpressionRef=E_CounterIsr_SystemTimer_core0_Context
      K_CounterIsr_SystemTimer_core0_StackSize (ArtiConstant): ArtiConstantString=1024
      IP_CounterIsr_SystemTimer_core0_StackSize (ArtiObjectInstanceParameter): ArtiObjectInstanceParameterConstantRef=K_CounterIsr_SystemTimer_core0_StackSize
      E_CounterIsr_SystemTimer_core1_StackBase (ArtiExpression): ArtiExpressionString=&CounterIsr_SystemTimer_core1_stack[0]
      IP_CounterIsr_SystemTimer_core1_StackBase (ArtiObjectInstanceParameter): ArtiObjectInstanceParameterExpressionRef=E_CounterIsr_SystemTimer_core1_StackBase
      E_CounterIsr_SystemTimer_core1_Context (ArtiExpression): ArtiExpressionString=&CounterIsr_SystemTimer_core1_ContextInfo
      IP_CounterIsr_SystemTimer_core1_Context (ArtiObjectInstanceParameter): ArtiObjectInstanceParameterExpressionRef=E_CounterIsr_SystemTimer_core1_Context
      K_CounterIsr_SystemTimer_core1_StackSize (ArtiConstant): ArtiConstantString=1024
      IP_CounterIsr_SystemTimer_core1_StackSize (ArtiObjectInstanceParameter): ArtiObjectInstanceParameterConstantRef=K_CounterIsr_SystemTimer_core1_StackSize
      E_XSignalIsr_OsCore1_StackBase (ArtiExpression): ArtiExpressionString=&XSignalIsr_OsCore1_stack[0]
      IP_XSignalIsr_OsCore1_StackBase (ArtiObjectInstanceParameter): ArtiObjectInstanceParameterExpressionRef=E_XSignalIsr_OsCore1_StackBase
      E_XSignalIsr_OsCore1_Context (ArtiExpression): ArtiExpressionString=&XSignalIsr_OsCore1_ContextInfo
      IP_XSignalIsr_OsCore1_Context (ArtiObjectInstanceParameter): ArtiObjectInstanceParameterExpressionRef=E_XSignalIsr_OsCore1_Context
      K_XSignalIsr_OsCore1_StackSize (ArtiConstant): ArtiConstantString=1024
      IP_XSignalIsr_OsCore1_StackSize (ArtiObjectInstanceParameter): ArtiObjectInstanceParameterConstantRef=K_XSignalIsr_OsCore1_StackSize
      E_XSignalIsr_OsCore0_StackBase (ArtiExpression): ArtiExpressionString=&XSignalIsr_OsCore0_stack[0]
      IP_XSignalIsr_OsCore0_StackBase (ArtiObjectInstanceParameter): ArtiObjectInstanceParameterExpressionRef=E_XSignalIsr_OsCore0_StackBase
      E_XSignalIsr_OsCore0_Context (ArtiExpression): ArtiExpressionString=&XSignalIsr_OsCore0_ContextInfo
      IP_XSignalIsr_OsCore0_Context (ArtiObjectInstanceParameter): ArtiObjectInstanceParameterExpressionRef=E_XSignalIsr_OsCore0_Context
      K_XSignalIsr_OsCore0_StackSize (ArtiConstant): ArtiConstantString=1024
      IP_XSignalIsr_OsCore0_StackSize (ArtiObjectInstanceParameter): ArtiObjectInstanceParameterConstantRef=K_XSignalIsr_OsCore0_StackSize
      E_Rte_Al_TE_StartApplication_StartApplication_Cyclic1000ms_State (ArtiExpression): ArtiExpressionString=Rte_Al_TE_StartApplication_StartApplication_Cyclic1000ms_RunningData.State
      IP_Rte_Al_TE_StartApplication_StartApplication_Cyclic1000ms_State (ArtiObjectInstanceParameter): ArtiObjectInstanceParameterExpressionRef=E_Rte_Al_TE_StartApplication_StartApplication_Cyclic1000ms_State
      E_Rte_Al_TE_StartApplication_StartApplication_Cyclic1000ms_Cycle (ArtiExpression): ArtiExpressionString=Rte_Al_TE_StartApplication_StartApplication_Cyclic1000ms_RunningData.Cycle
      IP_Rte_Al_TE_StartApplication_StartApplication_Cyclic1000ms_Cycle (ArtiObjectInstanceParameter): ArtiObjectInstanceParameterExpressionRef=E_Rte_Al_TE_StartApplication_StartApplication_Cyclic1000ms_Cycle
      E_Rte_Al_TE_StartApplication_StartApplication_Cyclic10ms_State (ArtiExpression): ArtiExpressionString=Rte_Al_TE_StartApplication_StartApplication_Cyclic10ms_RunningData.State
      IP_Rte_Al_TE_StartApplication_StartApplication_Cyclic10ms_State (ArtiObjectInstanceParameter): ArtiObjectInstanceParameterExpressionRef=E_Rte_Al_TE_StartApplication_StartApplication_Cyclic10ms_State
      E_Rte_Al_TE_StartApplication_StartApplication_Cyclic10ms_Cycle (ArtiExpression): ArtiExpressionString=Rte_Al_TE_StartApplication_StartApplication_Cyclic10ms_RunningData.Cycle
      IP_Rte_Al_TE_StartApplication_StartApplication_Cyclic10ms_Cycle (ArtiObjectInstanceParameter): ArtiObjectInstanceParameterExpressionRef=E_Rte_Al_TE_StartApplication_StartApplication_Cyclic10ms_Cycle
      E_Rte_Al_TE_StartApplication_StartApplication_Cyclic1ms_State (ArtiExpression): ArtiExpressionString=Rte_Al_TE_StartApplication_StartApplication_Cyclic1ms_RunningData.State
      IP_Rte_Al_TE_StartApplication_StartApplication_Cyclic1ms_State (ArtiObjectInstanceParameter): ArtiObjectInstanceParameterExpressionRef=E_Rte_Al_TE_StartApplication_StartApplication_Cyclic1ms_State
      E_Rte_Al_TE_StartApplication_StartApplication_Cyclic1ms_Cycle (ArtiExpression): ArtiExpressionString=Rte_Al_TE_StartApplication_StartApplication_Cyclic1ms_RunningData.Cycle
      IP_Rte_Al_TE_StartApplication_StartApplication_Cyclic1ms_Cycle (ArtiObjectInstanceParameter): ArtiObjectInstanceParameterExpressionRef=E_Rte_Al_TE_StartApplication_StartApplication_Cyclic1ms_Cycle
      E_Rte_Al_TE_StartApplication_StartApplication_Cyclic250ms_State (ArtiExpression): ArtiExpressionString=Rte_Al_TE_StartApplication_StartApplication_Cyclic250ms_RunningData.State
      IP_Rte_Al_TE_StartApplication_StartApplication_Cyclic250ms_State (ArtiObjectInstanceParameter): ArtiObjectInstanceParameterExpressionRef=E_Rte_Al_TE_StartApplication_StartApplication_Cyclic250ms_State
      E_Rte_Al_TE_StartApplication_StartApplication_Cyclic250ms_Cycle (ArtiExpression): ArtiExpressionString=Rte_Al_TE_StartApplication_StartApplication_Cyclic250ms_RunningData.Cycle
      IP_Rte_Al_TE_StartApplication_StartApplication_Cyclic250ms_Cycle (ArtiObjectInstanceParameter): ArtiObjectInstanceParameterExpressionRef=E_Rte_Al_TE_StartApplication_StartApplication_Cyclic250ms_Cycle
      E_Rte_Al_TE2_Default_BSW_Async_Task_Core0_0_10ms_State (ArtiExpression): ArtiExpressionString=Rte_Al_TE2_Default_BSW_Async_Task_Core0_0_10ms_RunningData.State
      IP_Rte_Al_TE2_Default_BSW_Async_Task_Core0_0_10ms_State (ArtiObjectInstanceParameter): ArtiObjectInstanceParameterExpressionRef=E_Rte_Al_TE2_Default_BSW_Async_Task_Core0_0_10ms_State
      E_Rte_Al_TE2_Default_BSW_Async_Task_Core0_0_10ms_Cycle (ArtiExpression): ArtiExpressionString=Rte_Al_TE2_Default_BSW_Async_Task_Core0_0_10ms_RunningData.Cycle
      IP_Rte_Al_TE2_Default_BSW_Async_Task_Core0_0_10ms_Cycle (ArtiObjectInstanceParameter): ArtiObjectInstanceParameterExpressionRef=E_Rte_Al_TE2_Default_BSW_Async_Task_Core0_0_10ms_Cycle
      E_Rte_Al_TE2_EcuM_EcuM_MainFunction_State (ArtiExpression): ArtiExpressionString=Rte_Al_TE2_EcuM_EcuM_MainFunction_RunningData.State
      IP_Rte_Al_TE2_EcuM_EcuM_MainFunction_State (ArtiObjectInstanceParameter): ArtiObjectInstanceParameterExpressionRef=E_Rte_Al_TE2_EcuM_EcuM_MainFunction_State
      E_Rte_Al_TE2_EcuM_EcuM_MainFunction_Cycle (ArtiExpression): ArtiExpressionString=Rte_Al_TE2_EcuM_EcuM_MainFunction_RunningData.Cycle
      IP_Rte_Al_TE2_EcuM_EcuM_MainFunction_Cycle (ArtiObjectInstanceParameter): ArtiObjectInstanceParameterExpressionRef=E_Rte_Al_TE2_EcuM_EcuM_MainFunction_Cycle
      E_Rte_Al_TE_StartApplication_Appl_Task_Core0_0_100ms_State (ArtiExpression): ArtiExpressionString=Rte_Al_TE_StartApplication_Appl_Task_Core0_0_100ms_RunningData.State
      IP_Rte_Al_TE_StartApplication_Appl_Task_Core0_0_100ms_State (ArtiObjectInstanceParameter): ArtiObjectInstanceParameterExpressionRef=E_Rte_Al_TE_StartApplication_Appl_Task_Core0_0_100ms_State
      E_Rte_Al_TE_StartApplication_Appl_Task_Core0_0_100ms_Cycle (ArtiExpression): ArtiExpressionString=Rte_Al_TE_StartApplication_Appl_Task_Core0_0_100ms_RunningData.Cycle
      IP_Rte_Al_TE_StartApplication_Appl_Task_Core0_0_100ms_Cycle (ArtiObjectInstanceParameter): ArtiObjectInstanceParameterExpressionRef=E_Rte_Al_TE_StartApplication_Appl_Task_Core0_0_100ms_Cycle
      E_OsResource_State (ArtiExpression): ArtiExpressionString=Os_LockConfig_OsResource.Previous == 0xFFFFFFFF ? 0:1
      IP_OsResource_State (ArtiObjectInstanceParameter): ArtiObjectInstanceParameterExpressionRef=E_OsResource_State
      8 x ArtiConstant:
        K_Rte_Ev_Run_StartApplication_StartApplication_Cyclic1000ms_EVENTMASK: ArtiConstantString=1
        K_Rte_Ev_Run_StartApplication_StartApplication_Cyclic10ms_EVENTMASK: ArtiConstantString=2
        K_Rte_Ev_Run_StartApplication_StartApplication_Cyclic1ms_EVENTMASK: ArtiConstantString=4
        K_Rte_Ev_Run_StartApplication_StartApplication_Cyclic250ms_EVENTMASK: ArtiConstantString=8
        K_Rte_Ev_Run_StartApplication_StartApplication_OnDataRec_EthernetCommunication_EVENTMASK: ArtiConstantString=16
        K_Rte_Ev_Cyclic_StartApplication_Appl_Task_Core0_0_100ms_EVENTMASK: ArtiConstantString=32
        K_Rte_Ev_Run_StartApplication_StartApplication_OnDataRec_RxCtrl_EVENTMASK: ArtiConstantString=64
        K_Rte_Ev_Run_StartApplication_StartApplication_OnDataRec_RxData_EVENTMASK: ArtiConstantString=128
      E_LockAddr_OsResource (ArtiExpression): ArtiExpressionString=&Os_LockConfig_OsResource
      IP_LockAddr_OsResource (ArtiObjectInstanceParameter): ArtiObjectInstanceParameterExpressionRef=E_LockAddr_OsResource
      E_OsResource_LOCKED (ArtiExpression): ArtiExpressionString=Os_LockConfig_OsResource.Previous
      IP_OsResource_LOCKED (ArtiObjectInstanceParameter): ArtiObjectInstanceParameterExpressionRef=E_OsResource_LOCKED
      E_OsResource_RESOURCE_OWNER (ArtiExpression): ArtiExpressionString=Os_OsResource_RunningData.OwnerObjectID
      IP_OsResource_RESOURCE_OWNER (ArtiObjectInstanceParameter): ArtiObjectInstanceParameterExpressionRef=E_OsResource_RESOURCE_OWNER
      E_OsResource_PRIORITY_TYPE (ArtiExpression): ArtiExpressionString=Os_ResourceConfig_OsResource.CeilingIsrLevel == 0xFFFFFFFF ? 0:1
      IP_OsResource_PRIORITY_TYPE (ArtiObjectInstanceParameter): ArtiObjectInstanceParameterExpressionRef=E_OsResource_PRIORITY_TYPE
      E_OsResource_PRIORITY (ArtiExpression):
        ArtiExpressionString = Os_ResourceConfig_OsResource.CeilingIsrLevel == 0xFFFFFFFF ? Os_ResourceConfig_OsResource.CeilingPriority : Os_ResourceConfig_OsResource.CeilingIsrLevel
      IP_OsResource_PRIORITY (ArtiObjectInstanceParameter): ArtiObjectInstanceParameterExpressionRef=E_OsResource_PRIORITY
      E_Idle_Task_Core0_OSTASKTYPE (ArtiExpression): ArtiExpressionString=Task_Idle_Task_Core0_ConfigRef.IsExtended
      IP_Idle_Task_Core0_OSTASKTYPE (ArtiObjectInstanceParameter): ArtiObjectInstanceParameterExpressionRef=E_Idle_Task_Core0_OSTASKTYPE
      K_Idle_Task_Core0_OSTASKSCHEDULE (ArtiConstant): ArtiConstantString=FULL
      E_Idle_Task_Core0_OSTASKMAXACTIVATION (ArtiExpression): ArtiExpressionString=Task_Idle_Task_Core0_ConfigRef.MaxActivationCount
      IP_Idle_Task_Core0_OSTASKMAXACTIVATION (ArtiObjectInstanceParameter): ArtiObjectInstanceParameterExpressionRef=E_Idle_Task_Core0_OSTASKMAXACTIVATION
      E_Idle_Task_Core0_REMAININGACTIVATIONS (ArtiExpression): ArtiExpressionString=Task_Idle_Task_Core0_ConfigRef.MaxActivationCount - Idle_Task_Core0_RunningData.ActivationCount
      IP_Idle_Task_Core0_REMAININGACTIVATIONS (ArtiObjectInstanceParameter): ArtiObjectInstanceParameterExpressionRef=E_Idle_Task_Core0_REMAININGACTIVATIONS
      E_Idle_Task_Core0_EVENTMASK (ArtiExpression): ArtiExpressionString=Idle_Task_Core0_RunningData.EventWait
      IP_Idle_Task_Core0_EVENTMASK (ArtiObjectInstanceParameter): ArtiObjectInstanceParameterExpressionRef=E_Idle_Task_Core0_EVENTMASK
      E_Idle_Task_Core0_EVENTSETFLAG (ArtiExpression): ArtiExpressionString=Idle_Task_Core0_RunningData.EventSet
      IP_Idle_Task_Core0_EVENTSETFLAG (ArtiObjectInstanceParameter): ArtiObjectInstanceParameterExpressionRef=E_Idle_Task_Core0_EVENTSETFLAG
      E_Idle_Task_Core0_LOCKED (ArtiExpression): ArtiExpressionString=Idle_Task_Core0_RunningData.LockList
      IP_Idle_Task_Core0_LOCKED (ArtiObjectInstanceParameter): ArtiObjectInstanceParameterExpressionRef=E_Idle_Task_Core0_LOCKED
      E_Default_BSW_Sync_Task_OSTASKTYPE (ArtiExpression): ArtiExpressionString=Task_Default_BSW_Sync_Task_ConfigRef.IsExtended
      IP_Default_BSW_Sync_Task_OSTASKTYPE (ArtiObjectInstanceParameter): ArtiObjectInstanceParameterExpressionRef=E_Default_BSW_Sync_Task_OSTASKTYPE
      K_Default_BSW_Sync_Task_OSTASKSCHEDULE (ArtiConstant): ArtiConstantString=NON
      E_Default_BSW_Sync_Task_OSTASKMAXACTIVATION (ArtiExpression): ArtiExpressionString=Task_Default_BSW_Sync_Task_ConfigRef.MaxActivationCount
      IP_Default_BSW_Sync_Task_OSTASKMAXACTIVATION (ArtiObjectInstanceParameter): ArtiObjectInstanceParameterExpressionRef=E_Default_BSW_Sync_Task_OSTASKMAXACTIVATION
      E_Default_BSW_Sync_Task_REMAININGACTIVATIONS (ArtiExpression): ArtiExpressionString=Task_Default_BSW_Sync_Task_ConfigRef.MaxActivationCount - Default_BSW_Sync_Task_RunningData.ActivationCount
      IP_Default_BSW_Sync_Task_REMAININGACTIVATIONS (ArtiObjectInstanceParameter): ArtiObjectInstanceParameterExpressionRef=E_Default_BSW_Sync_Task_REMAININGACTIVATIONS
      E_Default_BSW_Sync_Task_EVENTMASK (ArtiExpression): ArtiExpressionString=Default_BSW_Sync_Task_RunningData.EventWait
      IP_Default_BSW_Sync_Task_EVENTMASK (ArtiObjectInstanceParameter): ArtiObjectInstanceParameterExpressionRef=E_Default_BSW_Sync_Task_EVENTMASK
      E_Default_BSW_Sync_Task_EVENTSETFLAG (ArtiExpression): ArtiExpressionString=Default_BSW_Sync_Task_RunningData.EventSet
      IP_Default_BSW_Sync_Task_EVENTSETFLAG (ArtiObjectInstanceParameter): ArtiObjectInstanceParameterExpressionRef=E_Default_BSW_Sync_Task_EVENTSETFLAG
      E_Default_BSW_Sync_Task_LOCKED (ArtiExpression): ArtiExpressionString=Default_BSW_Sync_Task_RunningData.LockList
      IP_Default_BSW_Sync_Task_LOCKED (ArtiObjectInstanceParameter): ArtiObjectInstanceParameterExpressionRef=E_Default_BSW_Sync_Task_LOCKED
      E_Default_RTE_Mode_switch_Task_OSTASKTYPE (ArtiExpression): ArtiExpressionString=Task_Default_RTE_Mode_switch_Task_ConfigRef.IsExtended
      IP_Default_RTE_Mode_switch_Task_OSTASKTYPE (ArtiObjectInstanceParameter): ArtiObjectInstanceParameterExpressionRef=E_Default_RTE_Mode_switch_Task_OSTASKTYPE
      K_Default_RTE_Mode_switch_Task_OSTASKSCHEDULE (ArtiConstant): ArtiConstantString=NON
      E_Default_RTE_Mode_switch_Task_OSTASKMAXACTIVATION (ArtiExpression): ArtiExpressionString=Task_Default_RTE_Mode_switch_Task_ConfigRef.MaxActivationCount
      IP_Default_RTE_Mode_switch_Task_OSTASKMAXACTIVATION (ArtiObjectInstanceParameter): ArtiObjectInstanceParameterExpressionRef=E_Default_RTE_Mode_switch_Task_OSTASKMAXACTIVATION
      E_Default_RTE_Mode_switch_Task_REMAININGACTIVATIONS (ArtiExpression):
        ArtiExpressionString = Task_Default_RTE_Mode_switch_Task_ConfigRef.MaxActivationCount - Default_RTE_Mode_switch_Task_RunningData.ActivationCount
      IP_Default_RTE_Mode_switch_Task_REMAININGACTIVATIONS (ArtiObjectInstanceParameter): ArtiObjectInstanceParameterExpressionRef=E_Default_RTE_Mode_switch_Task_REMAININGACTIVATIONS
      E_Default_RTE_Mode_switch_Task_EVENTMASK (ArtiExpression): ArtiExpressionString=Default_RTE_Mode_switch_Task_RunningData.EventWait
      IP_Default_RTE_Mode_switch_Task_EVENTMASK (ArtiObjectInstanceParameter): ArtiObjectInstanceParameterExpressionRef=E_Default_RTE_Mode_switch_Task_EVENTMASK
      E_Default_RTE_Mode_switch_Task_EVENTSETFLAG (ArtiExpression): ArtiExpressionString=Default_RTE_Mode_switch_Task_RunningData.EventSet
      IP_Default_RTE_Mode_switch_Task_EVENTSETFLAG (ArtiObjectInstanceParameter): ArtiObjectInstanceParameterExpressionRef=E_Default_RTE_Mode_switch_Task_EVENTSETFLAG
      E_Default_RTE_Mode_switch_Task_LOCKED (ArtiExpression): ArtiExpressionString=Default_RTE_Mode_switch_Task_RunningData.LockList
      IP_Default_RTE_Mode_switch_Task_LOCKED (ArtiObjectInstanceParameter): ArtiObjectInstanceParameterExpressionRef=E_Default_RTE_Mode_switch_Task_LOCKED
      E_StartApplication_Appl_Init_Task_OSTASKTYPE (ArtiExpression): ArtiExpressionString=Task_StartApplication_Appl_Init_Task_ConfigRef.IsExtended
      IP_StartApplication_Appl_Init_Task_OSTASKTYPE (ArtiObjectInstanceParameter): ArtiObjectInstanceParameterExpressionRef=E_StartApplication_Appl_Init_Task_OSTASKTYPE
      K_StartApplication_Appl_Init_Task_OSTASKSCHEDULE (ArtiConstant): ArtiConstantString=NON
      E_StartApplication_Appl_Init_Task_OSTASKMAXACTIVATION (ArtiExpression): ArtiExpressionString=Task_StartApplication_Appl_Init_Task_ConfigRef.MaxActivationCount
      IP_StartApplication_Appl_Init_Task_OSTASKMAXACTIVATION (ArtiObjectInstanceParameter): ArtiObjectInstanceParameterExpressionRef=E_StartApplication_Appl_Init_Task_OSTASKMAXACTIVATION
      E_StartApplication_Appl_Init_Task_REMAININGACTIVATIONS (ArtiExpression):
        ArtiExpressionString = Task_StartApplication_Appl_Init_Task_ConfigRef.MaxActivationCount - StartApplication_Appl_Init_Task_RunningData.ActivationCount
      IP_StartApplication_Appl_Init_Task_REMAININGACTIVATIONS (ArtiObjectInstanceParameter): ArtiObjectInstanceParameterExpressionRef=E_StartApplication_Appl_Init_Task_REMAININGACTIVATIONS
      E_StartApplication_Appl_Init_Task_EVENTMASK (ArtiExpression): ArtiExpressionString=StartApplication_Appl_Init_Task_RunningData.EventWait
      IP_StartApplication_Appl_Init_Task_EVENTMASK (ArtiObjectInstanceParameter): ArtiObjectInstanceParameterExpressionRef=E_StartApplication_Appl_Init_Task_EVENTMASK
      E_StartApplication_Appl_Init_Task_EVENTSETFLAG (ArtiExpression): ArtiExpressionString=StartApplication_Appl_Init_Task_RunningData.EventSet
      IP_StartApplication_Appl_Init_Task_EVENTSETFLAG (ArtiObjectInstanceParameter): ArtiObjectInstanceParameterExpressionRef=E_StartApplication_Appl_Init_Task_EVENTSETFLAG
      E_StartApplication_Appl_Init_Task_LOCKED (ArtiExpression): ArtiExpressionString=StartApplication_Appl_Init_Task_RunningData.LockList
      IP_StartApplication_Appl_Init_Task_LOCKED (ArtiObjectInstanceParameter): ArtiObjectInstanceParameterExpressionRef=E_StartApplication_Appl_Init_Task_LOCKED
      E_Default_Init_Task_OSTASKTYPE (ArtiExpression): ArtiExpressionString=Task_Default_Init_Task_ConfigRef.IsExtended
      IP_Default_Init_Task_OSTASKTYPE (ArtiObjectInstanceParameter): ArtiObjectInstanceParameterExpressionRef=E_Default_Init_Task_OSTASKTYPE
      K_Default_Init_Task_OSTASKSCHEDULE (ArtiConstant): ArtiConstantString=NON
      E_Default_Init_Task_OSTASKMAXACTIVATION (ArtiExpression): ArtiExpressionString=Task_Default_Init_Task_ConfigRef.MaxActivationCount
      IP_Default_Init_Task_OSTASKMAXACTIVATION (ArtiObjectInstanceParameter): ArtiObjectInstanceParameterExpressionRef=E_Default_Init_Task_OSTASKMAXACTIVATION
      E_Default_Init_Task_REMAININGACTIVATIONS (ArtiExpression): ArtiExpressionString=Task_Default_Init_Task_ConfigRef.MaxActivationCount - Default_Init_Task_RunningData.ActivationCount
      IP_Default_Init_Task_REMAININGACTIVATIONS (ArtiObjectInstanceParameter): ArtiObjectInstanceParameterExpressionRef=E_Default_Init_Task_REMAININGACTIVATIONS
      E_Default_Init_Task_EVENTMASK (ArtiExpression): ArtiExpressionString=Default_Init_Task_RunningData.EventWait
      IP_Default_Init_Task_EVENTMASK (ArtiObjectInstanceParameter): ArtiObjectInstanceParameterExpressionRef=E_Default_Init_Task_EVENTMASK
      E_Default_Init_Task_EVENTSETFLAG (ArtiExpression): ArtiExpressionString=Default_Init_Task_RunningData.EventSet
      IP_Default_Init_Task_EVENTSETFLAG (ArtiObjectInstanceParameter): ArtiObjectInstanceParameterExpressionRef=E_Default_Init_Task_EVENTSETFLAG
      E_Default_Init_Task_LOCKED (ArtiExpression): ArtiExpressionString=Default_Init_Task_RunningData.LockList
      IP_Default_Init_Task_LOCKED (ArtiObjectInstanceParameter): ArtiObjectInstanceParameterExpressionRef=E_Default_Init_Task_LOCKED
      E_Default_Init_Task_Trusted_OSTASKTYPE (ArtiExpression): ArtiExpressionString=Task_Default_Init_Task_Trusted_ConfigRef.IsExtended
      IP_Default_Init_Task_Trusted_OSTASKTYPE (ArtiObjectInstanceParameter): ArtiObjectInstanceParameterExpressionRef=E_Default_Init_Task_Trusted_OSTASKTYPE
      K_Default_Init_Task_Trusted_OSTASKSCHEDULE (ArtiConstant): ArtiConstantString=NON
      E_Default_Init_Task_Trusted_OSTASKMAXACTIVATION (ArtiExpression): ArtiExpressionString=Task_Default_Init_Task_Trusted_ConfigRef.MaxActivationCount
      IP_Default_Init_Task_Trusted_OSTASKMAXACTIVATION (ArtiObjectInstanceParameter): ArtiObjectInstanceParameterExpressionRef=E_Default_Init_Task_Trusted_OSTASKMAXACTIVATION
      E_Default_Init_Task_Trusted_REMAININGACTIVATIONS (ArtiExpression): ArtiExpressionString=Task_Default_Init_Task_Trusted_ConfigRef.MaxActivationCount - Default_Init_Task_Trusted_RunningData.ActivationCount
      IP_Default_Init_Task_Trusted_REMAININGACTIVATIONS (ArtiObjectInstanceParameter): ArtiObjectInstanceParameterExpressionRef=E_Default_Init_Task_Trusted_REMAININGACTIVATIONS
      E_Default_Init_Task_Trusted_EVENTMASK (ArtiExpression): ArtiExpressionString=Default_Init_Task_Trusted_RunningData.EventWait
      IP_Default_Init_Task_Trusted_EVENTMASK (ArtiObjectInstanceParameter): ArtiObjectInstanceParameterExpressionRef=E_Default_Init_Task_Trusted_EVENTMASK
      E_Default_Init_Task_Trusted_EVENTSETFLAG (ArtiExpression): ArtiExpressionString=Default_Init_Task_Trusted_RunningData.EventSet
      IP_Default_Init_Task_Trusted_EVENTSETFLAG (ArtiObjectInstanceParameter): ArtiObjectInstanceParameterExpressionRef=E_Default_Init_Task_Trusted_EVENTSETFLAG
      E_Default_Init_Task_Trusted_LOCKED (ArtiExpression): ArtiExpressionString=Default_Init_Task_Trusted_RunningData.LockList
      IP_Default_Init_Task_Trusted_LOCKED (ArtiObjectInstanceParameter): ArtiObjectInstanceParameterExpressionRef=E_Default_Init_Task_Trusted_LOCKED
      E_Idle_Task_Core1_OSTASKTYPE (ArtiExpression): ArtiExpressionString=Task_Idle_Task_Core1_ConfigRef.IsExtended
      IP_Idle_Task_Core1_OSTASKTYPE (ArtiObjectInstanceParameter): ArtiObjectInstanceParameterExpressionRef=E_Idle_Task_Core1_OSTASKTYPE
      K_Idle_Task_Core1_OSTASKSCHEDULE (ArtiConstant): ArtiConstantString=FULL
      E_Idle_Task_Core1_OSTASKMAXACTIVATION (ArtiExpression): ArtiExpressionString=Task_Idle_Task_Core1_ConfigRef.MaxActivationCount
      IP_Idle_Task_Core1_OSTASKMAXACTIVATION (ArtiObjectInstanceParameter): ArtiObjectInstanceParameterExpressionRef=E_Idle_Task_Core1_OSTASKMAXACTIVATION
      E_Idle_Task_Core1_REMAININGACTIVATIONS (ArtiExpression): ArtiExpressionString=Task_Idle_Task_Core1_ConfigRef.MaxActivationCount - Idle_Task_Core1_RunningData.ActivationCount
      IP_Idle_Task_Core1_REMAININGACTIVATIONS (ArtiObjectInstanceParameter): ArtiObjectInstanceParameterExpressionRef=E_Idle_Task_Core1_REMAININGACTIVATIONS
      E_Idle_Task_Core1_EVENTMASK (ArtiExpression): ArtiExpressionString=Idle_Task_Core1_RunningData.EventWait
      IP_Idle_Task_Core1_EVENTMASK (ArtiObjectInstanceParameter): ArtiObjectInstanceParameterExpressionRef=E_Idle_Task_Core1_EVENTMASK
      E_Idle_Task_Core1_EVENTSETFLAG (ArtiExpression): ArtiExpressionString=Idle_Task_Core1_RunningData.EventSet
      IP_Idle_Task_Core1_EVENTSETFLAG (ArtiObjectInstanceParameter): ArtiObjectInstanceParameterExpressionRef=E_Idle_Task_Core1_EVENTSETFLAG
      E_Idle_Task_Core1_LOCKED (ArtiExpression): ArtiExpressionString=Idle_Task_Core1_RunningData.LockList
      IP_Idle_Task_Core1_LOCKED (ArtiObjectInstanceParameter): ArtiObjectInstanceParameterExpressionRef=E_Idle_Task_Core1_LOCKED
      E_Default_BSW_Async_Task_Core0_OSTASKTYPE (ArtiExpression): ArtiExpressionString=Task_Default_BSW_Async_Task_Core0_ConfigRef.IsExtended
      IP_Default_BSW_Async_Task_Core0_OSTASKTYPE (ArtiObjectInstanceParameter): ArtiObjectInstanceParameterExpressionRef=E_Default_BSW_Async_Task_Core0_OSTASKTYPE
      K_Default_BSW_Async_Task_Core0_OSTASKSCHEDULE (ArtiConstant): ArtiConstantString=NON
      E_Default_BSW_Async_Task_Core0_OSTASKMAXACTIVATION (ArtiExpression): ArtiExpressionString=Task_Default_BSW_Async_Task_Core0_ConfigRef.MaxActivationCount
      IP_Default_BSW_Async_Task_Core0_OSTASKMAXACTIVATION (ArtiObjectInstanceParameter): ArtiObjectInstanceParameterExpressionRef=E_Default_BSW_Async_Task_Core0_OSTASKMAXACTIVATION
      E_Default_BSW_Async_Task_Core0_REMAININGACTIVATIONS (ArtiExpression):
        ArtiExpressionString = Task_Default_BSW_Async_Task_Core0_ConfigRef.MaxActivationCount - Default_BSW_Async_Task_Core0_RunningData.ActivationCount
      IP_Default_BSW_Async_Task_Core0_REMAININGACTIVATIONS (ArtiObjectInstanceParameter): ArtiObjectInstanceParameterExpressionRef=E_Default_BSW_Async_Task_Core0_REMAININGACTIVATIONS
      E_Default_BSW_Async_Task_Core0_EVENTMASK (ArtiExpression): ArtiExpressionString=Default_BSW_Async_Task_Core0_RunningData.EventWait
      IP_Default_BSW_Async_Task_Core0_EVENTMASK (ArtiObjectInstanceParameter): ArtiObjectInstanceParameterExpressionRef=E_Default_BSW_Async_Task_Core0_EVENTMASK
      E_Default_BSW_Async_Task_Core0_EVENTSETFLAG (ArtiExpression): ArtiExpressionString=Default_BSW_Async_Task_Core0_RunningData.EventSet
      IP_Default_BSW_Async_Task_Core0_EVENTSETFLAG (ArtiObjectInstanceParameter): ArtiObjectInstanceParameterExpressionRef=E_Default_BSW_Async_Task_Core0_EVENTSETFLAG
      E_Default_BSW_Async_Task_Core0_LOCKED (ArtiExpression): ArtiExpressionString=Default_BSW_Async_Task_Core0_RunningData.LockList
      IP_Default_BSW_Async_Task_Core0_LOCKED (ArtiObjectInstanceParameter): ArtiObjectInstanceParameterExpressionRef=E_Default_BSW_Async_Task_Core0_LOCKED
      E_Default_BSW_Async_Task_Core1_OSTASKTYPE (ArtiExpression): ArtiExpressionString=Task_Default_BSW_Async_Task_Core1_ConfigRef.IsExtended
      IP_Default_BSW_Async_Task_Core1_OSTASKTYPE (ArtiObjectInstanceParameter): ArtiObjectInstanceParameterExpressionRef=E_Default_BSW_Async_Task_Core1_OSTASKTYPE
      K_Default_BSW_Async_Task_Core1_OSTASKSCHEDULE (ArtiConstant): ArtiConstantString=NON
      E_Default_BSW_Async_Task_Core1_OSTASKMAXACTIVATION (ArtiExpression): ArtiExpressionString=Task_Default_BSW_Async_Task_Core1_ConfigRef.MaxActivationCount
      IP_Default_BSW_Async_Task_Core1_OSTASKMAXACTIVATION (ArtiObjectInstanceParameter): ArtiObjectInstanceParameterExpressionRef=E_Default_BSW_Async_Task_Core1_OSTASKMAXACTIVATION
      E_Default_BSW_Async_Task_Core1_REMAININGACTIVATIONS (ArtiExpression):
        ArtiExpressionString = Task_Default_BSW_Async_Task_Core1_ConfigRef.MaxActivationCount - Default_BSW_Async_Task_Core1_RunningData.ActivationCount
      IP_Default_BSW_Async_Task_Core1_REMAININGACTIVATIONS (ArtiObjectInstanceParameter): ArtiObjectInstanceParameterExpressionRef=E_Default_BSW_Async_Task_Core1_REMAININGACTIVATIONS
      E_Default_BSW_Async_Task_Core1_EVENTMASK (ArtiExpression): ArtiExpressionString=Default_BSW_Async_Task_Core1_RunningData.EventWait
      IP_Default_BSW_Async_Task_Core1_EVENTMASK (ArtiObjectInstanceParameter): ArtiObjectInstanceParameterExpressionRef=E_Default_BSW_Async_Task_Core1_EVENTMASK
      E_Default_BSW_Async_Task_Core1_EVENTSETFLAG (ArtiExpression): ArtiExpressionString=Default_BSW_Async_Task_Core1_RunningData.EventSet
      IP_Default_BSW_Async_Task_Core1_EVENTSETFLAG (ArtiObjectInstanceParameter): ArtiObjectInstanceParameterExpressionRef=E_Default_BSW_Async_Task_Core1_EVENTSETFLAG
      E_Default_BSW_Async_Task_Core1_LOCKED (ArtiExpression): ArtiExpressionString=Default_BSW_Async_Task_Core1_RunningData.LockList
      IP_Default_BSW_Async_Task_Core1_LOCKED (ArtiObjectInstanceParameter): ArtiObjectInstanceParameterExpressionRef=E_Default_BSW_Async_Task_Core1_LOCKED
      E_StartApplication_Appl_Task_Core0_OSTASKTYPE (ArtiExpression): ArtiExpressionString=Task_StartApplication_Appl_Task_Core0_ConfigRef.IsExtended
      IP_StartApplication_Appl_Task_Core0_OSTASKTYPE (ArtiObjectInstanceParameter): ArtiObjectInstanceParameterExpressionRef=E_StartApplication_Appl_Task_Core0_OSTASKTYPE
      K_StartApplication_Appl_Task_Core0_OSTASKSCHEDULE (ArtiConstant): ArtiConstantString=NON
      E_StartApplication_Appl_Task_Core0_OSTASKMAXACTIVATION (ArtiExpression): ArtiExpressionString=Task_StartApplication_Appl_Task_Core0_ConfigRef.MaxActivationCount
      IP_StartApplication_Appl_Task_Core0_OSTASKMAXACTIVATION (ArtiObjectInstanceParameter): ArtiObjectInstanceParameterExpressionRef=E_StartApplication_Appl_Task_Core0_OSTASKMAXACTIVATION
      E_StartApplication_Appl_Task_Core0_REMAININGACTIVATIONS (ArtiExpression):
        ArtiExpressionString = Task_StartApplication_Appl_Task_Core0_ConfigRef.MaxActivationCount - StartApplication_Appl_Task_Core0_RunningData.ActivationCount
      IP_StartApplication_Appl_Task_Core0_REMAININGACTIVATIONS (ArtiObjectInstanceParameter): ArtiObjectInstanceParameterExpressionRef=E_StartApplication_Appl_Task_Core0_REMAININGACTIVATIONS
      E_StartApplication_Appl_Task_Core0_EVENTMASK (ArtiExpression): ArtiExpressionString=StartApplication_Appl_Task_Core0_RunningData.EventWait
      IP_StartApplication_Appl_Task_Core0_EVENTMASK (ArtiObjectInstanceParameter): ArtiObjectInstanceParameterExpressionRef=E_StartApplication_Appl_Task_Core0_EVENTMASK
      E_StartApplication_Appl_Task_Core0_EVENTSETFLAG (ArtiExpression): ArtiExpressionString=StartApplication_Appl_Task_Core0_RunningData.EventSet
      IP_StartApplication_Appl_Task_Core0_EVENTSETFLAG (ArtiObjectInstanceParameter): ArtiObjectInstanceParameterExpressionRef=E_StartApplication_Appl_Task_Core0_EVENTSETFLAG
      E_StartApplication_Appl_Task_Core0_LOCKED (ArtiExpression): ArtiExpressionString=StartApplication_Appl_Task_Core0_RunningData.LockList
      IP_StartApplication_Appl_Task_Core0_LOCKED (ArtiObjectInstanceParameter): ArtiObjectInstanceParameterExpressionRef=E_StartApplication_Appl_Task_Core0_LOCKED
      E_StartApplication_Appl_Task_Core1_OSTASKTYPE (ArtiExpression): ArtiExpressionString=Task_StartApplication_Appl_Task_Core1_ConfigRef.IsExtended
      IP_StartApplication_Appl_Task_Core1_OSTASKTYPE (ArtiObjectInstanceParameter): ArtiObjectInstanceParameterExpressionRef=E_StartApplication_Appl_Task_Core1_OSTASKTYPE
      K_StartApplication_Appl_Task_Core1_OSTASKSCHEDULE (ArtiConstant): ArtiConstantString=NON
      E_StartApplication_Appl_Task_Core1_OSTASKMAXACTIVATION (ArtiExpression): ArtiExpressionString=Task_StartApplication_Appl_Task_Core1_ConfigRef.MaxActivationCount
      IP_StartApplication_Appl_Task_Core1_OSTASKMAXACTIVATION (ArtiObjectInstanceParameter): ArtiObjectInstanceParameterExpressionRef=E_StartApplication_Appl_Task_Core1_OSTASKMAXACTIVATION
      E_StartApplication_Appl_Task_Core1_REMAININGACTIVATIONS (ArtiExpression):
        ArtiExpressionString = Task_StartApplication_Appl_Task_Core1_ConfigRef.MaxActivationCount - StartApplication_Appl_Task_Core1_RunningData.ActivationCount
      IP_StartApplication_Appl_Task_Core1_REMAININGACTIVATIONS (ArtiObjectInstanceParameter): ArtiObjectInstanceParameterExpressionRef=E_StartApplication_Appl_Task_Core1_REMAININGACTIVATIONS
      E_StartApplication_Appl_Task_Core1_EVENTMASK (ArtiExpression): ArtiExpressionString=StartApplication_Appl_Task_Core1_RunningData.EventWait
      IP_StartApplication_Appl_Task_Core1_EVENTMASK (ArtiObjectInstanceParameter): ArtiObjectInstanceParameterExpressionRef=E_StartApplication_Appl_Task_Core1_EVENTMASK
      E_StartApplication_Appl_Task_Core1_EVENTSETFLAG (ArtiExpression): ArtiExpressionString=StartApplication_Appl_Task_Core1_RunningData.EventSet
      IP_StartApplication_Appl_Task_Core1_EVENTSETFLAG (ArtiObjectInstanceParameter): ArtiObjectInstanceParameterExpressionRef=E_StartApplication_Appl_Task_Core1_EVENTSETFLAG
      E_StartApplication_Appl_Task_Core1_LOCKED (ArtiExpression): ArtiExpressionString=StartApplication_Appl_Task_Core1_RunningData.LockList
      IP_StartApplication_Appl_Task_Core1_LOCKED (ArtiObjectInstanceParameter): ArtiObjectInstanceParameterExpressionRef=E_StartApplication_Appl_Task_Core1_LOCKED
      E_Default_Init_Task_Core1_OSTASKTYPE (ArtiExpression): ArtiExpressionString=Task_Default_Init_Task_Core1_ConfigRef.IsExtended
      IP_Default_Init_Task_Core1_OSTASKTYPE (ArtiObjectInstanceParameter): ArtiObjectInstanceParameterExpressionRef=E_Default_Init_Task_Core1_OSTASKTYPE
      K_Default_Init_Task_Core1_OSTASKSCHEDULE (ArtiConstant): ArtiConstantString=NON
      E_Default_Init_Task_Core1_OSTASKMAXACTIVATION (ArtiExpression): ArtiExpressionString=Task_Default_Init_Task_Core1_ConfigRef.MaxActivationCount
      IP_Default_Init_Task_Core1_OSTASKMAXACTIVATION (ArtiObjectInstanceParameter): ArtiObjectInstanceParameterExpressionRef=E_Default_Init_Task_Core1_OSTASKMAXACTIVATION
      E_Default_Init_Task_Core1_REMAININGACTIVATIONS (ArtiExpression): ArtiExpressionString=Task_Default_Init_Task_Core1_ConfigRef.MaxActivationCount - Default_Init_Task_Core1_RunningData.ActivationCount
      IP_Default_Init_Task_Core1_REMAININGACTIVATIONS (ArtiObjectInstanceParameter): ArtiObjectInstanceParameterExpressionRef=E_Default_Init_Task_Core1_REMAININGACTIVATIONS
      E_Default_Init_Task_Core1_EVENTMASK (ArtiExpression): ArtiExpressionString=Default_Init_Task_Core1_RunningData.EventWait
      IP_Default_Init_Task_Core1_EVENTMASK (ArtiObjectInstanceParameter): ArtiObjectInstanceParameterExpressionRef=E_Default_Init_Task_Core1_EVENTMASK
      E_Default_Init_Task_Core1_EVENTSETFLAG (ArtiExpression): ArtiExpressionString=Default_Init_Task_Core1_RunningData.EventSet
      IP_Default_Init_Task_Core1_EVENTSETFLAG (ArtiObjectInstanceParameter): ArtiObjectInstanceParameterExpressionRef=E_Default_Init_Task_Core1_EVENTSETFLAG
      E_Default_Init_Task_Core1_LOCKED (ArtiExpression): ArtiExpressionString=Default_Init_Task_Core1_RunningData.LockList
      IP_Default_Init_Task_Core1_LOCKED (ArtiObjectInstanceParameter): ArtiObjectInstanceParameterExpressionRef=E_Default_Init_Task_Core1_LOCKED
      E_Default_Init_Task_Core1_Trusted_OSTASKTYPE (ArtiExpression): ArtiExpressionString=Task_Default_Init_Task_Core1_Trusted_ConfigRef.IsExtended
      IP_Default_Init_Task_Core1_Trusted_OSTASKTYPE (ArtiObjectInstanceParameter): ArtiObjectInstanceParameterExpressionRef=E_Default_Init_Task_Core1_Trusted_OSTASKTYPE
      K_Default_Init_Task_Core1_Trusted_OSTASKSCHEDULE (ArtiConstant): ArtiConstantString=NON
      E_Default_Init_Task_Core1_Trusted_OSTASKMAXACTIVATION (ArtiExpression): ArtiExpressionString=Task_Default_Init_Task_Core1_Trusted_ConfigRef.MaxActivationCount
      IP_Default_Init_Task_Core1_Trusted_OSTASKMAXACTIVATION (ArtiObjectInstanceParameter): ArtiObjectInstanceParameterExpressionRef=E_Default_Init_Task_Core1_Trusted_OSTASKMAXACTIVATION
      E_Default_Init_Task_Core1_Trusted_REMAININGACTIVATIONS (ArtiExpression):
        ArtiExpressionString = Task_Default_Init_Task_Core1_Trusted_ConfigRef.MaxActivationCount - Default_Init_Task_Core1_Trusted_RunningData.ActivationCount
      IP_Default_Init_Task_Core1_Trusted_REMAININGACTIVATIONS (ArtiObjectInstanceParameter): ArtiObjectInstanceParameterExpressionRef=E_Default_Init_Task_Core1_Trusted_REMAININGACTIVATIONS
      E_Default_Init_Task_Core1_Trusted_EVENTMASK (ArtiExpression): ArtiExpressionString=Default_Init_Task_Core1_Trusted_RunningData.EventWait
      IP_Default_Init_Task_Core1_Trusted_EVENTMASK (ArtiObjectInstanceParameter): ArtiObjectInstanceParameterExpressionRef=E_Default_Init_Task_Core1_Trusted_EVENTMASK
      E_Default_Init_Task_Core1_Trusted_EVENTSETFLAG (ArtiExpression): ArtiExpressionString=Default_Init_Task_Core1_Trusted_RunningData.EventSet
      IP_Default_Init_Task_Core1_Trusted_EVENTSETFLAG (ArtiObjectInstanceParameter): ArtiObjectInstanceParameterExpressionRef=E_Default_Init_Task_Core1_Trusted_EVENTSETFLAG
      E_Default_Init_Task_Core1_Trusted_LOCKED (ArtiExpression): ArtiExpressionString=Default_Init_Task_Core1_Trusted_RunningData.LockList
      IP_Default_Init_Task_Core1_Trusted_LOCKED (ArtiObjectInstanceParameter): ArtiObjectInstanceParameterExpressionRef=E_Default_Init_Task_Core1_Trusted_LOCKED
      E_CAN_00_RXFIFO_ISR_PRIORITY (ArtiExpression): ArtiExpressionString=CAN_00_RXFIFO_ISR.IsrHwConfig.priority
      IP_CAN_00_RXFIFO_ISR_PRIORITY (ArtiObjectInstanceParameter): ArtiObjectInstanceParameterExpressionRef=E_CAN_00_RXFIFO_ISR_PRIORITY
      E_CAN_00_RXFIFO_ISR_LOCKED (ArtiExpression): ArtiExpressionString=CAN_00_RXFIFO_ISR_RunningData.LockList
      IP_CAN_00_RXFIFO_ISR_LOCKED (ArtiObjectInstanceParameter): ArtiObjectInstanceParameterExpressionRef=E_CAN_00_RXFIFO_ISR_LOCKED
      E_CAN_00_TX_ISR_PRIORITY (ArtiExpression): ArtiExpressionString=CAN_00_TX_ISR.IsrHwConfig.priority
      IP_CAN_00_TX_ISR_PRIORITY (ArtiObjectInstanceParameter): ArtiObjectInstanceParameterExpressionRef=E_CAN_00_TX_ISR_PRIORITY
      E_CAN_00_TX_ISR_LOCKED (ArtiExpression): ArtiExpressionString=CAN_00_TX_ISR_RunningData.LockList
      IP_CAN_00_TX_ISR_LOCKED (ArtiObjectInstanceParameter): ArtiObjectInstanceParameterExpressionRef=E_CAN_00_TX_ISR_LOCKED
      E_CAN_00_RX_ISR_PRIORITY (ArtiExpression): ArtiExpressionString=CAN_00_RX_ISR.IsrHwConfig.priority
      IP_CAN_00_RX_ISR_PRIORITY (ArtiObjectInstanceParameter): ArtiObjectInstanceParameterExpressionRef=E_CAN_00_RX_ISR_PRIORITY
      E_CAN_00_RX_ISR_LOCKED (ArtiExpression): ArtiExpressionString=CAN_00_RX_ISR_RunningData.LockList
      IP_CAN_00_RX_ISR_LOCKED (ArtiObjectInstanceParameter): ArtiObjectInstanceParameterExpressionRef=E_CAN_00_RX_ISR_LOCKED
      E_CounterIsr_SystemTimer_core0_PRIORITY (ArtiExpression): ArtiExpressionString=CounterIsr_SystemTimer_core0.IsrHwConfig.priority
      IP_CounterIsr_SystemTimer_core0_PRIORITY (ArtiObjectInstanceParameter): ArtiObjectInstanceParameterExpressionRef=E_CounterIsr_SystemTimer_core0_PRIORITY
      E_CounterIsr_SystemTimer_core0_LOCKED (ArtiExpression): ArtiExpressionString=CounterIsr_SystemTimer_core0_RunningData.LockList
      IP_CounterIsr_SystemTimer_core0_LOCKED (ArtiObjectInstanceParameter): ArtiObjectInstanceParameterExpressionRef=E_CounterIsr_SystemTimer_core0_LOCKED
      E_CounterIsr_SystemTimer_core1_PRIORITY (ArtiExpression): ArtiExpressionString=CounterIsr_SystemTimer_core1.IsrHwConfig.priority
      IP_CounterIsr_SystemTimer_core1_PRIORITY (ArtiObjectInstanceParameter): ArtiObjectInstanceParameterExpressionRef=E_CounterIsr_SystemTimer_core1_PRIORITY
      E_CounterIsr_SystemTimer_core1_LOCKED (ArtiExpression): ArtiExpressionString=CounterIsr_SystemTimer_core1_RunningData.LockList
      IP_CounterIsr_SystemTimer_core1_LOCKED (ArtiObjectInstanceParameter): ArtiObjectInstanceParameterExpressionRef=E_CounterIsr_SystemTimer_core1_LOCKED
      E_XSignalIsr_OsCore1_PRIORITY (ArtiExpression): ArtiExpressionString=XSignalIsr_OsCore1.IsrHwConfig.priority
      IP_XSignalIsr_OsCore1_PRIORITY (ArtiObjectInstanceParameter): ArtiObjectInstanceParameterExpressionRef=E_XSignalIsr_OsCore1_PRIORITY
      E_XSignalIsr_OsCore1_LOCKED (ArtiExpression): ArtiExpressionString=XSignalIsr_OsCore1_RunningData.LockList
      IP_XSignalIsr_OsCore1_LOCKED (ArtiObjectInstanceParameter): ArtiObjectInstanceParameterExpressionRef=E_XSignalIsr_OsCore1_LOCKED
      E_XSignalIsr_OsCore0_PRIORITY (ArtiExpression): ArtiExpressionString=XSignalIsr_OsCore0.IsrHwConfig.priority
      IP_XSignalIsr_OsCore0_PRIORITY (ArtiObjectInstanceParameter): ArtiObjectInstanceParameterExpressionRef=E_XSignalIsr_OsCore0_PRIORITY
      E_XSignalIsr_OsCore0_LOCKED (ArtiExpression): ArtiExpressionString=XSignalIsr_OsCore0_RunningData.LockList
      IP_XSignalIsr_OsCore0_LOCKED (ArtiObjectInstanceParameter): ArtiObjectInstanceParameterExpressionRef=E_XSignalIsr_OsCore0_LOCKED
      3 x ArtiConstant:
        K_OsConfig_ScalabilityClass: ArtiConstantString=SC1
        K_OsConfig_StatusLevel: ArtiConstantString=EXTENDED
        K_OsConfig_OsStackMonitoring: ArtiConstantString=TRUE
      E_Rte_Al_TE_StartApplication_StartApplication_Cyclic1000ms_ACTION (ArtiExpression): ArtiExpressionString=Alarm_Rte_Al_TE_StartApplication_StartApplication_Cyclic1000ms_ConfigRef.ActionType
      IP_Rte_Al_TE_StartApplication_StartApplication_Cyclic1000ms_ACTION (ArtiObjectInstanceParameter): ArtiObjectInstanceParameterExpressionRef=E_Rte_Al_TE_StartApplication_StartApplication_Cyclic1000ms_ACTION
      K_Rte_Al_TE_StartApplication_StartApplication_Cyclic1000ms_ALARMTIME (ArtiConstant): ArtiConstantString=0
      E_Rte_Al_TE_StartApplication_StartApplication_Cyclic10ms_ACTION (ArtiExpression): ArtiExpressionString=Alarm_Rte_Al_TE_StartApplication_StartApplication_Cyclic10ms_ConfigRef.ActionType
      IP_Rte_Al_TE_StartApplication_StartApplication_Cyclic10ms_ACTION (ArtiObjectInstanceParameter): ArtiObjectInstanceParameterExpressionRef=E_Rte_Al_TE_StartApplication_StartApplication_Cyclic10ms_ACTION
      K_Rte_Al_TE_StartApplication_StartApplication_Cyclic10ms_ALARMTIME (ArtiConstant): ArtiConstantString=0
      E_Rte_Al_TE_StartApplication_StartApplication_Cyclic1ms_ACTION (ArtiExpression): ArtiExpressionString=Alarm_Rte_Al_TE_StartApplication_StartApplication_Cyclic1ms_ConfigRef.ActionType
      IP_Rte_Al_TE_StartApplication_StartApplication_Cyclic1ms_ACTION (ArtiObjectInstanceParameter): ArtiObjectInstanceParameterExpressionRef=E_Rte_Al_TE_StartApplication_StartApplication_Cyclic1ms_ACTION
      K_Rte_Al_TE_StartApplication_StartApplication_Cyclic1ms_ALARMTIME (ArtiConstant): ArtiConstantString=0
      E_Rte_Al_TE_StartApplication_StartApplication_Cyclic250ms_ACTION (ArtiExpression): ArtiExpressionString=Alarm_Rte_Al_TE_StartApplication_StartApplication_Cyclic250ms_ConfigRef.ActionType
      IP_Rte_Al_TE_StartApplication_StartApplication_Cyclic250ms_ACTION (ArtiObjectInstanceParameter): ArtiObjectInstanceParameterExpressionRef=E_Rte_Al_TE_StartApplication_StartApplication_Cyclic250ms_ACTION
      K_Rte_Al_TE_StartApplication_StartApplication_Cyclic250ms_ALARMTIME (ArtiConstant): ArtiConstantString=0
      E_Rte_Al_TE2_Default_BSW_Async_Task_Core0_0_10ms_ACTION (ArtiExpression): ArtiExpressionString=Alarm_Rte_Al_TE2_Default_BSW_Async_Task_Core0_0_10ms_ConfigRef.ActionType
      IP_Rte_Al_TE2_Default_BSW_Async_Task_Core0_0_10ms_ACTION (ArtiObjectInstanceParameter): ArtiObjectInstanceParameterExpressionRef=E_Rte_Al_TE2_Default_BSW_Async_Task_Core0_0_10ms_ACTION
      K_Rte_Al_TE2_Default_BSW_Async_Task_Core0_0_10ms_ALARMTIME (ArtiConstant): ArtiConstantString=0
      E_Rte_Al_TE2_EcuM_EcuM_MainFunction_ACTION (ArtiExpression): ArtiExpressionString=Alarm_Rte_Al_TE2_EcuM_EcuM_MainFunction_ConfigRef.ActionType
      IP_Rte_Al_TE2_EcuM_EcuM_MainFunction_ACTION (ArtiObjectInstanceParameter): ArtiObjectInstanceParameterExpressionRef=E_Rte_Al_TE2_EcuM_EcuM_MainFunction_ACTION
      K_Rte_Al_TE2_EcuM_EcuM_MainFunction_ALARMTIME (ArtiConstant): ArtiConstantString=0
      E_Rte_Al_TE_StartApplication_Appl_Task_Core0_0_100ms_ACTION (ArtiExpression): ArtiExpressionString=Alarm_Rte_Al_TE_StartApplication_Appl_Task_Core0_0_100ms_ConfigRef.ActionType
      IP_Rte_Al_TE_StartApplication_Appl_Task_Core0_0_100ms_ACTION (ArtiObjectInstanceParameter): ArtiObjectInstanceParameterExpressionRef=E_Rte_Al_TE_StartApplication_Appl_Task_Core0_0_100ms_ACTION
      K_Rte_Al_TE_StartApplication_Appl_Task_Core0_0_100ms_ALARMTIME (ArtiConstant): ArtiConstantString=0
      19 x ArtiHook, all with ArtiHookContext=NOSUSP, ArtiHookInstance=OsOS, ArtiHookInstanceParameterTypeRef=TM_ArtiCoreIndex:
        H_OsApplication_Start: ArtiHookClass=AR_CP_OS_APPLICATION, ArtiHookEventName=OsApplication_Start, ArtiHookEventParameterTypeRef=TM_ApplicationId
        H_OsApplication_Restart: ArtiHookClass=AR_CP_OS_APPLICATION, ArtiHookEventName=OsApplication_Restart, ArtiHookEventParameterTypeRef=TM_ApplicationId
        H_OsApplication_AllowAccess: ArtiHookClass=AR_CP_OS_APPLICATION, ArtiHookEventName=OsApplication_AllowAccess, ArtiHookEventParameterTypeRef=TM_ApplicationId
        H_OsApplication_Terminate: ArtiHookClass=AR_CP_OS_APPLICATION, ArtiHookEventName=OsApplication_Terminate, ArtiHookEventParameterTypeRef=TM_ApplicationId
        H_OsTask_Activate: ArtiHookClass=AR_CP_OSARTI_TASK, ArtiHookEventName=OsTask_Activate, ArtiHookEventParameterTypeRef=TM_TaskId
        H_OsTask_Start: ArtiHookClass=AR_CP_OSARTI_TASK, ArtiHookEventName=OsTask_Start, ArtiHookEventParameterTypeRef=TM_TaskId
        H_OsTask_Preempt: ArtiHookClass=AR_CP_OSARTI_TASK, ArtiHookEventName=OsTask_Preempt, ArtiHookEventParameterTypeRef=TM_TaskId
        H_OsTask_Resume: ArtiHookClass=AR_CP_OSARTI_TASK, ArtiHookEventName=OsTask_Resume, ArtiHookEventParameterTypeRef=TM_TaskId
        H_OsTask_Wait: ArtiHookClass=AR_CP_OSARTI_TASK, ArtiHookEventName=OsTask_Wait, ArtiHookEventParameterTypeRef=TM_TaskId
        H_OsTask_Release: ArtiHookClass=AR_CP_OSARTI_TASK, ArtiHookEventName=OsTask_Release, ArtiHookEventParameterTypeRef=TM_TaskId
        H_OsTask_Continue: ArtiHookClass=AR_CP_OSARTI_TASK, ArtiHookEventName=OsTask_Continue, ArtiHookEventParameterTypeRef=TM_TaskId
        H_OsTask_Terminate: ArtiHookClass=AR_CP_OSARTI_TASK, ArtiHookEventName=OsTask_Terminate, ArtiHookEventParameterTypeRef=TM_TaskId
        H_OsCat2Isr_Activate: ArtiHookClass=AR_CP_OSARTI_CAT2ISR, ArtiHookEventName=OsCat2Isr_Activate, ArtiHookEventParameterTypeRef=TM_Isr2Id
        H_OsCat2Isr_Start: ArtiHookClass=AR_CP_OSARTI_CAT2ISR, ArtiHookEventName=OsCat2Isr_Start, ArtiHookEventParameterTypeRef=TM_Isr2Id
        H_OsCat2Isr_Preempt: ArtiHookClass=AR_CP_OSARTI_CAT2ISR, ArtiHookEventName=OsCat2Isr_Preempt, ArtiHookEventParameterTypeRef=TM_Isr2Id
        H_OsCat2Isr_Resume: ArtiHookClass=AR_CP_OSARTI_CAT2ISR, ArtiHookEventName=OsCat2Isr_Resume, ArtiHookEventParameterTypeRef=TM_Isr2Id
        H_OsCat2Isr_Stop: ArtiHookClass=AR_CP_OSARTI_CAT2ISR, ArtiHookEventName=OsCat2Isr_Stop, ArtiHookEventParameterTypeRef=TM_Isr2Id
        H_OsHook_ErrorHook_Start: ArtiHookClass=AR_CP_OS_HOOK, ArtiHookEventName=OsHook_ErrorHook_Start, ArtiHookEventParameterTypeRef=TM_LastError
        H_OsHook_ErrorHook_Return: ArtiHookClass=AR_CP_OS_HOOK, ArtiHookEventName=OsHook_ErrorHook_Return
    ArtiOs: ArtiOsGenericComponentRef=GC_OsEvent, ArtiOsGenericComponentRef=GC_OsConfig
      ArtiOsClass: ArtiOsClassAppModeRef=CP_AppMode, ArtiOsClassServiceTraceRef=CP_ServiceTrace, ArtiOsClassGenericComponentRef=GC_OsConfig
      Os (ArtiOsInstance):
        ArtiOsInstanceAppModeRef = IP_AppMode
        ArtiOsInstanceEcucRef = OsOS
        ArtiOsInstanceServiceTraceRef = IP_Core0_ServiceId
        ArtiOsInstanceGenericComponentRef = GI_OsConfig
        ArtiOsInstanceHookRef = H_OsApplication_Start
        ArtiOsInstanceHookRef = H_OsApplication_Restart
        ArtiOsInstanceHookRef = H_OsApplication_AllowAccess
        ArtiOsInstanceHookRef = H_OsApplication_Terminate
        ArtiOsInstanceHookRef = H_OsTask_Activate
        ArtiOsInstanceHookRef = H_OsTask_Start
        ArtiOsInstanceHookRef = H_OsTask_Preempt
        ArtiOsInstanceHookRef = H_OsTask_Resume
        ArtiOsInstanceHookRef = H_OsTask_Wait
        ArtiOsInstanceHookRef = H_OsTask_Release
        ArtiOsInstanceHookRef = H_OsTask_Continue
        ArtiOsInstanceHookRef = H_OsTask_Terminate
        ArtiOsInstanceHookRef = H_OsCat2Isr_Activate
        ArtiOsInstanceHookRef = H_OsCat2Isr_Start
        ArtiOsInstanceHookRef = H_OsCat2Isr_Preempt
        ArtiOsInstanceHookRef = H_OsCat2Isr_Resume
        ArtiOsInstanceHookRef = H_OsCat2Isr_Stop
        ArtiOsInstanceHookRef = H_OsHook_ErrorHook_Start
        ArtiOsInstanceHookRef = H_OsHook_ErrorHook_Return
      ArtiOsTaskClass:
        ArtiOsTaskClassContextRef = CP_TaskContext
        ArtiOsTaskClassCurrentTaskStateRef = CP_TaskState
        ArtiOsTaskClassPriorityRef = CP_TaskPriority
        ArtiOsTaskClassStackRef = CP_TaskStack
        ArtiOsTaskClassClassGenericComponentRef = GC_OsTask
      13 x ArtiOsTaskInstance:
        Idle_Task_Core0: ArtiOsTaskInstanceId=0, ArtiOsTaskInstanceContextRef=IP_Idle_Task_Core0_Context, ArtiOsTaskInstanceCurrentActivationsRef=IP_Idle_Task_Core0_Activations, ArtiOsTaskInstanceCurrentTaskStateRef=IP_Idle_Task_Core0_State, ArtiOsTaskInstanceEcucRef=Idle_Task_Core0, ArtiOsTaskInstancePriorityRef=IP_Idle_Task_Core0_Priority, ArtiOsTaskInstanceStackRef=IP_Idle_Task_Core0_StackBase, ArtiOsTaskInstanceGenericComponentRef=GI_Idle_Task_Core0
        Default_BSW_Sync_Task: ArtiOsTaskInstanceId=1, ArtiOsTaskInstanceContextRef=IP_Default_BSW_Sync_Task_Context, ArtiOsTaskInstanceCurrentActivationsRef=IP_Default_BSW_Sync_Task_Activations, ArtiOsTaskInstanceCurrentTaskStateRef=IP_Default_BSW_Sync_Task_State, ArtiOsTaskInstanceEcucRef=Default_BSW_Sync_Task, ArtiOsTaskInstancePriorityRef=IP_Default_BSW_Sync_Task_Priority, ArtiOsTaskInstanceStackRef=IP_Default_BSW_Sync_Task_StackBase, ArtiOsTaskInstanceGenericComponentRef=GI_Default_BSW_Sync_Task
        Default_RTE_Mode_switch_Task: ArtiOsTaskInstanceId=2, ArtiOsTaskInstanceContextRef=IP_Default_RTE_Mode_switch_Task_Context, ArtiOsTaskInstanceCurrentActivationsRef=IP_Default_RTE_Mode_switch_Task_Activations, ArtiOsTaskInstanceCurrentTaskStateRef=IP_Default_RTE_Mode_switch_Task_State, ArtiOsTaskInstanceEcucRef=Default_RTE_Mode_switch_Task, ArtiOsTaskInstancePriorityRef=IP_Default_RTE_Mode_switch_Task_Priority, ArtiOsTaskInstanceStackRef=IP_Default_RTE_Mode_switch_Task_StackBase, ArtiOsTaskInstanceGenericComponentRef=GI_Default_RTE_Mode_switch_Task
        StartApplication_Appl_Init_Task: ArtiOsTaskInstanceId=3, ArtiOsTaskInstanceContextRef=IP_StartApplication_Appl_Init_Task_Context, ArtiOsTaskInstanceCurrentActivationsRef=IP_StartApplication_Appl_Init_Task_Activations, ArtiOsTaskInstanceCurrentTaskStateRef=IP_StartApplication_Appl_Init_Task_State, ArtiOsTaskInstanceEcucRef=StartApplication_Appl_Init_Task, ArtiOsTaskInstancePriorityRef=IP_StartApplication_Appl_Init_Task_Priority, ArtiOsTaskInstanceStackRef=IP_StartApplication_Appl_Init_Task_StackBase, ArtiOsTaskInstanceGenericComponentRef=GI_StartApplication_Appl_Init_Task
        Default_Init_Task: ArtiOsTaskInstanceId=4, ArtiOsTaskInstanceContextRef=IP_Default_Init_Task_Context, ArtiOsTaskInstanceCurrentActivationsRef=IP_Default_Init_Task_Activations, ArtiOsTaskInstanceCurrentTaskStateRef=IP_Default_Init_Task_State, ArtiOsTaskInstanceEcucRef=Default_Init_Task, ArtiOsTaskInstancePriorityRef=IP_Default_Init_Task_Priority, ArtiOsTaskInstanceStackRef=IP_Default_Init_Task_StackBase, ArtiOsTaskInstanceGenericComponentRef=GI_Default_Init_Task
        Default_Init_Task_Trusted: ArtiOsTaskInstanceId=5, ArtiOsTaskInstanceContextRef=IP_Default_Init_Task_Trusted_Context, ArtiOsTaskInstanceCurrentActivationsRef=IP_Default_Init_Task_Trusted_Activations, ArtiOsTaskInstanceCurrentTaskStateRef=IP_Default_Init_Task_Trusted_State, ArtiOsTaskInstanceEcucRef=Default_Init_Task_Trusted, ArtiOsTaskInstancePriorityRef=IP_Default_Init_Task_Trusted_Priority, ArtiOsTaskInstanceStackRef=IP_Default_Init_Task_Trusted_StackBase, ArtiOsTaskInstanceGenericComponentRef=GI_Default_Init_Task_Trusted
        Idle_Task_Core1: ArtiOsTaskInstanceId=6, ArtiOsTaskInstanceContextRef=IP_Idle_Task_Core1_Context, ArtiOsTaskInstanceCurrentActivationsRef=IP_Idle_Task_Core1_Activations, ArtiOsTaskInstanceCurrentTaskStateRef=IP_Idle_Task_Core1_State, ArtiOsTaskInstanceEcucRef=Idle_Task_Core1, ArtiOsTaskInstancePriorityRef=IP_Idle_Task_Core1_Priority, ArtiOsTaskInstanceStackRef=IP_Idle_Task_Core1_StackBase, ArtiOsTaskInstanceGenericComponentRef=GI_Idle_Task_Core1
        Default_BSW_Async_Task_Core0: ArtiOsTaskInstanceId=7, ArtiOsTaskInstanceContextRef=IP_Default_BSW_Async_Task_Core0_Context, ArtiOsTaskInstanceCurrentActivationsRef=IP_Default_BSW_Async_Task_Core0_Activations, ArtiOsTaskInstanceCurrentTaskStateRef=IP_Default_BSW_Async_Task_Core0_State, ArtiOsTaskInstanceEcucRef=Default_BSW_Async_Task_Core0, ArtiOsTaskInstancePriorityRef=IP_Default_BSW_Async_Task_Core0_Priority, ArtiOsTaskInstanceStackRef=IP_Default_BSW_Async_Task_Core0_StackBase, ArtiOsTaskInstanceGenericComponentRef=GI_Default_BSW_Async_Task_Core0
        Default_BSW_Async_Task_Core1: ArtiOsTaskInstanceId=8, ArtiOsTaskInstanceContextRef=IP_Default_BSW_Async_Task_Core1_Context, ArtiOsTaskInstanceCurrentActivationsRef=IP_Default_BSW_Async_Task_Core1_Activations, ArtiOsTaskInstanceCurrentTaskStateRef=IP_Default_BSW_Async_Task_Core1_State, ArtiOsTaskInstanceEcucRef=Default_BSW_Async_Task_Core1, ArtiOsTaskInstancePriorityRef=IP_Default_BSW_Async_Task_Core1_Priority, ArtiOsTaskInstanceStackRef=IP_Default_BSW_Async_Task_Core1_StackBase, ArtiOsTaskInstanceGenericComponentRef=GI_Default_BSW_Async_Task_Core1
        StartApplication_Appl_Task_Core0: ArtiOsTaskInstanceId=9, ArtiOsTaskInstanceContextRef=IP_StartApplication_Appl_Task_Core0_Context, ArtiOsTaskInstanceCurrentActivationsRef=IP_StartApplication_Appl_Task_Core0_Activations, ArtiOsTaskInstanceCurrentTaskStateRef=IP_StartApplication_Appl_Task_Core0_State, ArtiOsTaskInstanceEcucRef=StartApplication_Appl_Task_Core0, ArtiOsTaskInstancePriorityRef=IP_StartApplication_Appl_Task_Core0_Priority, ArtiOsTaskInstanceStackRef=IP_StartApplication_Appl_Task_Core0_StackBase, ArtiOsTaskInstanceGenericComponentRef=GI_StartApplication_Appl_Task_Core0
        StartApplication_Appl_Task_Core1: ArtiOsTaskInstanceId=10, ArtiOsTaskInstanceContextRef=IP_StartApplication_Appl_Task_Core1_Context, ArtiOsTaskInstanceCurrentActivationsRef=IP_StartApplication_Appl_Task_Core1_Activations, ArtiOsTaskInstanceCurrentTaskStateRef=IP_StartApplication_Appl_Task_Core1_State, ArtiOsTaskInstanceEcucRef=StartApplication_Appl_Task_Core1, ArtiOsTaskInstancePriorityRef=IP_StartApplication_Appl_Task_Core1_Priority, ArtiOsTaskInstanceStackRef=IP_StartApplication_Appl_Task_Core1_StackBase, ArtiOsTaskInstanceGenericComponentRef=GI_StartApplication_Appl_Task_Core1
        Default_Init_Task_Core1: ArtiOsTaskInstanceId=11, ArtiOsTaskInstanceContextRef=IP_Default_Init_Task_Core1_Context, ArtiOsTaskInstanceCurrentActivationsRef=IP_Default_Init_Task_Core1_Activations, ArtiOsTaskInstanceCurrentTaskStateRef=IP_Default_Init_Task_Core1_State, ArtiOsTaskInstanceEcucRef=Default_Init_Task_Core1, ArtiOsTaskInstancePriorityRef=IP_Default_Init_Task_Core1_Priority, ArtiOsTaskInstanceStackRef=IP_Default_Init_Task_Core1_StackBase, ArtiOsTaskInstanceGenericComponentRef=GI_Default_Init_Task_Core1
        Default_Init_Task_Core1_Trusted: ArtiOsTaskInstanceId=12, ArtiOsTaskInstanceContextRef=IP_Default_Init_Task_Core1_Trusted_Context, ArtiOsTaskInstanceCurrentActivationsRef=IP_Default_Init_Task_Core1_Trusted_Activations, ArtiOsTaskInstanceCurrentTaskStateRef=IP_Default_Init_Task_Core1_Trusted_State, ArtiOsTaskInstanceEcucRef=Default_Init_Task_Core1_Trusted, ArtiOsTaskInstancePriorityRef=IP_Default_Init_Task_Core1_Trusted_Priority, ArtiOsTaskInstanceStackRef=IP_Default_Init_Task_Core1_Trusted_StackBase, ArtiOsTaskInstanceGenericComponentRef=GI_Default_Init_Task_Core1_Trusted
      ArtiOsIsrClass: ArtiOsIsrClassGenericComponentRef=GC_OsIsr
      7 x ArtiOsIsrInstance, all with ArtiOsIsrInstanceCategory=CATEGORY_2:
        CAN_00_RXFIFO_ISR: ArtiOsIsrInstanceId=0, ArtiOsIsrInstanceEcucRef=CAN_00_RXFIFO_ISR, ArtiOsIsrInstanceGenericComponentRef=GI_CAN_00_RXFIFO_ISR
        CAN_00_TX_ISR: ArtiOsIsrInstanceId=1, ArtiOsIsrInstanceEcucRef=CAN_00_TX_ISR, ArtiOsIsrInstanceGenericComponentRef=GI_CAN_00_TX_ISR
        CAN_00_RX_ISR: ArtiOsIsrInstanceId=2, ArtiOsIsrInstanceEcucRef=CAN_00_RX_ISR, ArtiOsIsrInstanceGenericComponentRef=GI_CAN_00_RX_ISR
        CounterIsr_SystemTimer_core0: ArtiOsIsrInstanceId=3, ArtiOsIsrInstanceEcucRef=CounterIsr_SystemTimer_core0, ArtiOsIsrInstanceGenericComponentRef=GI_CounterIsr_SystemTimer_core0
        CounterIsr_SystemTimer_core1: ArtiOsIsrInstanceId=4, ArtiOsIsrInstanceEcucRef=CounterIsr_SystemTimer_core1, ArtiOsIsrInstanceGenericComponentRef=GI_CounterIsr_SystemTimer_core1
        XSignalIsr_OsCore1: ArtiOsIsrInstanceId=5, ArtiOsIsrInstanceEcucRef=XSignalIsr_OsCore1, ArtiOsIsrInstanceGenericComponentRef=GI_XSignalIsr_OsCore1
        XSignalIsr_OsCore0: ArtiOsIsrInstanceId=6, ArtiOsIsrInstanceEcucRef=XSignalIsr_OsCore0, ArtiOsIsrInstanceGenericComponentRef=GI_XSignalIsr_OsCore0
      ArtiOsStackClass
      20 x ArtiOsStackInstance, all with ArtiOsStackInstanceDirection=DOWN, ArtiOsStackInstanceFillPatternRef=IP_StackFillPattern:
        Idle_Task_Core0_stack: ArtiOsStackInstanceBaseAddressRef=IP_Idle_Task_Core0_StackBase, ArtiOsStackInstanceSizeRef=IP_Idle_Task_Core0_StackSize
        Default_BSW_Sync_Task_stack: ArtiOsStackInstanceBaseAddressRef=IP_Default_BSW_Sync_Task_StackBase, ArtiOsStackInstanceSizeRef=IP_Default_BSW_Sync_Task_StackSize
        Default_RTE_Mode_switch_Task_stack: ArtiOsStackInstanceBaseAddressRef=IP_Default_RTE_Mode_switch_Task_StackBase, ArtiOsStackInstanceSizeRef=IP_Default_RTE_Mode_switch_Task_StackSize
        StartApplication_Appl_Init_Task_stack: ArtiOsStackInstanceBaseAddressRef=IP_StartApplication_Appl_Init_Task_StackBase, ArtiOsStackInstanceSizeRef=IP_StartApplication_Appl_Init_Task_StackSize
        Default_Init_Task_stack: ArtiOsStackInstanceBaseAddressRef=IP_Default_Init_Task_StackBase, ArtiOsStackInstanceSizeRef=IP_Default_Init_Task_StackSize
        Default_Init_Task_Trusted_stack: ArtiOsStackInstanceBaseAddressRef=IP_Default_Init_Task_Trusted_StackBase, ArtiOsStackInstanceSizeRef=IP_Default_Init_Task_Trusted_StackSize
        Idle_Task_Core1_stack: ArtiOsStackInstanceBaseAddressRef=IP_Idle_Task_Core1_StackBase, ArtiOsStackInstanceSizeRef=IP_Idle_Task_Core1_StackSize
        Default_BSW_Async_Task_Core0_stack: ArtiOsStackInstanceBaseAddressRef=IP_Default_BSW_Async_Task_Core0_StackBase, ArtiOsStackInstanceSizeRef=IP_Default_BSW_Async_Task_Core0_StackSize
        Default_BSW_Async_Task_Core1_stack: ArtiOsStackInstanceBaseAddressRef=IP_Default_BSW_Async_Task_Core1_StackBase, ArtiOsStackInstanceSizeRef=IP_Default_BSW_Async_Task_Core1_StackSize
        StartApplication_Appl_Task_Core0_stack: ArtiOsStackInstanceBaseAddressRef=IP_StartApplication_Appl_Task_Core0_StackBase, ArtiOsStackInstanceSizeRef=IP_StartApplication_Appl_Task_Core0_StackSize
        StartApplication_Appl_Task_Core1_stack: ArtiOsStackInstanceBaseAddressRef=IP_StartApplication_Appl_Task_Core1_StackBase, ArtiOsStackInstanceSizeRef=IP_StartApplication_Appl_Task_Core1_StackSize
        Default_Init_Task_Core1_stack: ArtiOsStackInstanceBaseAddressRef=IP_Default_Init_Task_Core1_StackBase, ArtiOsStackInstanceSizeRef=IP_Default_Init_Task_Core1_StackSize
        Default_Init_Task_Core1_Trusted_stack: ArtiOsStackInstanceBaseAddressRef=IP_Default_Init_Task_Core1_Trusted_StackBase, ArtiOsStackInstanceSizeRef=IP_Default_Init_Task_Core1_Trusted_StackSize
        CAN_00_RXFIFO_ISR_stack: ArtiOsStackInstanceBaseAddressRef=IP_CAN_00_RXFIFO_ISR_StackBase, ArtiOsStackInstanceSizeRef=IP_CAN_00_RXFIFO_ISR_StackSize
        CAN_00_TX_ISR_stack: ArtiOsStackInstanceBaseAddressRef=IP_CAN_00_TX_ISR_StackBase, ArtiOsStackInstanceSizeRef=IP_CAN_00_TX_ISR_StackSize
        CAN_00_RX_ISR_stack: ArtiOsStackInstanceBaseAddressRef=IP_CAN_00_RX_ISR_StackBase, ArtiOsStackInstanceSizeRef=IP_CAN_00_RX_ISR_StackSize
        CounterIsr_SystemTimer_core0_stack: ArtiOsStackInstanceBaseAddressRef=IP_CounterIsr_SystemTimer_core0_StackBase, ArtiOsStackInstanceSizeRef=IP_CounterIsr_SystemTimer_core0_StackSize
        CounterIsr_SystemTimer_core1_stack: ArtiOsStackInstanceBaseAddressRef=IP_CounterIsr_SystemTimer_core1_StackBase, ArtiOsStackInstanceSizeRef=IP_CounterIsr_SystemTimer_core1_StackSize
        XSignalIsr_OsCore1_stack: ArtiOsStackInstanceBaseAddressRef=IP_XSignalIsr_OsCore1_StackBase, ArtiOsStackInstanceSizeRef=IP_XSignalIsr_OsCore1_StackSize
        XSignalIsr_OsCore0_stack: ArtiOsStackInstanceBaseAddressRef=IP_XSignalIsr_OsCore0_StackBase, ArtiOsStackInstanceSizeRef=IP_XSignalIsr_OsCore0_StackSize
      ArtiOsContextClass
      20 x ArtiOsContextInstance:
        Idle_Task_Core0_ContextInfo: ArtiOsContextInstanceAddressRef=IP_Idle_Task_Core0_Context
        Default_BSW_Sync_Task_ContextInfo: ArtiOsContextInstanceAddressRef=IP_Default_BSW_Sync_Task_Context
        Default_RTE_Mode_switch_Task_ContextInfo: ArtiOsContextInstanceAddressRef=IP_Default_RTE_Mode_switch_Task_Context
        StartApplication_Appl_Init_Task_ContextInfo: ArtiOsContextInstanceAddressRef=IP_StartApplication_Appl_Init_Task_Context
        Default_Init_Task_ContextInfo: ArtiOsContextInstanceAddressRef=IP_Default_Init_Task_Context
        Default_Init_Task_Trusted_ContextInfo: ArtiOsContextInstanceAddressRef=IP_Default_Init_Task_Trusted_Context
        Idle_Task_Core1_ContextInfo: ArtiOsContextInstanceAddressRef=IP_Idle_Task_Core1_Context
        Default_BSW_Async_Task_Core0_ContextInfo: ArtiOsContextInstanceAddressRef=IP_Default_BSW_Async_Task_Core0_Context
        Default_BSW_Async_Task_Core1_ContextInfo: ArtiOsContextInstanceAddressRef=IP_Default_BSW_Async_Task_Core1_Context
        StartApplication_Appl_Task_Core0_ContextInfo: ArtiOsContextInstanceAddressRef=IP_StartApplication_Appl_Task_Core0_Context
        StartApplication_Appl_Task_Core1_ContextInfo: ArtiOsContextInstanceAddressRef=IP_StartApplication_Appl_Task_Core1_Context
        Default_Init_Task_Core1_ContextInfo: ArtiOsContextInstanceAddressRef=IP_Default_Init_Task_Core1_Context
        Default_Init_Task_Core1_Trusted_ContextInfo: ArtiOsContextInstanceAddressRef=IP_Default_Init_Task_Core1_Trusted_Context
        CAN_00_RXFIFO_ISR_ContextInfo: ArtiOsContextInstanceAddressRef=IP_CAN_00_RXFIFO_ISR_Context
        CAN_00_TX_ISR_ContextInfo: ArtiOsContextInstanceAddressRef=IP_CAN_00_TX_ISR_Context
        CAN_00_RX_ISR_ContextInfo: ArtiOsContextInstanceAddressRef=IP_CAN_00_RX_ISR_Context
        CounterIsr_SystemTimer_core0_ContextInfo: ArtiOsContextInstanceAddressRef=IP_CounterIsr_SystemTimer_core0_Context
        CounterIsr_SystemTimer_core1_ContextInfo: ArtiOsContextInstanceAddressRef=IP_CounterIsr_SystemTimer_core1_Context
        XSignalIsr_OsCore1_ContextInfo: ArtiOsContextInstanceAddressRef=IP_XSignalIsr_OsCore1_Context
        XSignalIsr_OsCore0_ContextInfo: ArtiOsContextInstanceAddressRef=IP_XSignalIsr_OsCore0_Context
      ArtiOsAlarmClass: ArtiOsAlarmClassStateRef=CP_AlarmState, ArtiOsAlarmClassGenericComponentClassRef=GC_OsAlarm
      7 x ArtiOsAlarmInstance:
        Rte_Al_TE_StartApplication_StartApplication_Cyclic1000ms: ArtiOsAlarmInstanceCounter=SystemTimer_core0, ArtiOsAlarmInstanceCycleTimeRef=IP_Rte_Al_TE_StartApplication_StartApplication_Cyclic1000ms_Cycle, ArtiOsAlarmInstanceEcuCRef=Rte_Al_TE_StartApplication_StartApplication_Cyclic1000ms, ArtiOsAlarmInstanceStateRef=IP_Rte_Al_TE_StartApplication_StartApplication_Cyclic1000ms_State, ArtiOsAlarmInstanceGenericComponentInstanceRef=GI_Rte_Al_TE_StartApplication_StartApplication_Cyclic1000ms
        Rte_Al_TE_StartApplication_StartApplication_Cyclic10ms: ArtiOsAlarmInstanceCounter=SystemTimer_core0, ArtiOsAlarmInstanceCycleTimeRef=IP_Rte_Al_TE_StartApplication_StartApplication_Cyclic10ms_Cycle, ArtiOsAlarmInstanceEcuCRef=Rte_Al_TE_StartApplication_StartApplication_Cyclic10ms, ArtiOsAlarmInstanceStateRef=IP_Rte_Al_TE_StartApplication_StartApplication_Cyclic10ms_State, ArtiOsAlarmInstanceGenericComponentInstanceRef=GI_Rte_Al_TE_StartApplication_StartApplication_Cyclic10ms
        Rte_Al_TE_StartApplication_StartApplication_Cyclic1ms: ArtiOsAlarmInstanceCounter=SystemTimer_core0, ArtiOsAlarmInstanceCycleTimeRef=IP_Rte_Al_TE_StartApplication_StartApplication_Cyclic1ms_Cycle, ArtiOsAlarmInstanceEcuCRef=Rte_Al_TE_StartApplication_StartApplication_Cyclic1ms, ArtiOsAlarmInstanceStateRef=IP_Rte_Al_TE_StartApplication_StartApplication_Cyclic1ms_State, ArtiOsAlarmInstanceGenericComponentInstanceRef=GI_Rte_Al_TE_StartApplication_StartApplication_Cyclic1ms
        Rte_Al_TE_StartApplication_StartApplication_Cyclic250ms: ArtiOsAlarmInstanceCounter=SystemTimer_core0, ArtiOsAlarmInstanceCycleTimeRef=IP_Rte_Al_TE_StartApplication_StartApplication_Cyclic250ms_Cycle, ArtiOsAlarmInstanceEcuCRef=Rte_Al_TE_StartApplication_StartApplication_Cyclic250ms, ArtiOsAlarmInstanceStateRef=IP_Rte_Al_TE_StartApplication_StartApplication_Cyclic250ms_State, ArtiOsAlarmInstanceGenericComponentInstanceRef=GI_Rte_Al_TE_StartApplication_StartApplication_Cyclic250ms
        Rte_Al_TE2_Default_BSW_Async_Task_Core0_0_10ms: ArtiOsAlarmInstanceCounter=SystemTimer_core0, ArtiOsAlarmInstanceCycleTimeRef=IP_Rte_Al_TE2_Default_BSW_Async_Task_Core0_0_10ms_Cycle, ArtiOsAlarmInstanceEcuCRef=Rte_Al_TE2_Default_BSW_Async_Task_Core0_0_10ms, ArtiOsAlarmInstanceStateRef=IP_Rte_Al_TE2_Default_BSW_Async_Task_Core0_0_10ms_State, ArtiOsAlarmInstanceGenericComponentInstanceRef=GI_Rte_Al_TE2_Default_BSW_Async_Task_Core0_0_10ms
        Rte_Al_TE2_EcuM_EcuM_MainFunction: ArtiOsAlarmInstanceCounter=SystemTimer_core1, ArtiOsAlarmInstanceCycleTimeRef=IP_Rte_Al_TE2_EcuM_EcuM_MainFunction_Cycle, ArtiOsAlarmInstanceEcuCRef=Rte_Al_TE2_EcuM_EcuM_MainFunction, ArtiOsAlarmInstanceStateRef=IP_Rte_Al_TE2_EcuM_EcuM_MainFunction_State, ArtiOsAlarmInstanceGenericComponentInstanceRef=GI_Rte_Al_TE2_EcuM_EcuM_MainFunction
        Rte_Al_TE_StartApplication_Appl_Task_Core0_0_100ms: ArtiOsAlarmInstanceCounter=SystemTimer_core0, ArtiOsAlarmInstanceCycleTimeRef=IP_Rte_Al_TE_StartApplication_Appl_Task_Core0_0_100ms_Cycle, ArtiOsAlarmInstanceEcuCRef=Rte_Al_TE_StartApplication_Appl_Task_Core0_0_100ms, ArtiOsAlarmInstanceStateRef=IP_Rte_Al_TE_StartApplication_Appl_Task_Core0_0_100ms_State, ArtiOsAlarmInstanceGenericComponentInstanceRef=GI_Rte_Al_TE_StartApplication_Appl_Task_Core0_0_100ms
      ArtiOsResourceClass: ArtiOsResourceClassStateRef=CP_ResourceState, ArtiOsResourceClassGenericComponentClassRef=GC_OsResource
      OsResource (ArtiOsResourceInstance):
        ArtiOsResourceInstanceEcuCRef = OsResource
        ArtiOsResourceInstanceStateRef = IP_OsResource_State
        ArtiOsResourceInstanceGenericComponentInstanceRef = GI_OsResource
    ArtiHardware
      ArtiHardwareCoreClass:
        ArtiHardwareCoreClassCurrentApplicationRef = CP_CurrentApplication
        ArtiHardwareCoreClassCurrentIsrRef = CP_CurrentIsr
        ArtiHardwareCoreClassCurrentTaskRef = CP_CurrentTask
        ArtiHardwareCoreClassLastErrorRef = CP_LastError
        ArtiHardwareCoreClassRunningTaskPriorityRef = CP_RunningTaskPriority
      Core0 (ArtiHardwareCoreInstance):
        ArtiHardwareCoreInstanceCoreId = 0
        ArtiHardwareCoreInstanceCurrentApplicationRef = IP_Core0_CurrentApplication
        ArtiHardwareCoreInstanceCurrentIsrRef = IP_Core0_RunningIsr
        ArtiHardwareCoreInstanceCurrentTaskRef = IP_Core0_RunningTask
        ArtiHardwareCoreInstanceEcucCoreRef = EcucCoreDefinition_0
        ArtiHardwareCoreInstanceLastErrorRef = IP_Core0_LastError
        ArtiHardwareCoreInstanceRunningTaskPriorityRef = IP_Core0_RunningTask
      Core1 (ArtiHardwareCoreInstance):
        ArtiHardwareCoreInstanceCoreId = 1
        ArtiHardwareCoreInstanceCurrentApplicationRef = IP_Core1_CurrentApplication
        ArtiHardwareCoreInstanceCurrentIsrRef = IP_Core1_RunningIsr
        ArtiHardwareCoreInstanceCurrentTaskRef = IP_Core1_RunningTask
        ArtiHardwareCoreInstanceEcucCoreRef = EcucCoreDefinition_1
        ArtiHardwareCoreInstanceLastErrorRef = IP_Core1_LastError
        ArtiHardwareCoreInstanceRunningTaskPriorityRef = IP_Core1_RunningTask
    ArtiGeneric
      GC_OsEvent (ArtiGenericComponentClass): ArtiGenericComponentClassName=OsEvent
        GCP_OsEvent_EVENTMASK (ArtiGenericComponentClassParameter): ArtiGenericComponentClassParameterName=EVENTMASK
      8 x ArtiGenericComponentInstance, all with ArtiGenericComponentInstanceClassRef=GC_OsEvent:
        GI_Rte_Ev_Run_StartApplication_StartApplication_Cyclic1000ms: ArtiGenericComponentInstanceName=Rte_Ev_Run_StartApplication_StartApplication_Cyclic1000ms
          GIP_Rte_Ev_Run_StartApplication_StartApplication_Cyclic1000ms_EVENTMASK (ArtiGenericComponentInstanceParameter):
            ArtiGenericComponentInstanceParameterClassParameterRef = GCP_OsEvent_EVENTMASK
            ArtiGenericComponentInstanceParameterConstantRef = K_Rte_Ev_Run_StartApplication_StartApplication_Cyclic1000ms_EVENTMASK
        GI_Rte_Ev_Run_StartApplication_StartApplication_Cyclic10ms: ArtiGenericComponentInstanceName=Rte_Ev_Run_StartApplication_StartApplication_Cyclic10ms
          GIP_Rte_Ev_Run_StartApplication_StartApplication_Cyclic10ms_EVENTMASK (ArtiGenericComponentInstanceParameter):
            ArtiGenericComponentInstanceParameterClassParameterRef = GCP_OsEvent_EVENTMASK
            ArtiGenericComponentInstanceParameterConstantRef = K_Rte_Ev_Run_StartApplication_StartApplication_Cyclic10ms_EVENTMASK
        GI_Rte_Ev_Run_StartApplication_StartApplication_Cyclic1ms: ArtiGenericComponentInstanceName=Rte_Ev_Run_StartApplication_StartApplication_Cyclic1ms
          GIP_Rte_Ev_Run_StartApplication_StartApplication_Cyclic1ms_EVENTMASK (ArtiGenericComponentInstanceParameter):
            ArtiGenericComponentInstanceParameterClassParameterRef = GCP_OsEvent_EVENTMASK
            ArtiGenericComponentInstanceParameterConstantRef = K_Rte_Ev_Run_StartApplication_StartApplication_Cyclic1ms_EVENTMASK
        GI_Rte_Ev_Run_StartApplication_StartApplication_Cyclic250ms: ArtiGenericComponentInstanceName=Rte_Ev_Run_StartApplication_StartApplication_Cyclic250ms
          GIP_Rte_Ev_Run_StartApplication_StartApplication_Cyclic250ms_EVENTMASK (ArtiGenericComponentInstanceParameter):
            ArtiGenericComponentInstanceParameterClassParameterRef = GCP_OsEvent_EVENTMASK
            ArtiGenericComponentInstanceParameterConstantRef = K_Rte_Ev_Run_StartApplication_StartApplication_Cyclic250ms_EVENTMASK
        GI_Rte_Ev_Run_StartApplication_StartApplication_OnDataRec_EthernetCommunication: ArtiGenericComponentInstanceName=Rte_Ev_Run_StartApplication_StartApplication_OnDataRec_EthernetCommunication
          GIP_Rte_Ev_Run_StartApplication_StartApplication_OnDataRec_EthernetCommunication_EVENTMASK (ArtiGenericComponentInstanceParameter):
            ArtiGenericComponentInstanceParameterClassParameterRef = GCP_OsEvent_EVENTMASK
            ArtiGenericComponentInstanceParameterConstantRef = K_Rte_Ev_Run_StartApplication_StartApplication_OnDataRec_EthernetCommunication_EVENTMASK
        GI_Rte_Ev_Cyclic_StartApplication_Appl_Task_Core0_0_100ms: ArtiGenericComponentInstanceName=Rte_Ev_Cyclic_StartApplication_Appl_Task_Core0_0_100ms
          GIP_Rte_Ev_Cyclic_StartApplication_Appl_Task_Core0_0_100ms_EVENTMASK (ArtiGenericComponentInstanceParameter):
            ArtiGenericComponentInstanceParameterClassParameterRef = GCP_OsEvent_EVENTMASK
            ArtiGenericComponentInstanceParameterConstantRef = K_Rte_Ev_Cyclic_StartApplication_Appl_Task_Core0_0_100ms_EVENTMASK
        GI_Rte_Ev_Run_StartApplication_StartApplication_OnDataRec_RxCtrl: ArtiGenericComponentInstanceName=Rte_Ev_Run_StartApplication_StartApplication_OnDataRec_RxCtrl
          GIP_Rte_Ev_Run_StartApplication_StartApplication_OnDataRec_RxCtrl_EVENTMASK (ArtiGenericComponentInstanceParameter):
            ArtiGenericComponentInstanceParameterClassParameterRef = GCP_OsEvent_EVENTMASK
            ArtiGenericComponentInstanceParameterConstantRef = K_Rte_Ev_Run_StartApplication_StartApplication_OnDataRec_RxCtrl_EVENTMASK
        GI_Rte_Ev_Run_StartApplication_StartApplication_OnDataRec_RxData: ArtiGenericComponentInstanceName=Rte_Ev_Run_StartApplication_StartApplication_OnDataRec_RxData
          GIP_Rte_Ev_Run_StartApplication_StartApplication_OnDataRec_RxData_EVENTMASK (ArtiGenericComponentInstanceParameter):
            ArtiGenericComponentInstanceParameterClassParameterRef = GCP_OsEvent_EVENTMASK
            ArtiGenericComponentInstanceParameterConstantRef = K_Rte_Ev_Run_StartApplication_StartApplication_OnDataRec_RxData_EVENTMASK
      GC_OsTask (ArtiGenericComponentClass): ArtiGenericComponentClassName=OsTask
        7 x ArtiGenericComponentClassParameter:
          GCP_OsTask_OSTASKTYPE: ArtiGenericComponentClassParameterName=OSTASKTYPE, ArtiGenericComponentClassParameterTypeMapRef=TM_TaskType
          GCP_OsTask_OSTASKSCHEDULE: ArtiGenericComponentClassParameterName=OSTASKSCHEDULE
          GCP_OsTask_OSTASKMAXACTIVATION: ArtiGenericComponentClassParameterName=OSTASKMAXACTIVATION
          GCP_OsTask_REMAININGACTIVATIONS: ArtiGenericComponentClassParameterName=REMAININGACTIVATIONS
          GCP_OsTask_EVENTMASK: ArtiGenericComponentClassParameterName=EVENTMASK
          GCP_OsTask_EVENTSETFLAG: ArtiGenericComponentClassParameterName=EVENTSETFLAG
          GCP_OsTask_LOCKED: ArtiGenericComponentClassParameterName=LOCKED, ArtiGenericComponentClassParameterTypeMapRef=TM_LockedByTask
      13 x ArtiGenericComponentInstance, all with ArtiGenericComponentInstanceClassRef=GC_OsTask:
        GI_Idle_Task_Core0: ArtiGenericComponentInstanceName=Idle_Task_Core0
          7 x ArtiGenericComponentInstanceParameter:
            GIP_Idle_Task_Core0_OSTASKTYPE: ArtiGenericComponentInstanceParameterClassParameterRef=GCP_OsTask_OSTASKTYPE, ArtiGenericComponentInstanceParameterExpressionRef=E_Idle_Task_Core0_OSTASKTYPE
            GIP_Idle_Task_Core0_OSTASKSCHEDULE: ArtiGenericComponentInstanceParameterClassParameterRef=GCP_OsTask_OSTASKSCHEDULE, ArtiGenericComponentInstanceParameterConstantRef=K_Idle_Task_Core0_OSTASKSCHEDULE
            GIP_Idle_Task_Core0_OSTASKMAXACTIVATION: ArtiGenericComponentInstanceParameterClassParameterRef=GCP_OsTask_OSTASKMAXACTIVATION, ArtiGenericComponentInstanceParameterExpressionRef=E_Idle_Task_Core0_OSTASKMAXACTIVATION
            GIP_Idle_Task_Core0_REMAININGACTIVATIONS: ArtiGenericComponentInstanceParameterClassParameterRef=GCP_OsTask_REMAININGACTIVATIONS, ArtiGenericComponentInstanceParameterExpressionRef=E_Idle_Task_Core0_REMAININGACTIVATIONS
            GIP_Idle_Task_Core0_EVENTMASK: ArtiGenericComponentInstanceParameterClassParameterRef=GCP_OsTask_EVENTMASK, ArtiGenericComponentInstanceParameterExpressionRef=E_Idle_Task_Core0_EVENTMASK
            GIP_Idle_Task_Core0_EVENTSETFLAG: ArtiGenericComponentInstanceParameterClassParameterRef=GCP_OsTask_EVENTSETFLAG, ArtiGenericComponentInstanceParameterExpressionRef=E_Idle_Task_Core0_EVENTSETFLAG
            GIP_Idle_Task_Core0_LOCKED: ArtiGenericComponentInstanceParameterClassParameterRef=GCP_OsTask_LOCKED, ArtiGenericComponentInstanceParameterExpressionRef=E_Idle_Task_Core0_LOCKED
        GI_Default_BSW_Sync_Task: ArtiGenericComponentInstanceName=Default_BSW_Sync_Task
          7 x ArtiGenericComponentInstanceParameter:
            GIP_Default_BSW_Sync_Task_OSTASKTYPE: ArtiGenericComponentInstanceParameterClassParameterRef=GCP_OsTask_OSTASKTYPE, ArtiGenericComponentInstanceParameterExpressionRef=E_Default_BSW_Sync_Task_OSTASKTYPE
            GIP_Default_BSW_Sync_Task_OSTASKSCHEDULE: ArtiGenericComponentInstanceParameterClassParameterRef=GCP_OsTask_OSTASKSCHEDULE, ArtiGenericComponentInstanceParameterConstantRef=K_Default_BSW_Sync_Task_OSTASKSCHEDULE
            GIP_Default_BSW_Sync_Task_OSTASKMAXACTIVATION: ArtiGenericComponentInstanceParameterClassParameterRef=GCP_OsTask_OSTASKMAXACTIVATION, ArtiGenericComponentInstanceParameterExpressionRef=E_Default_BSW_Sync_Task_OSTASKMAXACTIVATION
            GIP_Default_BSW_Sync_Task_REMAININGACTIVATIONS: ArtiGenericComponentInstanceParameterClassParameterRef=GCP_OsTask_REMAININGACTIVATIONS, ArtiGenericComponentInstanceParameterExpressionRef=E_Default_BSW_Sync_Task_REMAININGACTIVATIONS
            GIP_Default_BSW_Sync_Task_EVENTMASK: ArtiGenericComponentInstanceParameterClassParameterRef=GCP_OsTask_EVENTMASK, ArtiGenericComponentInstanceParameterExpressionRef=E_Default_BSW_Sync_Task_EVENTMASK
            GIP_Default_BSW_Sync_Task_EVENTSETFLAG: ArtiGenericComponentInstanceParameterClassParameterRef=GCP_OsTask_EVENTSETFLAG, ArtiGenericComponentInstanceParameterExpressionRef=E_Default_BSW_Sync_Task_EVENTSETFLAG
            GIP_Default_BSW_Sync_Task_LOCKED: ArtiGenericComponentInstanceParameterClassParameterRef=GCP_OsTask_LOCKED, ArtiGenericComponentInstanceParameterExpressionRef=E_Default_BSW_Sync_Task_LOCKED
        GI_Default_RTE_Mode_switch_Task: ArtiGenericComponentInstanceName=Default_RTE_Mode_switch_Task
          7 x ArtiGenericComponentInstanceParameter:
            GIP_Default_RTE_Mode_switch_Task_OSTASKTYPE: ArtiGenericComponentInstanceParameterClassParameterRef=GCP_OsTask_OSTASKTYPE, ArtiGenericComponentInstanceParameterExpressionRef=E_Default_RTE_Mode_switch_Task_OSTASKTYPE
            GIP_Default_RTE_Mode_switch_Task_OSTASKSCHEDULE: ArtiGenericComponentInstanceParameterClassParameterRef=GCP_OsTask_OSTASKSCHEDULE, ArtiGenericComponentInstanceParameterConstantRef=K_Default_RTE_Mode_switch_Task_OSTASKSCHEDULE
            GIP_Default_RTE_Mode_switch_Task_OSTASKMAXACTIVATION: ArtiGenericComponentInstanceParameterClassParameterRef=GCP_OsTask_OSTASKMAXACTIVATION, ArtiGenericComponentInstanceParameterExpressionRef=E_Default_RTE_Mode_switch_Task_OSTASKMAXACTIVATION
            GIP_Default_RTE_Mode_switch_Task_REMAININGACTIVATIONS: ArtiGenericComponentInstanceParameterClassParameterRef=GCP_OsTask_REMAININGACTIVATIONS, ArtiGenericComponentInstanceParameterExpressionRef=E_Default_RTE_Mode_switch_Task_REMAININGACTIVATIONS
            GIP_Default_RTE_Mode_switch_Task_EVENTMASK: ArtiGenericComponentInstanceParameterClassParameterRef=GCP_OsTask_EVENTMASK, ArtiGenericComponentInstanceParameterExpressionRef=E_Default_RTE_Mode_switch_Task_EVENTMASK
            GIP_Default_RTE_Mode_switch_Task_EVENTSETFLAG: ArtiGenericComponentInstanceParameterClassParameterRef=GCP_OsTask_EVENTSETFLAG, ArtiGenericComponentInstanceParameterExpressionRef=E_Default_RTE_Mode_switch_Task_EVENTSETFLAG
            GIP_Default_RTE_Mode_switch_Task_LOCKED: ArtiGenericComponentInstanceParameterClassParameterRef=GCP_OsTask_LOCKED, ArtiGenericComponentInstanceParameterExpressionRef=E_Default_RTE_Mode_switch_Task_LOCKED
        GI_StartApplication_Appl_Init_Task: ArtiGenericComponentInstanceName=StartApplication_Appl_Init_Task
          7 x ArtiGenericComponentInstanceParameter:
            GIP_StartApplication_Appl_Init_Task_OSTASKTYPE: ArtiGenericComponentInstanceParameterClassParameterRef=GCP_OsTask_OSTASKTYPE, ArtiGenericComponentInstanceParameterExpressionRef=E_StartApplication_Appl_Init_Task_OSTASKTYPE
            GIP_StartApplication_Appl_Init_Task_OSTASKSCHEDULE: ArtiGenericComponentInstanceParameterClassParameterRef=GCP_OsTask_OSTASKSCHEDULE, ArtiGenericComponentInstanceParameterConstantRef=K_StartApplication_Appl_Init_Task_OSTASKSCHEDULE
            GIP_StartApplication_Appl_Init_Task_OSTASKMAXACTIVATION: ArtiGenericComponentInstanceParameterClassParameterRef=GCP_OsTask_OSTASKMAXACTIVATION, ArtiGenericComponentInstanceParameterExpressionRef=E_StartApplication_Appl_Init_Task_OSTASKMAXACTIVATION
            GIP_StartApplication_Appl_Init_Task_REMAININGACTIVATIONS: ArtiGenericComponentInstanceParameterClassParameterRef=GCP_OsTask_REMAININGACTIVATIONS, ArtiGenericComponentInstanceParameterExpressionRef=E_StartApplication_Appl_Init_Task_REMAININGACTIVATIONS
            GIP_StartApplication_Appl_Init_Task_EVENTMASK: ArtiGenericComponentInstanceParameterClassParameterRef=GCP_OsTask_EVENTMASK, ArtiGenericComponentInstanceParameterExpressionRef=E_StartApplication_Appl_Init_Task_EVENTMASK
            GIP_StartApplication_Appl_Init_Task_EVENTSETFLAG: ArtiGenericComponentInstanceParameterClassParameterRef=GCP_OsTask_EVENTSETFLAG, ArtiGenericComponentInstanceParameterExpressionRef=E_StartApplication_Appl_Init_Task_EVENTSETFLAG
            GIP_StartApplication_Appl_Init_Task_LOCKED: ArtiGenericComponentInstanceParameterClassParameterRef=GCP_OsTask_LOCKED, ArtiGenericComponentInstanceParameterExpressionRef=E_StartApplication_Appl_Init_Task_LOCKED
        GI_Default_Init_Task: ArtiGenericComponentInstanceName=Default_Init_Task
          7 x ArtiGenericComponentInstanceParameter:
            GIP_Default_Init_Task_OSTASKTYPE: ArtiGenericComponentInstanceParameterClassParameterRef=GCP_OsTask_OSTASKTYPE, ArtiGenericComponentInstanceParameterExpressionRef=E_Default_Init_Task_OSTASKTYPE
            GIP_Default_Init_Task_OSTASKSCHEDULE: ArtiGenericComponentInstanceParameterClassParameterRef=GCP_OsTask_OSTASKSCHEDULE, ArtiGenericComponentInstanceParameterConstantRef=K_Default_Init_Task_OSTASKSCHEDULE
            GIP_Default_Init_Task_OSTASKMAXACTIVATION: ArtiGenericComponentInstanceParameterClassParameterRef=GCP_OsTask_OSTASKMAXACTIVATION, ArtiGenericComponentInstanceParameterExpressionRef=E_Default_Init_Task_OSTASKMAXACTIVATION
            GIP_Default_Init_Task_REMAININGACTIVATIONS: ArtiGenericComponentInstanceParameterClassParameterRef=GCP_OsTask_REMAININGACTIVATIONS, ArtiGenericComponentInstanceParameterExpressionRef=E_Default_Init_Task_REMAININGACTIVATIONS
            GIP_Default_Init_Task_EVENTMASK: ArtiGenericComponentInstanceParameterClassParameterRef=GCP_OsTask_EVENTMASK, ArtiGenericComponentInstanceParameterExpressionRef=E_Default_Init_Task_EVENTMASK
            GIP_Default_Init_Task_EVENTSETFLAG: ArtiGenericComponentInstanceParameterClassParameterRef=GCP_OsTask_EVENTSETFLAG, ArtiGenericComponentInstanceParameterExpressionRef=E_Default_Init_Task_EVENTSETFLAG
            GIP_Default_Init_Task_LOCKED: ArtiGenericComponentInstanceParameterClassParameterRef=GCP_OsTask_LOCKED, ArtiGenericComponentInstanceParameterExpressionRef=E_Default_Init_Task_LOCKED
        GI_Default_Init_Task_Trusted: ArtiGenericComponentInstanceName=Default_Init_Task_Trusted
          7 x ArtiGenericComponentInstanceParameter:
            GIP_Default_Init_Task_Trusted_OSTASKTYPE: ArtiGenericComponentInstanceParameterClassParameterRef=GCP_OsTask_OSTASKTYPE, ArtiGenericComponentInstanceParameterExpressionRef=E_Default_Init_Task_Trusted_OSTASKTYPE
            GIP_Default_Init_Task_Trusted_OSTASKSCHEDULE: ArtiGenericComponentInstanceParameterClassParameterRef=GCP_OsTask_OSTASKSCHEDULE, ArtiGenericComponentInstanceParameterConstantRef=K_Default_Init_Task_Trusted_OSTASKSCHEDULE
            GIP_Default_Init_Task_Trusted_OSTASKMAXACTIVATION: ArtiGenericComponentInstanceParameterClassParameterRef=GCP_OsTask_OSTASKMAXACTIVATION, ArtiGenericComponentInstanceParameterExpressionRef=E_Default_Init_Task_Trusted_OSTASKMAXACTIVATION
            GIP_Default_Init_Task_Trusted_REMAININGACTIVATIONS: ArtiGenericComponentInstanceParameterClassParameterRef=GCP_OsTask_REMAININGACTIVATIONS, ArtiGenericComponentInstanceParameterExpressionRef=E_Default_Init_Task_Trusted_REMAININGACTIVATIONS
            GIP_Default_Init_Task_Trusted_EVENTMASK: ArtiGenericComponentInstanceParameterClassParameterRef=GCP_OsTask_EVENTMASK, ArtiGenericComponentInstanceParameterExpressionRef=E_Default_Init_Task_Trusted_EVENTMASK
            GIP_Default_Init_Task_Trusted_EVENTSETFLAG: ArtiGenericComponentInstanceParameterClassParameterRef=GCP_OsTask_EVENTSETFLAG, ArtiGenericComponentInstanceParameterExpressionRef=E_Default_Init_Task_Trusted_EVENTSETFLAG
            GIP_Default_Init_Task_Trusted_LOCKED: ArtiGenericComponentInstanceParameterClassParameterRef=GCP_OsTask_LOCKED, ArtiGenericComponentInstanceParameterExpressionRef=E_Default_Init_Task_Trusted_LOCKED
        GI_Idle_Task_Core1: ArtiGenericComponentInstanceName=Idle_Task_Core1
          7 x ArtiGenericComponentInstanceParameter:
            GIP_Idle_Task_Core1_OSTASKTYPE: ArtiGenericComponentInstanceParameterClassParameterRef=GCP_OsTask_OSTASKTYPE, ArtiGenericComponentInstanceParameterExpressionRef=E_Idle_Task_Core1_OSTASKTYPE
            GIP_Idle_Task_Core1_OSTASKSCHEDULE: ArtiGenericComponentInstanceParameterClassParameterRef=GCP_OsTask_OSTASKSCHEDULE, ArtiGenericComponentInstanceParameterConstantRef=K_Idle_Task_Core1_OSTASKSCHEDULE
            GIP_Idle_Task_Core1_OSTASKMAXACTIVATION: ArtiGenericComponentInstanceParameterClassParameterRef=GCP_OsTask_OSTASKMAXACTIVATION, ArtiGenericComponentInstanceParameterExpressionRef=E_Idle_Task_Core1_OSTASKMAXACTIVATION
            GIP_Idle_Task_Core1_REMAININGACTIVATIONS: ArtiGenericComponentInstanceParameterClassParameterRef=GCP_OsTask_REMAININGACTIVATIONS, ArtiGenericComponentInstanceParameterExpressionRef=E_Idle_Task_Core1_REMAININGACTIVATIONS
            GIP_Idle_Task_Core1_EVENTMASK: ArtiGenericComponentInstanceParameterClassParameterRef=GCP_OsTask_EVENTMASK, ArtiGenericComponentInstanceParameterExpressionRef=E_Idle_Task_Core1_EVENTMASK
            GIP_Idle_Task_Core1_EVENTSETFLAG: ArtiGenericComponentInstanceParameterClassParameterRef=GCP_OsTask_EVENTSETFLAG, ArtiGenericComponentInstanceParameterExpressionRef=E_Idle_Task_Core1_EVENTSETFLAG
            GIP_Idle_Task_Core1_LOCKED: ArtiGenericComponentInstanceParameterClassParameterRef=GCP_OsTask_LOCKED, ArtiGenericComponentInstanceParameterExpressionRef=E_Idle_Task_Core1_LOCKED
        GI_Default_BSW_Async_Task_Core0: ArtiGenericComponentInstanceName=Default_BSW_Async_Task_Core0
          7 x ArtiGenericComponentInstanceParameter:
            GIP_Default_BSW_Async_Task_Core0_OSTASKTYPE: ArtiGenericComponentInstanceParameterClassParameterRef=GCP_OsTask_OSTASKTYPE, ArtiGenericComponentInstanceParameterExpressionRef=E_Default_BSW_Async_Task_Core0_OSTASKTYPE
            GIP_Default_BSW_Async_Task_Core0_OSTASKSCHEDULE: ArtiGenericComponentInstanceParameterClassParameterRef=GCP_OsTask_OSTASKSCHEDULE, ArtiGenericComponentInstanceParameterConstantRef=K_Default_BSW_Async_Task_Core0_OSTASKSCHEDULE
            GIP_Default_BSW_Async_Task_Core0_OSTASKMAXACTIVATION: ArtiGenericComponentInstanceParameterClassParameterRef=GCP_OsTask_OSTASKMAXACTIVATION, ArtiGenericComponentInstanceParameterExpressionRef=E_Default_BSW_Async_Task_Core0_OSTASKMAXACTIVATION
            GIP_Default_BSW_Async_Task_Core0_REMAININGACTIVATIONS: ArtiGenericComponentInstanceParameterClassParameterRef=GCP_OsTask_REMAININGACTIVATIONS, ArtiGenericComponentInstanceParameterExpressionRef=E_Default_BSW_Async_Task_Core0_REMAININGACTIVATIONS
            GIP_Default_BSW_Async_Task_Core0_EVENTMASK: ArtiGenericComponentInstanceParameterClassParameterRef=GCP_OsTask_EVENTMASK, ArtiGenericComponentInstanceParameterExpressionRef=E_Default_BSW_Async_Task_Core0_EVENTMASK
            GIP_Default_BSW_Async_Task_Core0_EVENTSETFLAG: ArtiGenericComponentInstanceParameterClassParameterRef=GCP_OsTask_EVENTSETFLAG, ArtiGenericComponentInstanceParameterExpressionRef=E_Default_BSW_Async_Task_Core0_EVENTSETFLAG
            GIP_Default_BSW_Async_Task_Core0_LOCKED: ArtiGenericComponentInstanceParameterClassParameterRef=GCP_OsTask_LOCKED, ArtiGenericComponentInstanceParameterExpressionRef=E_Default_BSW_Async_Task_Core0_LOCKED
        GI_Default_BSW_Async_Task_Core1: ArtiGenericComponentInstanceName=Default_BSW_Async_Task_Core1
          7 x ArtiGenericComponentInstanceParameter:
            GIP_Default_BSW_Async_Task_Core1_OSTASKTYPE: ArtiGenericComponentInstanceParameterClassParameterRef=GCP_OsTask_OSTASKTYPE, ArtiGenericComponentInstanceParameterExpressionRef=E_Default_BSW_Async_Task_Core1_OSTASKTYPE
            GIP_Default_BSW_Async_Task_Core1_OSTASKSCHEDULE: ArtiGenericComponentInstanceParameterClassParameterRef=GCP_OsTask_OSTASKSCHEDULE, ArtiGenericComponentInstanceParameterConstantRef=K_Default_BSW_Async_Task_Core1_OSTASKSCHEDULE
            GIP_Default_BSW_Async_Task_Core1_OSTASKMAXACTIVATION: ArtiGenericComponentInstanceParameterClassParameterRef=GCP_OsTask_OSTASKMAXACTIVATION, ArtiGenericComponentInstanceParameterExpressionRef=E_Default_BSW_Async_Task_Core1_OSTASKMAXACTIVATION
            GIP_Default_BSW_Async_Task_Core1_REMAININGACTIVATIONS: ArtiGenericComponentInstanceParameterClassParameterRef=GCP_OsTask_REMAININGACTIVATIONS, ArtiGenericComponentInstanceParameterExpressionRef=E_Default_BSW_Async_Task_Core1_REMAININGACTIVATIONS
            GIP_Default_BSW_Async_Task_Core1_EVENTMASK: ArtiGenericComponentInstanceParameterClassParameterRef=GCP_OsTask_EVENTMASK, ArtiGenericComponentInstanceParameterExpressionRef=E_Default_BSW_Async_Task_Core1_EVENTMASK
            GIP_Default_BSW_Async_Task_Core1_EVENTSETFLAG: ArtiGenericComponentInstanceParameterClassParameterRef=GCP_OsTask_EVENTSETFLAG, ArtiGenericComponentInstanceParameterExpressionRef=E_Default_BSW_Async_Task_Core1_EVENTSETFLAG
            GIP_Default_BSW_Async_Task_Core1_LOCKED: ArtiGenericComponentInstanceParameterClassParameterRef=GCP_OsTask_LOCKED, ArtiGenericComponentInstanceParameterExpressionRef=E_Default_BSW_Async_Task_Core1_LOCKED
        GI_StartApplication_Appl_Task_Core0: ArtiGenericComponentInstanceName=StartApplication_Appl_Task_Core0
          7 x ArtiGenericComponentInstanceParameter:
            GIP_StartApplication_Appl_Task_Core0_OSTASKTYPE: ArtiGenericComponentInstanceParameterClassParameterRef=GCP_OsTask_OSTASKTYPE, ArtiGenericComponentInstanceParameterExpressionRef=E_StartApplication_Appl_Task_Core0_OSTASKTYPE
            GIP_StartApplication_Appl_Task_Core0_OSTASKSCHEDULE: ArtiGenericComponentInstanceParameterClassParameterRef=GCP_OsTask_OSTASKSCHEDULE, ArtiGenericComponentInstanceParameterConstantRef=K_StartApplication_Appl_Task_Core0_OSTASKSCHEDULE
            GIP_StartApplication_Appl_Task_Core0_OSTASKMAXACTIVATION: ArtiGenericComponentInstanceParameterClassParameterRef=GCP_OsTask_OSTASKMAXACTIVATION, ArtiGenericComponentInstanceParameterExpressionRef=E_StartApplication_Appl_Task_Core0_OSTASKMAXACTIVATION
            GIP_StartApplication_Appl_Task_Core0_REMAININGACTIVATIONS: ArtiGenericComponentInstanceParameterClassParameterRef=GCP_OsTask_REMAININGACTIVATIONS, ArtiGenericComponentInstanceParameterExpressionRef=E_StartApplication_Appl_Task_Core0_REMAININGACTIVATIONS
            GIP_StartApplication_Appl_Task_Core0_EVENTMASK: ArtiGenericComponentInstanceParameterClassParameterRef=GCP_OsTask_EVENTMASK, ArtiGenericComponentInstanceParameterExpressionRef=E_StartApplication_Appl_Task_Core0_EVENTMASK
            GIP_StartApplication_Appl_Task_Core0_EVENTSETFLAG: ArtiGenericComponentInstanceParameterClassParameterRef=GCP_OsTask_EVENTSETFLAG, ArtiGenericComponentInstanceParameterExpressionRef=E_StartApplication_Appl_Task_Core0_EVENTSETFLAG
            GIP_StartApplication_Appl_Task_Core0_LOCKED: ArtiGenericComponentInstanceParameterClassParameterRef=GCP_OsTask_LOCKED, ArtiGenericComponentInstanceParameterExpressionRef=E_StartApplication_Appl_Task_Core0_LOCKED
        GI_StartApplication_Appl_Task_Core1: ArtiGenericComponentInstanceName=StartApplication_Appl_Task_Core1
          7 x ArtiGenericComponentInstanceParameter:
            GIP_StartApplication_Appl_Task_Core1_OSTASKTYPE: ArtiGenericComponentInstanceParameterClassParameterRef=GCP_OsTask_OSTASKTYPE, ArtiGenericComponentInstanceParameterExpressionRef=E_StartApplication_Appl_Task_Core1_OSTASKTYPE
            GIP_StartApplication_Appl_Task_Core1_OSTASKSCHEDULE: ArtiGenericComponentInstanceParameterClassParameterRef=GCP_OsTask_OSTASKSCHEDULE, ArtiGenericComponentInstanceParameterConstantRef=K_StartApplication_Appl_Task_Core1_OSTASKSCHEDULE
            GIP_StartApplication_Appl_Task_Core1_OSTASKMAXACTIVATION: ArtiGenericComponentInstanceParameterClassParameterRef=GCP_OsTask_OSTASKMAXACTIVATION, ArtiGenericComponentInstanceParameterExpressionRef=E_StartApplication_Appl_Task_Core1_OSTASKMAXACTIVATION
            GIP_StartApplication_Appl_Task_Core1_REMAININGACTIVATIONS: ArtiGenericComponentInstanceParameterClassParameterRef=GCP_OsTask_REMAININGACTIVATIONS, ArtiGenericComponentInstanceParameterExpressionRef=E_StartApplication_Appl_Task_Core1_REMAININGACTIVATIONS
            GIP_StartApplication_Appl_Task_Core1_EVENTMASK: ArtiGenericComponentInstanceParameterClassParameterRef=GCP_OsTask_EVENTMASK, ArtiGenericComponentInstanceParameterExpressionRef=E_StartApplication_Appl_Task_Core1_EVENTMASK
            GIP_StartApplication_Appl_Task_Core1_EVENTSETFLAG: ArtiGenericComponentInstanceParameterClassParameterRef=GCP_OsTask_EVENTSETFLAG, ArtiGenericComponentInstanceParameterExpressionRef=E_StartApplication_Appl_Task_Core1_EVENTSETFLAG
            GIP_StartApplication_Appl_Task_Core1_LOCKED: ArtiGenericComponentInstanceParameterClassParameterRef=GCP_OsTask_LOCKED, ArtiGenericComponentInstanceParameterExpressionRef=E_StartApplication_Appl_Task_Core1_LOCKED
        GI_Default_Init_Task_Core1: ArtiGenericComponentInstanceName=Default_Init_Task_Core1
          7 x ArtiGenericComponentInstanceParameter:
            GIP_Default_Init_Task_Core1_OSTASKTYPE: ArtiGenericComponentInstanceParameterClassParameterRef=GCP_OsTask_OSTASKTYPE, ArtiGenericComponentInstanceParameterExpressionRef=E_Default_Init_Task_Core1_OSTASKTYPE
            GIP_Default_Init_Task_Core1_OSTASKSCHEDULE: ArtiGenericComponentInstanceParameterClassParameterRef=GCP_OsTask_OSTASKSCHEDULE, ArtiGenericComponentInstanceParameterConstantRef=K_Default_Init_Task_Core1_OSTASKSCHEDULE
            GIP_Default_Init_Task_Core1_OSTASKMAXACTIVATION: ArtiGenericComponentInstanceParameterClassParameterRef=GCP_OsTask_OSTASKMAXACTIVATION, ArtiGenericComponentInstanceParameterExpressionRef=E_Default_Init_Task_Core1_OSTASKMAXACTIVATION
            GIP_Default_Init_Task_Core1_REMAININGACTIVATIONS: ArtiGenericComponentInstanceParameterClassParameterRef=GCP_OsTask_REMAININGACTIVATIONS, ArtiGenericComponentInstanceParameterExpressionRef=E_Default_Init_Task_Core1_REMAININGACTIVATIONS
            GIP_Default_Init_Task_Core1_EVENTMASK: ArtiGenericComponentInstanceParameterClassParameterRef=GCP_OsTask_EVENTMASK, ArtiGenericComponentInstanceParameterExpressionRef=E_Default_Init_Task_Core1_EVENTMASK
            GIP_Default_Init_Task_Core1_EVENTSETFLAG: ArtiGenericComponentInstanceParameterClassParameterRef=GCP_OsTask_EVENTSETFLAG, ArtiGenericComponentInstanceParameterExpressionRef=E_Default_Init_Task_Core1_EVENTSETFLAG
            GIP_Default_Init_Task_Core1_LOCKED: ArtiGenericComponentInstanceParameterClassParameterRef=GCP_OsTask_LOCKED, ArtiGenericComponentInstanceParameterExpressionRef=E_Default_Init_Task_Core1_LOCKED
        GI_Default_Init_Task_Core1_Trusted: ArtiGenericComponentInstanceName=Default_Init_Task_Core1_Trusted
          7 x ArtiGenericComponentInstanceParameter:
            GIP_Default_Init_Task_Core1_Trusted_OSTASKTYPE: ArtiGenericComponentInstanceParameterClassParameterRef=GCP_OsTask_OSTASKTYPE, ArtiGenericComponentInstanceParameterExpressionRef=E_Default_Init_Task_Core1_Trusted_OSTASKTYPE
            GIP_Default_Init_Task_Core1_Trusted_OSTASKSCHEDULE: ArtiGenericComponentInstanceParameterClassParameterRef=GCP_OsTask_OSTASKSCHEDULE, ArtiGenericComponentInstanceParameterConstantRef=K_Default_Init_Task_Core1_Trusted_OSTASKSCHEDULE
            GIP_Default_Init_Task_Core1_Trusted_OSTASKMAXACTIVATION: ArtiGenericComponentInstanceParameterClassParameterRef=GCP_OsTask_OSTASKMAXACTIVATION, ArtiGenericComponentInstanceParameterExpressionRef=E_Default_Init_Task_Core1_Trusted_OSTASKMAXACTIVATION
            GIP_Default_Init_Task_Core1_Trusted_REMAININGACTIVATIONS: ArtiGenericComponentInstanceParameterClassParameterRef=GCP_OsTask_REMAININGACTIVATIONS, ArtiGenericComponentInstanceParameterExpressionRef=E_Default_Init_Task_Core1_Trusted_REMAININGACTIVATIONS
            GIP_Default_Init_Task_Core1_Trusted_EVENTMASK: ArtiGenericComponentInstanceParameterClassParameterRef=GCP_OsTask_EVENTMASK, ArtiGenericComponentInstanceParameterExpressionRef=E_Default_Init_Task_Core1_Trusted_EVENTMASK
            GIP_Default_Init_Task_Core1_Trusted_EVENTSETFLAG: ArtiGenericComponentInstanceParameterClassParameterRef=GCP_OsTask_EVENTSETFLAG, ArtiGenericComponentInstanceParameterExpressionRef=E_Default_Init_Task_Core1_Trusted_EVENTSETFLAG
            GIP_Default_Init_Task_Core1_Trusted_LOCKED: ArtiGenericComponentInstanceParameterClassParameterRef=GCP_OsTask_LOCKED, ArtiGenericComponentInstanceParameterExpressionRef=E_Default_Init_Task_Core1_Trusted_LOCKED
      GC_OsIsr (ArtiGenericComponentClass): ArtiGenericComponentClassName=OsIsr
        GCP_OsIsr_PRIORITY (ArtiGenericComponentClassParameter): ArtiGenericComponentClassParameterName=PRIORITY
        GCP_OsIsr_LOCKED (ArtiGenericComponentClassParameter): ArtiGenericComponentClassParameterName=LOCKED, ArtiGenericComponentClassParameterTypeMapRef=TM_LockedByTask
      7 x ArtiGenericComponentInstance, all with ArtiGenericComponentInstanceClassRef=GC_OsIsr:
        GI_CAN_00_RXFIFO_ISR: ArtiGenericComponentInstanceName=CAN_00_RXFIFO_ISR
          GIP_CAN_00_RXFIFO_ISR_PRIORITY (ArtiGenericComponentInstanceParameter):
            ArtiGenericComponentInstanceParameterClassParameterRef = GCP_OsIsr_PRIORITY
            ArtiGenericComponentInstanceParameterExpressionRef = E_CAN_00_RXFIFO_ISR_PRIORITY
          GIP_CAN_00_RXFIFO_ISR_LOCKED (ArtiGenericComponentInstanceParameter):
            ArtiGenericComponentInstanceParameterClassParameterRef = GCP_OsIsr_LOCKED
            ArtiGenericComponentInstanceParameterExpressionRef = E_CAN_00_RXFIFO_ISR_LOCKED
        GI_CAN_00_TX_ISR: ArtiGenericComponentInstanceName=CAN_00_TX_ISR
          GIP_CAN_00_TX_ISR_PRIORITY (ArtiGenericComponentInstanceParameter):
            ArtiGenericComponentInstanceParameterClassParameterRef = GCP_OsIsr_PRIORITY
            ArtiGenericComponentInstanceParameterExpressionRef = E_CAN_00_TX_ISR_PRIORITY
          GIP_CAN_00_TX_ISR_LOCKED (ArtiGenericComponentInstanceParameter):
            ArtiGenericComponentInstanceParameterClassParameterRef = GCP_OsIsr_LOCKED
            ArtiGenericComponentInstanceParameterExpressionRef = E_CAN_00_TX_ISR_LOCKED
        GI_CAN_00_RX_ISR: ArtiGenericComponentInstanceName=CAN_00_RX_ISR
          GIP_CAN_00_RX_ISR_PRIORITY (ArtiGenericComponentInstanceParameter):
            ArtiGenericComponentInstanceParameterClassParameterRef = GCP_OsIsr_PRIORITY
            ArtiGenericComponentInstanceParameterExpressionRef = E_CAN_00_RX_ISR_PRIORITY
          GIP_CAN_00_RX_ISR_LOCKED (ArtiGenericComponentInstanceParameter):
            ArtiGenericComponentInstanceParameterClassParameterRef = GCP_OsIsr_LOCKED
            ArtiGenericComponentInstanceParameterExpressionRef = E_CAN_00_RX_ISR_LOCKED
        GI_CounterIsr_SystemTimer_core0: ArtiGenericComponentInstanceName=CounterIsr_SystemTimer_core0
          GIP_CounterIsr_SystemTimer_core0_PRIORITY (ArtiGenericComponentInstanceParameter):
            ArtiGenericComponentInstanceParameterClassParameterRef = GCP_OsIsr_PRIORITY
            ArtiGenericComponentInstanceParameterExpressionRef = E_CounterIsr_SystemTimer_core0_PRIORITY
          GIP_CounterIsr_SystemTimer_core0_LOCKED (ArtiGenericComponentInstanceParameter):
            ArtiGenericComponentInstanceParameterClassParameterRef = GCP_OsIsr_LOCKED
            ArtiGenericComponentInstanceParameterExpressionRef = E_CounterIsr_SystemTimer_core0_LOCKED
        GI_CounterIsr_SystemTimer_core1: ArtiGenericComponentInstanceName=CounterIsr_SystemTimer_core1
          GIP_CounterIsr_SystemTimer_core1_PRIORITY (ArtiGenericComponentInstanceParameter):
            ArtiGenericComponentInstanceParameterClassParameterRef = GCP_OsIsr_PRIORITY
            ArtiGenericComponentInstanceParameterExpressionRef = E_CounterIsr_SystemTimer_core1_PRIORITY
          GIP_CounterIsr_SystemTimer_core1_LOCKED (ArtiGenericComponentInstanceParameter):
            ArtiGenericComponentInstanceParameterClassParameterRef = GCP_OsIsr_LOCKED
            ArtiGenericComponentInstanceParameterExpressionRef = E_CounterIsr_SystemTimer_core1_LOCKED
        GI_XSignalIsr_OsCore1: ArtiGenericComponentInstanceName=XSignalIsr_OsCore1
          GIP_XSignalIsr_OsCore1_PRIORITY (ArtiGenericComponentInstanceParameter):
            ArtiGenericComponentInstanceParameterClassParameterRef = GCP_OsIsr_PRIORITY
            ArtiGenericComponentInstanceParameterExpressionRef = E_XSignalIsr_OsCore1_PRIORITY
          GIP_XSignalIsr_OsCore1_LOCKED (ArtiGenericComponentInstanceParameter):
            ArtiGenericComponentInstanceParameterClassParameterRef = GCP_OsIsr_LOCKED
            ArtiGenericComponentInstanceParameterExpressionRef = E_XSignalIsr_OsCore1_LOCKED
        GI_XSignalIsr_OsCore0: ArtiGenericComponentInstanceName=XSignalIsr_OsCore0
          GIP_XSignalIsr_OsCore0_PRIORITY (ArtiGenericComponentInstanceParameter):
            ArtiGenericComponentInstanceParameterClassParameterRef = GCP_OsIsr_PRIORITY
            ArtiGenericComponentInstanceParameterExpressionRef = E_XSignalIsr_OsCore0_PRIORITY
          GIP_XSignalIsr_OsCore0_LOCKED (ArtiGenericComponentInstanceParameter):
            ArtiGenericComponentInstanceParameterClassParameterRef = GCP_OsIsr_LOCKED
            ArtiGenericComponentInstanceParameterExpressionRef = E_XSignalIsr_OsCore0_LOCKED
      GC_OsConfig (ArtiGenericComponentClass): ArtiGenericComponentClassName=OsConfig
        3 x ArtiGenericComponentClassParameter:
          GCP_OsConfig_ScalabilityClass: ArtiGenericComponentClassParameterName=ScalabilityClass
          GCP_OsConfig_StatusLevel: ArtiGenericComponentClassParameterName=StatusLevel
          GCP_OsConfig_OsStackMonitoring: ArtiGenericComponentClassParameterName=OsStackMonitoring
      GI_OsConfig (ArtiGenericComponentInstance): ArtiGenericComponentInstanceName=OsConfig, ArtiGenericComponentInstanceClassRef=GC_OsConfig
        3 x ArtiGenericComponentInstanceParameter:
          GIP_OsConfig_ScalabilityClass: ArtiGenericComponentInstanceParameterClassParameterRef=GCP_OsConfig_ScalabilityClass, ArtiGenericComponentInstanceParameterConstantRef=K_OsConfig_ScalabilityClass
          GIP_OsConfig_StatusLevel: ArtiGenericComponentInstanceParameterClassParameterRef=GCP_OsConfig_StatusLevel, ArtiGenericComponentInstanceParameterConstantRef=K_OsConfig_StatusLevel
          GIP_OsConfig_OsStackMonitoring: ArtiGenericComponentInstanceParameterClassParameterRef=GCP_OsConfig_OsStackMonitoring, ArtiGenericComponentInstanceParameterConstantRef=K_OsConfig_OsStackMonitoring
      GC_OsAlarm (ArtiGenericComponentClass): ArtiGenericComponentClassName=OsAlarm
        GCP_OsAlarm_ACTION (ArtiGenericComponentClassParameter): ArtiGenericComponentClassParameterName=ACTION, ArtiGenericComponentClassParameterTypeMapRef=TM_AlarmAction
        GCP_OsAlarm_ALARMTIME (ArtiGenericComponentClassParameter): ArtiGenericComponentClassParameterName=ALARMTIME
      7 x ArtiGenericComponentInstance, all with ArtiGenericComponentInstanceClassRef=GC_OsAlarm:
        GI_Rte_Al_TE_StartApplication_StartApplication_Cyclic1000ms: ArtiGenericComponentInstanceName=Rte_Al_TE_StartApplication_StartApplication_Cyclic1000ms
          GIP_Rte_Al_TE_StartApplication_StartApplication_Cyclic1000ms_ACTION (ArtiGenericComponentInstanceParameter):
            ArtiGenericComponentInstanceParameterClassParameterRef = GCP_OsAlarm_ACTION
            ArtiGenericComponentInstanceParameterExpressionRef = E_Rte_Al_TE_StartApplication_StartApplication_Cyclic1000ms_ACTION
          GIP_Rte_Al_TE_StartApplication_StartApplication_Cyclic1000ms_ALARMTIME (ArtiGenericComponentInstanceParameter):
            ArtiGenericComponentInstanceParameterClassParameterRef = GCP_OsAlarm_ALARMTIME
            ArtiGenericComponentInstanceParameterConstantRef = K_Rte_Al_TE_StartApplication_StartApplication_Cyclic1000ms_ALARMTIME
        GI_Rte_Al_TE_StartApplication_StartApplication_Cyclic10ms: ArtiGenericComponentInstanceName=Rte_Al_TE_StartApplication_StartApplication_Cyclic10ms
          GIP_Rte_Al_TE_StartApplication_StartApplication_Cyclic10ms_ACTION (ArtiGenericComponentInstanceParameter):
            ArtiGenericComponentInstanceParameterClassParameterRef = GCP_OsAlarm_ACTION
            ArtiGenericComponentInstanceParameterExpressionRef = E_Rte_Al_TE_StartApplication_StartApplication_Cyclic10ms_ACTION
          GIP_Rte_Al_TE_StartApplication_StartApplication_Cyclic10ms_ALARMTIME (ArtiGenericComponentInstanceParameter):
            ArtiGenericComponentInstanceParameterClassParameterRef = GCP_OsAlarm_ALARMTIME
            ArtiGenericComponentInstanceParameterConstantRef = K_Rte_Al_TE_StartApplication_StartApplication_Cyclic10ms_ALARMTIME
        GI_Rte_Al_TE_StartApplication_StartApplication_Cyclic1ms: ArtiGenericComponentInstanceName=Rte_Al_TE_StartApplication_StartApplication_Cyclic1ms
          GIP_Rte_Al_TE_StartApplication_StartApplication_Cyclic1ms_ACTION (ArtiGenericComponentInstanceParameter):
            ArtiGenericComponentInstanceParameterClassParameterRef = GCP_OsAlarm_ACTION
            ArtiGenericComponentInstanceParameterExpressionRef = E_Rte_Al_TE_StartApplication_StartApplication_Cyclic1ms_ACTION
          GIP_Rte_Al_TE_StartApplication_StartApplication_Cyclic1ms_ALARMTIME (ArtiGenericComponentInstanceParameter):
            ArtiGenericComponentInstanceParameterClassParameterRef = GCP_OsAlarm_ALARMTIME
            ArtiGenericComponentInstanceParameterConstantRef = K_Rte_Al_TE_StartApplication_StartApplication_Cyclic1ms_ALARMTIME
        GI_Rte_Al_TE_StartApplication_StartApplication_Cyclic250ms: ArtiGenericComponentInstanceName=Rte_Al_TE_StartApplication_StartApplication_Cyclic250ms
          GIP_Rte_Al_TE_StartApplication_StartApplication_Cyclic250ms_ACTION (ArtiGenericComponentInstanceParameter):
            ArtiGenericComponentInstanceParameterClassParameterRef = GCP_OsAlarm_ACTION
            ArtiGenericComponentInstanceParameterExpressionRef = E_Rte_Al_TE_StartApplication_StartApplication_Cyclic250ms_ACTION
          GIP_Rte_Al_TE_StartApplication_StartApplication_Cyclic250ms_ALARMTIME (ArtiGenericComponentInstanceParameter):
            ArtiGenericComponentInstanceParameterClassParameterRef = GCP_OsAlarm_ALARMTIME
            ArtiGenericComponentInstanceParameterConstantRef = K_Rte_Al_TE_StartApplication_StartApplication_Cyclic250ms_ALARMTIME
        GI_Rte_Al_TE2_Default_BSW_Async_Task_Core0_0_10ms: ArtiGenericComponentInstanceName=Rte_Al_TE2_Default_BSW_Async_Task_Core0_0_10ms
          GIP_Rte_Al_TE2_Default_BSW_Async_Task_Core0_0_10ms_ACTION (ArtiGenericComponentInstanceParameter):
            ArtiGenericComponentInstanceParameterClassParameterRef = GCP_OsAlarm_ACTION
            ArtiGenericComponentInstanceParameterExpressionRef = E_Rte_Al_TE2_Default_BSW_Async_Task_Core0_0_10ms_ACTION
          GIP_Rte_Al_TE2_Default_BSW_Async_Task_Core0_0_10ms_ALARMTIME (ArtiGenericComponentInstanceParameter):
            ArtiGenericComponentInstanceParameterClassParameterRef = GCP_OsAlarm_ALARMTIME
            ArtiGenericComponentInstanceParameterConstantRef = K_Rte_Al_TE2_Default_BSW_Async_Task_Core0_0_10ms_ALARMTIME
        GI_Rte_Al_TE2_EcuM_EcuM_MainFunction: ArtiGenericComponentInstanceName=Rte_Al_TE2_EcuM_EcuM_MainFunction
          GIP_Rte_Al_TE2_EcuM_EcuM_MainFunction_ACTION (ArtiGenericComponentInstanceParameter):
            ArtiGenericComponentInstanceParameterClassParameterRef = GCP_OsAlarm_ACTION
            ArtiGenericComponentInstanceParameterExpressionRef = E_Rte_Al_TE2_EcuM_EcuM_MainFunction_ACTION
          GIP_Rte_Al_TE2_EcuM_EcuM_MainFunction_ALARMTIME (ArtiGenericComponentInstanceParameter):
            ArtiGenericComponentInstanceParameterClassParameterRef = GCP_OsAlarm_ALARMTIME
            ArtiGenericComponentInstanceParameterConstantRef = K_Rte_Al_TE2_EcuM_EcuM_MainFunction_ALARMTIME
        GI_Rte_Al_TE_StartApplication_Appl_Task_Core0_0_100ms: ArtiGenericComponentInstanceName=Rte_Al_TE_StartApplication_Appl_Task_Core0_0_100ms
          GIP_Rte_Al_TE_StartApplication_Appl_Task_Core0_0_100ms_ACTION (ArtiGenericComponentInstanceParameter):
            ArtiGenericComponentInstanceParameterClassParameterRef = GCP_OsAlarm_ACTION
            ArtiGenericComponentInstanceParameterExpressionRef = E_Rte_Al_TE_StartApplication_Appl_Task_Core0_0_100ms_ACTION
          GIP_Rte_Al_TE_StartApplication_Appl_Task_Core0_0_100ms_ALARMTIME (ArtiGenericComponentInstanceParameter):
            ArtiGenericComponentInstanceParameterClassParameterRef = GCP_OsAlarm_ALARMTIME
            ArtiGenericComponentInstanceParameterConstantRef = K_Rte_Al_TE_StartApplication_Appl_Task_Core0_0_100ms_ALARMTIME
      GC_OsResource (ArtiGenericComponentClass): ArtiGenericComponentClassName=OsResource
        4 x ArtiGenericComponentClassParameter:
          GCP_OsResource_LOCKED: ArtiGenericComponentClassParameterName=LOCKED, ArtiGenericComponentClassParameterTypeMapRef=TM_LockedByResource
          GCP_OsResource_RESOURCE_OWNER: ArtiGenericComponentClassParameterName=RESOURCE_OWNER, ArtiGenericComponentClassParameterTypeMapRef=TM_ObjectOwner
          GCP_OsResource_PRIORITY_TYPE: ArtiGenericComponentClassParameterName=PRIORITY_TYPE
          GCP_OsResource_PRIORITY: ArtiGenericComponentClassParameterName=PRIORITY
      GI_OsResource (ArtiGenericComponentInstance): ArtiGenericComponentInstanceName=OsResource, ArtiGenericComponentInstanceClassRef=GC_OsResource
        4 x ArtiGenericComponentInstanceParameter:
          GIP_OsResource_LOCKED: ArtiGenericComponentInstanceParameterClassParameterRef=GCP_OsResource_LOCKED, ArtiGenericComponentInstanceParameterExpressionRef=E_OsResource_LOCKED
          GIP_OsResource_RESOURCE_OWNER: ArtiGenericComponentInstanceParameterClassParameterRef=GCP_OsResource_RESOURCE_OWNER, ArtiGenericComponentInstanceParameterExpressionRef=E_OsResource_RESOURCE_OWNER
          GIP_OsResource_PRIORITY_TYPE: ArtiGenericComponentInstanceParameterClassParameterRef=GCP_OsResource_PRIORITY_TYPE, ArtiGenericComponentInstanceParameterExpressionRef=E_OsResource_PRIORITY_TYPE
          GIP_OsResource_PRIORITY: ArtiGenericComponentInstanceParameterClassParameterRef=GCP_OsResource_PRIORITY, ArtiGenericComponentInstanceParameterExpressionRef=E_OsResource_PRIORITY
