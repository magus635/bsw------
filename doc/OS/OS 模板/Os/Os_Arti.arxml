<?xml version="1.0" encoding="UTF-8"?>
<!--
  FileName      : Os_Arti.arxml
  BSW Module    : Os
  brief         : ARTI debug description (ECUC values of /AUTOSAR/EcucDefs/Arti), generated
                  from the Os configuration: static debugging (ArtiExpression) and the ArtiHook
                  description of the kernel trace events (openspec add-arti-hook-tracing). The hook
                  list comes from Os_ArtiEvents.m, shared with Os_ArtiHooks.h and Os_Arti_Mock.h.
  Spec          : AUTOSAR CP SWS ARTI R24-11 ch.10, SWS OS R21-11 10.4, EXP ARTI 2.4
  Source        : kernel symbols and ID rules follow the ORTI template (Os_Trace.orti)

  ASSUMPTIONS (to be verified against the real THA6 Os definition, Os_Cfg.h and kernel;
  see openspec/changes/add-os-arti-description-template/design.md, Open Questions):
  A1  Os_OrtiRunningData[] is indexed by the logical core id (kernel: Os_Inf_GetCoreId() =
      CoreIDListPtr[physical id]), taken as EcucCoreId of the core OsCoreId refers to; falls back to
      OsPhysicalCoreId when OsCoreId is not set. CoreIDListPtr's content is not yet verified.
  A2  TaskType = OsTask/@index, ISRType = OsIsr/@index (same rule as ORTI RUNNINGTASK/RUNNINGISR2);
      the invalid IDs are NO_TASK = count(OsTask/*) and NO_ISR = count(OsIsr/*) (kernel INVALID_TASK /
      INVALID_ISR). Verified against the Os_THA6_ASR21 plugin (Os_task_Cfg.h, Os_isr_Cfg.h).
  A3  Current OS-Application = Os_AppRunningTimeData_Core<N>.Current_ApplicationID (kernel Os_kernel_Lcfg.c,
      type Os_ApplicationRunningTimeDataType, N as in A1); ApplicationType = OsApplication/@index and the invalid
      value is count(OsApplication/*) (plugin Os_application_Cfg.h). OutputRef cannot target OsApplication in
      the Arti definition, so TM_ApplicationId maps to the application name as a string.
  A4  Os values live under /Os/Os, the Arti values written here under /Arti/Arti.
  A5  Task state encoding RUNNING=0, READY=1, WAITING=2, SUSPENDED=3 (ORTI TASK.STATE).
-->
[!/* Template portability: only constructs also used by the ORTI template, so that EB tresos and
     the configurator's EB engine render the same output. */!][!//
[!/* Os_AppCommon.m (Os plugin, next to the ORTI template) numbers the Os objects; ORTI and ARTI share it */!][!//
[!/* The .m sets ObjectID to 0. If it was not found the include is silent in the configurator, and the
     object numbers would silently omit the hook / IOC callback objects: then the owner type map is left out
     (the owner is shown as a plain number) instead of being wrong. */!][!//
[!VAR "ObjectID" = "'unset'"!][!//
[!INCLUDE "Os_AppCommon.m"!][!//
[!VAR "OwnerTypeMap" = "''"!][!IF "$ObjectID != 'unset'"!][!VAR "OwnerTypeMap" = "'ObjectOwner'"!][!ENDIF!][!//
[!/* Os_ArtiEvents.m sets ArtiEventsLoaded. Without it the include is silent in the configurator: then no
     hook is described (instead of a description that does not match the kernel) and a comment says why. */!][!//
[!VAR "ArtiEventsLoaded" = "'false'"!][!//
[!INCLUDE "Os_ArtiEvents.m"!][!//
[!VAR "OsValuePkg" = "'/Os/Os'"!][!//
[!VAR "ArtiPkg" = "'/Arti/Arti'"!][!//
[!VAR "Def" = "'/AUTOSAR/EcucDefs/Arti'"!][!//
[!//
[!/* ======================================================================================
     Macros: one ECUC container value per call
     ====================================================================================== */!][!//
[!MACRO "ArtiRef", "RefDef" = "", "Target" = ""!][!//
                <ECUC-REFERENCE-VALUE>
                  <DEFINITION-REF DEST="ECUC-REFERENCE-DEF">[!"$Def"!]/[!"$RefDef"!]</DEFINITION-REF>
                  <VALUE-REF DEST="ECUC-CONTAINER-VALUE">[!"$Target"!]</VALUE-REF>
                </ECUC-REFERENCE-VALUE>
[!ENDMACRO!][!//
[!/* AddressOf = 'true' prefixes the expression with "&". The "&amp;" must stay in template text:
     inside an expression literal the configurator's engine decodes it to "&" while EB keeps "&amp;". */!][!//
[!MACRO "ArtiExprIP", "Name" = "", "Str" = "", "AddressOf" = "'false'"!][!//
            <ECUC-CONTAINER-VALUE>
              <SHORT-NAME>E_[!"$Name"!]</SHORT-NAME>
              <DEFINITION-REF DEST="ECUC-PARAM-CONF-CONTAINER-DEF">[!"$Def"!]/ArtiValues/ArtiExpression</DEFINITION-REF>
              <PARAMETER-VALUES>
                <ECUC-TEXTUAL-PARAM-VALUE>
                  <DEFINITION-REF DEST="ECUC-STRING-PARAM-DEF">[!"$Def"!]/ArtiValues/ArtiExpression/ArtiExpressionString</DEFINITION-REF>
                  <VALUE>[!IF "$AddressOf = 'true'"!]&amp;[!ENDIF!][!"$Str"!]</VALUE>
                </ECUC-TEXTUAL-PARAM-VALUE>
              </PARAMETER-VALUES>
            </ECUC-CONTAINER-VALUE>
            <ECUC-CONTAINER-VALUE>
              <SHORT-NAME>IP_[!"$Name"!]</SHORT-NAME>
              <DEFINITION-REF DEST="ECUC-PARAM-CONF-CONTAINER-DEF">[!"$Def"!]/ArtiValues/ArtiObjectInstanceParameter</DEFINITION-REF>
              <REFERENCE-VALUES>
[!CALL "ArtiRef", "RefDef" = "'ArtiValues/ArtiObjectInstanceParameter/ArtiObjectInstanceParameterExpressionRef'", "Target" = "concat($ArtiPkg, '/ArtiValues/E_', $Name)"!][!//
              </REFERENCE-VALUES>
            </ECUC-CONTAINER-VALUE>
[!ENDMACRO!][!//
[!MACRO "ArtiConst", "Name" = "", "Str" = ""!][!//
            <ECUC-CONTAINER-VALUE>
              <SHORT-NAME>K_[!"$Name"!]</SHORT-NAME>
              <DEFINITION-REF DEST="ECUC-PARAM-CONF-CONTAINER-DEF">[!"$Def"!]/ArtiValues/ArtiConstant</DEFINITION-REF>
              <PARAMETER-VALUES>
                <ECUC-TEXTUAL-PARAM-VALUE>
                  <DEFINITION-REF DEST="ECUC-STRING-PARAM-DEF">[!"$Def"!]/ArtiValues/ArtiConstant/ArtiConstantString</DEFINITION-REF>
                  <VALUE>[!"$Str"!]</VALUE>
                </ECUC-TEXTUAL-PARAM-VALUE>
              </PARAMETER-VALUES>
            </ECUC-CONTAINER-VALUE>
[!ENDMACRO!][!//
[!MACRO "ArtiConstIP", "Name" = "", "Str" = ""!][!//
[!CALL "ArtiConst", "Name" = "$Name", "Str" = "$Str"!][!//
            <ECUC-CONTAINER-VALUE>
              <SHORT-NAME>IP_[!"$Name"!]</SHORT-NAME>
              <DEFINITION-REF DEST="ECUC-PARAM-CONF-CONTAINER-DEF">[!"$Def"!]/ArtiValues/ArtiObjectInstanceParameter</DEFINITION-REF>
              <REFERENCE-VALUES>
[!CALL "ArtiRef", "RefDef" = "'ArtiValues/ArtiObjectInstanceParameter/ArtiObjectInstanceParameterConstantRef'", "Target" = "concat($ArtiPkg, '/ArtiValues/K_', $Name)"!][!//
              </REFERENCE-VALUES>
            </ECUC-CONTAINER-VALUE>
[!ENDMACRO!][!//
[!MACRO "ArtiCP", "Name" = "", "TypeMap" = ""!][!//
            <ECUC-CONTAINER-VALUE>
              <SHORT-NAME>CP_[!"$Name"!]</SHORT-NAME>
              <DEFINITION-REF DEST="ECUC-PARAM-CONF-CONTAINER-DEF">[!"$Def"!]/ArtiValues/ArtiObjectClassParameter</DEFINITION-REF>
[!IF "$TypeMap != ''"!][!//
              <REFERENCE-VALUES>
[!CALL "ArtiRef", "RefDef" = "'ArtiValues/ArtiObjectClassParameter/ArtiObjectClassParameterTypeMapRef'", "Target" = "concat($ArtiPkg, '/ArtiValues/TM_', $TypeMap)"!][!//
              </REFERENCE-VALUES>
[!ENDIF!][!//
            </ECUC-CONTAINER-VALUE>
[!ENDMACRO!][!//
[!/* TypeMap pair. Exactly one of Out / OutRef is used; In is a number, or InExpr names an E_ expression. */!][!//
[!MACRO "ArtiPair", "Name" = "", "In" = "", "InExpr" = "", "Out" = "", "OutRef" = ""!][!//
                <ECUC-CONTAINER-VALUE>
                  <SHORT-NAME>[!"$Name"!]</SHORT-NAME>
                  <DEFINITION-REF DEST="ECUC-PARAM-CONF-CONTAINER-DEF">[!"$Def"!]/ArtiValues/ArtiParameterTypeMap/ArtiParameterTypeMapPair</DEFINITION-REF>
[!IF "$In != '' or $Out != ''"!][!//
                  <PARAMETER-VALUES>
[!IF "$In != ''"!][!//
                    <ECUC-NUMERICAL-PARAM-VALUE>
                      <DEFINITION-REF DEST="ECUC-INTEGER-PARAM-DEF">[!"$Def"!]/ArtiValues/ArtiParameterTypeMap/ArtiParameterTypeMapPair/ArtiParameterTypeMapPairInput</DEFINITION-REF>
                      <VALUE>[!"$In"!]</VALUE>
                    </ECUC-NUMERICAL-PARAM-VALUE>
[!ENDIF!][!//
[!IF "$Out != ''"!][!//
                    <ECUC-TEXTUAL-PARAM-VALUE>
                      <DEFINITION-REF DEST="ECUC-STRING-PARAM-DEF">[!"$Def"!]/ArtiValues/ArtiParameterTypeMap/ArtiParameterTypeMapPair/ArtiParameterTypeMapPairOutput</DEFINITION-REF>
                      <VALUE>[!"$Out"!]</VALUE>
                    </ECUC-TEXTUAL-PARAM-VALUE>
[!ENDIF!][!//
                  </PARAMETER-VALUES>
[!ENDIF!][!//
[!IF "$InExpr != '' or $OutRef != ''"!][!//
                  <REFERENCE-VALUES>
[!IF "$InExpr != ''"!][!//
                    <ECUC-REFERENCE-VALUE>
                      <DEFINITION-REF DEST="ECUC-REFERENCE-DEF">[!"$Def"!]/ArtiValues/ArtiParameterTypeMap/ArtiParameterTypeMapPair/ArtiParameterTypeMapPairInputExpressionRef</DEFINITION-REF>
                      <VALUE-REF DEST="ECUC-CONTAINER-VALUE">[!"$ArtiPkg"!]/ArtiValues/E_[!"$InExpr"!]</VALUE-REF>
                    </ECUC-REFERENCE-VALUE>
[!ENDIF!][!//
[!IF "$OutRef != ''"!][!//
                    <ECUC-REFERENCE-VALUE>
                      <DEFINITION-REF DEST="ECUC-CHOICE-REFERENCE-DEF">[!"$Def"!]/ArtiValues/ArtiParameterTypeMap/ArtiParameterTypeMapPair/ArtiParameterTypeMapPairOutputRef</DEFINITION-REF>
                      <VALUE-REF DEST="ECUC-CONTAINER-VALUE">[!"$OutRef"!]</VALUE-REF>
                    </ECUC-REFERENCE-VALUE>
[!ENDIF!][!//
                  </REFERENCE-VALUES>
[!ENDIF!][!//
                </ECUC-CONTAINER-VALUE>
[!ENDMACRO!][!//
[!MACRO "ArtiTypeMapOpen", "Name" = ""!][!//
            <ECUC-CONTAINER-VALUE>
              <SHORT-NAME>TM_[!"$Name"!]</SHORT-NAME>
              <DEFINITION-REF DEST="ECUC-PARAM-CONF-CONTAINER-DEF">[!"$Def"!]/ArtiValues/ArtiParameterTypeMap</DEFINITION-REF>
              <SUB-CONTAINERS>
[!ENDMACRO!][!//
[!MACRO "ArtiTypeMapClose"!][!//
              </SUB-CONTAINERS>
            </ECUC-CONTAINER-VALUE>
[!ENDMACRO!][!//
[!MACRO "ArtiTaskState", "Name" = "", "Literal" = ""!][!//
                <ECUC-CONTAINER-VALUE>
                  <SHORT-NAME>S_[!"$Name"!]</SHORT-NAME>
                  <DEFINITION-REF DEST="ECUC-PARAM-CONF-CONTAINER-DEF">[!"$Def"!]/ArtiValues/ArtiStates/ArtiStatesTaskState</DEFINITION-REF>
                  <PARAMETER-VALUES>
                    <ECUC-TEXTUAL-PARAM-VALUE>
                      <DEFINITION-REF DEST="ECUC-ENUMERATION-PARAM-DEF">[!"$Def"!]/ArtiValues/ArtiStates/ArtiStatesTaskState/ArtiStatesTaskStateEnum</DEFINITION-REF>
                      <VALUE>[!"$Literal"!]</VALUE>
                    </ECUC-TEXTUAL-PARAM-VALUE>
                  </PARAMETER-VALUES>
                </ECUC-CONTAINER-VALUE>
[!ENDMACRO!][!//
[!/* Kind = ScheduleTable or Spinlock: ArtiStates<Kind>State with ArtiStates<Kind>StateEnum */!][!//
[!MACRO "ArtiStateOf", "Kind" = "", "Name" = "", "Literal" = ""!][!//
                <ECUC-CONTAINER-VALUE>
                  <SHORT-NAME>S_[!"$Name"!]</SHORT-NAME>
                  <DEFINITION-REF DEST="ECUC-PARAM-CONF-CONTAINER-DEF">[!"$Def"!]/ArtiValues/ArtiStates/ArtiStates[!"$Kind"!]State</DEFINITION-REF>
                  <PARAMETER-VALUES>
                    <ECUC-TEXTUAL-PARAM-VALUE>
                      <DEFINITION-REF DEST="ECUC-ENUMERATION-PARAM-DEF">[!"$Def"!]/ArtiValues/ArtiStates/ArtiStates[!"$Kind"!]State/ArtiStates[!"$Kind"!]StateEnum</DEFINITION-REF>
                      <VALUE>[!"$Literal"!]</VALUE>
                    </ECUC-TEXTUAL-PARAM-VALUE>
                  </PARAMETER-VALUES>
                </ECUC-CONTAINER-VALUE>
[!ENDMACRO!][!//
[!/* Empty Class container (no class parameters needed) */!][!//
[!MACRO "ArtiEmptyClass", "Kind" = ""!][!//
            <ECUC-CONTAINER-VALUE>
              <SHORT-NAME>[!"$Kind"!]</SHORT-NAME>
              <DEFINITION-REF DEST="ECUC-PARAM-CONF-CONTAINER-DEF">[!"$Def"!]/ArtiOs/[!"$Kind"!]</DEFINITION-REF>
            </ECUC-CONTAINER-VALUE>
[!ENDMACRO!][!//
[!MACRO "ArtiStack", "Name" = "", "Size" = ""!][!//
            <ECUC-CONTAINER-VALUE>
              <SHORT-NAME>[!"$Name"!]_stack</SHORT-NAME>
              <DEFINITION-REF DEST="ECUC-PARAM-CONF-CONTAINER-DEF">[!"$Def"!]/ArtiOs/ArtiOsStackInstance</DEFINITION-REF>
              <PARAMETER-VALUES>
                <ECUC-TEXTUAL-PARAM-VALUE>
                  <DEFINITION-REF DEST="ECUC-STRING-PARAM-DEF">[!"$Def"!]/ArtiOs/ArtiOsStackInstance/ArtiOsStackInstanceDirection</DEFINITION-REF>
                  <VALUE>DOWN</VALUE>
                </ECUC-TEXTUAL-PARAM-VALUE>
              </PARAMETER-VALUES>
              <REFERENCE-VALUES>
[!CALL "ArtiRef", "RefDef" = "'ArtiOs/ArtiOsStackInstance/ArtiOsStackInstanceBaseAddressRef'", "Target" = "concat($ArtiPkg, '/ArtiValues/IP_', $Name, '_StackBase')"!][!//
[!CALL "ArtiRef", "RefDef" = "'ArtiOs/ArtiOsStackInstance/ArtiOsStackInstanceFillPatternRef'", "Target" = "concat($ArtiPkg, '/ArtiValues/IP_StackFillPattern')"!][!//
[!CALL "ArtiRef", "RefDef" = "'ArtiOs/ArtiOsStackInstance/ArtiOsStackInstanceSizeRef'", "Target" = "concat($ArtiPkg, '/ArtiValues/IP_', $Name, '_StackSize')"!][!//
              </REFERENCE-VALUES>
            </ECUC-CONTAINER-VALUE>
[!ENDMACRO!][!//
[!MACRO "ArtiContext", "Name" = ""!][!//
            <ECUC-CONTAINER-VALUE>
              <SHORT-NAME>[!"$Name"!]_ContextInfo</SHORT-NAME>
              <DEFINITION-REF DEST="ECUC-PARAM-CONF-CONTAINER-DEF">[!"$Def"!]/ArtiOs/ArtiOsContextInstance</DEFINITION-REF>
              <REFERENCE-VALUES>
[!CALL "ArtiRef", "RefDef" = "'ArtiOs/ArtiOsContextInstance/ArtiOsContextInstanceAddressRef'", "Target" = "concat($ArtiPkg, '/ArtiValues/IP_', $Name, '_Context')"!][!//
              </REFERENCE-VALUES>
            </ECUC-CONTAINER-VALUE>
[!ENDMACRO!][!//
[!/* One ArtiHook per (context, class, event) of Os_ArtiEvents.m. The four strings are the literal tokens
     the kernel passes to ARTI_TRACE; the instance parameter is the OS core index (TM_ArtiCoreIndex), the
     event parameter is decoded by TM_<TypeMap> unless TypeMap is '-'. */!][!//
[!MACRO "ArtiHook", "Ctx" = "", "Class" = "", "Event" = "", "TypeMap" = ""!][!//
            <ECUC-CONTAINER-VALUE>
              <SHORT-NAME>H_[!"$Event"!]</SHORT-NAME>
              <DEFINITION-REF DEST="ECUC-PARAM-CONF-CONTAINER-DEF">[!"$Def"!]/ArtiValues/ArtiHook</DEFINITION-REF>
              <PARAMETER-VALUES>
                <ECUC-TEXTUAL-PARAM-VALUE>
                  <DEFINITION-REF DEST="ECUC-STRING-PARAM-DEF">[!"$Def"!]/ArtiValues/ArtiHook/ArtiHookClass</DEFINITION-REF>
                  <VALUE>[!"$Class"!]</VALUE>
                </ECUC-TEXTUAL-PARAM-VALUE>
                <ECUC-TEXTUAL-PARAM-VALUE>
                  <DEFINITION-REF DEST="ECUC-STRING-PARAM-DEF">[!"$Def"!]/ArtiValues/ArtiHook/ArtiHookContext</DEFINITION-REF>
                  <VALUE>[!"$Ctx"!]</VALUE>
                </ECUC-TEXTUAL-PARAM-VALUE>
                <ECUC-TEXTUAL-PARAM-VALUE>
                  <DEFINITION-REF DEST="ECUC-STRING-PARAM-DEF">[!"$Def"!]/ArtiValues/ArtiHook/ArtiHookEventName</DEFINITION-REF>
                  <VALUE>[!"$Event"!]</VALUE>
                </ECUC-TEXTUAL-PARAM-VALUE>
                <ECUC-TEXTUAL-PARAM-VALUE>
                  <DEFINITION-REF DEST="ECUC-STRING-PARAM-DEF">[!"$Def"!]/ArtiValues/ArtiHook/ArtiHookInstance</DEFINITION-REF>
                  <VALUE>[!"$ArtiOsName"!]</VALUE>
                </ECUC-TEXTUAL-PARAM-VALUE>
              </PARAMETER-VALUES>
              <REFERENCE-VALUES>
[!IF "$TypeMap != '-'"!][!//
[!CALL "ArtiRef", "RefDef" = "'ArtiValues/ArtiHook/ArtiHookEventParameterTypeRef'", "Target" = "concat($ArtiPkg, '/ArtiValues/TM_', $TypeMap)"!][!//
[!ENDIF!][!//
[!CALL "ArtiRef", "RefDef" = "'ArtiValues/ArtiHook/ArtiHookInstanceParameterTypeRef'", "Target" = "concat($ArtiPkg, '/ArtiValues/TM_ArtiCoreIndex')"!][!//
              </REFERENCE-VALUES>
            </ECUC-CONTAINER-VALUE>
[!ENDMACRO!][!//
[!//
[!/* ---- ArtiGeneric: components for ORTI objects that ARTI has no dedicated container for ----
     One Class per object kind (GC_<Class>) with one ClassParameter per ORTI attribute
     (GCP_<Class>_<ATTR>, named like the ORTI attribute); one Instance per object (GI_<Name>) whose
     InstanceParameters (GIP_<Name>_<ATTR>) point to a constant (K_<Name>_<ATTR>) or an expression
     (E_<Name>_<ATTR>). The object name is part of every SHORT-NAME: the ORTI parity test relies on it. */!][!//
[!MACRO "ArtiGenClassOpen", "Class" = ""!][!//
            <ECUC-CONTAINER-VALUE>
              <SHORT-NAME>GC_[!"$Class"!]</SHORT-NAME>
              <DEFINITION-REF DEST="ECUC-PARAM-CONF-CONTAINER-DEF">[!"$Def"!]/ArtiGeneric/ArtiGenericComponentClass</DEFINITION-REF>
              <PARAMETER-VALUES>
                <ECUC-TEXTUAL-PARAM-VALUE>
                  <DEFINITION-REF DEST="ECUC-STRING-PARAM-DEF">[!"$Def"!]/ArtiGeneric/ArtiGenericComponentClass/ArtiGenericComponentClassName</DEFINITION-REF>
                  <VALUE>[!"$Class"!]</VALUE>
                </ECUC-TEXTUAL-PARAM-VALUE>
              </PARAMETER-VALUES>
              <SUB-CONTAINERS>
[!ENDMACRO!][!//
[!MACRO "ArtiGenClassParam", "Class" = "", "Param" = "", "TypeMap" = ""!][!//
                <ECUC-CONTAINER-VALUE>
                  <SHORT-NAME>GCP_[!"$Class"!]_[!"$Param"!]</SHORT-NAME>
                  <DEFINITION-REF DEST="ECUC-PARAM-CONF-CONTAINER-DEF">[!"$Def"!]/ArtiGeneric/ArtiGenericComponentClass/ArtiGenericComponentClassParameter</DEFINITION-REF>
                  <PARAMETER-VALUES>
                    <ECUC-TEXTUAL-PARAM-VALUE>
                      <DEFINITION-REF DEST="ECUC-STRING-PARAM-DEF">[!"$Def"!]/ArtiGeneric/ArtiGenericComponentClass/ArtiGenericComponentClassParameter/ArtiGenericComponentClassParameterName</DEFINITION-REF>
                      <VALUE>[!"$Param"!]</VALUE>
                    </ECUC-TEXTUAL-PARAM-VALUE>
                  </PARAMETER-VALUES>
[!IF "$TypeMap != ''"!][!//
                  <REFERENCE-VALUES>
                    <ECUC-REFERENCE-VALUE>
                      <DEFINITION-REF DEST="ECUC-REFERENCE-DEF">[!"$Def"!]/ArtiGeneric/ArtiGenericComponentClass/ArtiGenericComponentClassParameter/ArtiGenericComponentClassParameterTypeMapRef</DEFINITION-REF>
                      <VALUE-REF DEST="ECUC-CONTAINER-VALUE">[!"$ArtiPkg"!]/ArtiValues/TM_[!"$TypeMap"!]</VALUE-REF>
                    </ECUC-REFERENCE-VALUE>
                  </REFERENCE-VALUES>
[!ENDIF!][!//
                </ECUC-CONTAINER-VALUE>
[!ENDMACRO!][!//
[!MACRO "ArtiGenClassClose"!][!//
              </SUB-CONTAINERS>
            </ECUC-CONTAINER-VALUE>
[!ENDMACRO!][!//
[!MACRO "ArtiGenInstOpen", "Class" = "", "Name" = ""!][!//
            <ECUC-CONTAINER-VALUE>
              <SHORT-NAME>GI_[!"$Name"!]</SHORT-NAME>
              <DEFINITION-REF DEST="ECUC-PARAM-CONF-CONTAINER-DEF">[!"$Def"!]/ArtiGeneric/ArtiGenericComponentInstance</DEFINITION-REF>
              <PARAMETER-VALUES>
                <ECUC-TEXTUAL-PARAM-VALUE>
                  <DEFINITION-REF DEST="ECUC-STRING-PARAM-DEF">[!"$Def"!]/ArtiGeneric/ArtiGenericComponentInstance/ArtiGenericComponentInstanceName</DEFINITION-REF>
                  <VALUE>[!"$Name"!]</VALUE>
                </ECUC-TEXTUAL-PARAM-VALUE>
              </PARAMETER-VALUES>
              <REFERENCE-VALUES>
                <ECUC-REFERENCE-VALUE>
                  <DEFINITION-REF DEST="ECUC-REFERENCE-DEF">[!"$Def"!]/ArtiGeneric/ArtiGenericComponentInstance/ArtiGenericComponentInstanceClassRef</DEFINITION-REF>
                  <VALUE-REF DEST="ECUC-CONTAINER-VALUE">[!"$ArtiPkg"!]/ArtiGeneric/GC_[!"$Class"!]</VALUE-REF>
                </ECUC-REFERENCE-VALUE>
              </REFERENCE-VALUES>
              <SUB-CONTAINERS>
[!ENDMACRO!][!//
[!/* Kind = Expression (target E_<Name>_<Param>); empty = constant (target K_<Name>_<Param>) */!][!//
[!MACRO "ArtiGenInstParam", "Class" = "", "Name" = "", "Param" = "", "Kind" = ""!][!//
                <ECUC-CONTAINER-VALUE>
                  <SHORT-NAME>GIP_[!"$Name"!]_[!"$Param"!]</SHORT-NAME>
                  <DEFINITION-REF DEST="ECUC-PARAM-CONF-CONTAINER-DEF">[!"$Def"!]/ArtiGeneric/ArtiGenericComponentInstance/ArtiGenericComponentInstanceParameter</DEFINITION-REF>
                  <REFERENCE-VALUES>
                    <ECUC-REFERENCE-VALUE>
                      <DEFINITION-REF DEST="ECUC-REFERENCE-DEF">[!"$Def"!]/ArtiGeneric/ArtiGenericComponentInstance/ArtiGenericComponentInstanceParameter/ArtiGenericComponentInstanceParameterClassParameterRef</DEFINITION-REF>
                      <VALUE-REF DEST="ECUC-CONTAINER-VALUE">[!"$ArtiPkg"!]/ArtiGeneric/GC_[!"$Class"!]/GCP_[!"$Class"!]_[!"$Param"!]</VALUE-REF>
                    </ECUC-REFERENCE-VALUE>
[!IF "$Kind = 'Expression'"!][!//
                    <ECUC-REFERENCE-VALUE>
                      <DEFINITION-REF DEST="ECUC-REFERENCE-DEF">[!"$Def"!]/ArtiGeneric/ArtiGenericComponentInstance/ArtiGenericComponentInstanceParameter/ArtiGenericComponentInstanceParameterExpressionRef</DEFINITION-REF>
                      <VALUE-REF DEST="ECUC-CONTAINER-VALUE">[!"$ArtiPkg"!]/ArtiValues/E_[!"$Name"!]_[!"$Param"!]</VALUE-REF>
                    </ECUC-REFERENCE-VALUE>
[!ELSE!][!//
                    <ECUC-REFERENCE-VALUE>
                      <DEFINITION-REF DEST="ECUC-REFERENCE-DEF">[!"$Def"!]/ArtiGeneric/ArtiGenericComponentInstance/ArtiGenericComponentInstanceParameter/ArtiGenericComponentInstanceParameterConstantRef</DEFINITION-REF>
                      <VALUE-REF DEST="ECUC-CONTAINER-VALUE">[!"$ArtiPkg"!]/ArtiValues/K_[!"$Name"!]_[!"$Param"!]</VALUE-REF>
                    </ECUC-REFERENCE-VALUE>
[!ENDIF!][!//
                  </REFERENCE-VALUES>
                </ECUC-CONTAINER-VALUE>
[!ENDMACRO!][!//
[!MACRO "ArtiGenInstClose"!][!//
              </SUB-CONTAINERS>
            </ECUC-CONTAINER-VALUE>
[!ENDMACRO!][!//
[!/* Literal path, as in the ORTI template: the configurator's engine does not resolve a $variable here */!][!//
[!SELECT "/AUTOSAR/TOP-LEVEL-PACKAGES/Os/ELEMENTS/Os"!][!//
[!IF "$ArtiEventsLoaded = 'true'"!][!CALL "Os_ArtiEventList"!][!ELSE!][!VAR "ArtiEnhanced" = "'false'"!][!VAR "ArtiEvents" = "''"!][!VAR "ArtiOsName" = "node:name(./OsOS)"!][!ENDIF!][!//
[!IF "node:value(./OsOS/OsUseArti) = 'true'"!][!//
[!/* ---- derived values (A2) ---- */!][!//
[!VAR "NoTask" = "num:i(count(./OsTask/*))"!][!//
[!/* kernel: INVALID_ISR = OS_ISR_TOTAL_NUM = count(OsIsr/*), CATEGORY_1 included */!][!//
[!VAR "NoIsr" = "num:i(count(./OsIsr/*))"!][!//
[!VAR "FirstCore" = "''"!][!//
[!LOOP "node:order(./OsCoreIdMappingConfig/*,'@index')"!][!IF "$FirstCore = ''"!][!VAR "CoreNo" = "num:i(node:value(./OsPhysicalCoreId))"!][!IF "node:value(./OsCoreId) != ''"!][!VAR "CoreNo" = "num:i(node:ref(./OsCoreId)/EcucCoreId)"!][!ENDIF!][!VAR "FirstCore" = "concat('Core', $CoreNo)"!][!ENDIF!][!ENDLOOP!][!//
<AUTOSAR xmlns="http://autosar.org/schema/r4.0" xmlns:xsi="http://www.w3.org/2001/XMLSchema-instance" xsi:schemaLocation="http://autosar.org/schema/r4.0 AUTOSAR_00047.xsd">
[!IF "$ArtiEventsLoaded != 'true'"!][!//
  <!-- Os_ArtiEvents.m was not found next to this template: no ArtiHook is described. -->
[!ENDIF!][!//
  <AR-PACKAGES>
    <AR-PACKAGE>
      <SHORT-NAME>Arti</SHORT-NAME>
      <ELEMENTS>
        <ECUC-MODULE-CONFIGURATION-VALUES>
          <SHORT-NAME>Arti</SHORT-NAME>
          <DEFINITION-REF DEST="ECUC-MODULE-DEF">[!"$Def"!]</DEFINITION-REF>
          <IMPLEMENTATION-CONFIG-VARIANT>VARIANT-PRE-COMPILE</IMPLEMENTATION-CONFIG-VARIANT>
          <CONTAINERS>
<!-- ============================== ArtiValues ============================== -->
            <ECUC-CONTAINER-VALUE>
              <SHORT-NAME>ArtiValues</SHORT-NAME>
              <DEFINITION-REF DEST="ECUC-PARAM-CONF-CONTAINER-DEF">[!"$Def"!]/ArtiValues</DEFINITION-REF>
              <SUB-CONTAINERS>
[!/* ---- States. The kernel variable has 4 task states (A5), decoded by TM_TaskState. ArtiStatesTaskEnhanced
     follows OsVendorArtiStateModel (design D3): with the enhanced model the trace events distinguish the
     READY sub-states Activated / Preempted / Released, so these states are declared as well. ---- */!][!//
            <ECUC-CONTAINER-VALUE>
              <SHORT-NAME>ArtiStates</SHORT-NAME>
              <DEFINITION-REF DEST="ECUC-PARAM-CONF-CONTAINER-DEF">[!"$Def"!]/ArtiValues/ArtiStates</DEFINITION-REF>
              <PARAMETER-VALUES>
                <ECUC-NUMERICAL-PARAM-VALUE>
                  <DEFINITION-REF DEST="ECUC-BOOLEAN-PARAM-DEF">[!"$Def"!]/ArtiValues/ArtiStates/ArtiStatesTaskEnhanced</DEFINITION-REF>
                  <VALUE>[!"$ArtiEnhanced"!]</VALUE>
                </ECUC-NUMERICAL-PARAM-VALUE>
              </PARAMETER-VALUES>
              <SUB-CONTAINERS>
[!CALL "ArtiTaskState", "Name" = "'TaskRunning'", "Literal" = "'ArtiTaskStateRunning'"!][!//
[!CALL "ArtiTaskState", "Name" = "'TaskReady'", "Literal" = "'ArtiTaskStateReady'"!][!//
[!CALL "ArtiTaskState", "Name" = "'TaskWaiting'", "Literal" = "'ArtiTaskStateWaiting'"!][!//
[!CALL "ArtiTaskState", "Name" = "'TaskSuspended'", "Literal" = "'ArtiTaskStateSuspended'"!][!//
[!IF "$ArtiEnhanced = 'true'"!][!//
[!CALL "ArtiTaskState", "Name" = "'TaskActivated'", "Literal" = "'ArtiTaskStateActivated'"!][!//
[!CALL "ArtiTaskState", "Name" = "'TaskPreempted'", "Literal" = "'ArtiTaskStatePreempted'"!][!//
[!CALL "ArtiTaskState", "Name" = "'TaskReleased'", "Literal" = "'ArtiTaskStateReleased'"!][!//
[!ENDIF!][!//
[!IF "count(./OsScheduleTable/*) > 0"!][!//
[!CALL "ArtiStateOf", "Kind" = "'ScheduleTable'", "Name" = "'SchedTableStopped'", "Literal" = "'ArtiScheduleTableStateStopped'"!][!//
[!CALL "ArtiStateOf", "Kind" = "'ScheduleTable'", "Name" = "'SchedTableNext'", "Literal" = "'ArtiScheduleTableStateNext'"!][!//
[!CALL "ArtiStateOf", "Kind" = "'ScheduleTable'", "Name" = "'SchedTableWaiting'", "Literal" = "'ArtiScheduleTableStateWaiting'"!][!//
[!CALL "ArtiStateOf", "Kind" = "'ScheduleTable'", "Name" = "'SchedTableRunning'", "Literal" = "'ArtiScheduleTableStateRunning'"!][!//
[!CALL "ArtiStateOf", "Kind" = "'ScheduleTable'", "Name" = "'SchedTableRunningAndSynchronous'", "Literal" = "'ArtiScheduleTableStateRunningAndSynchronous'"!][!//
[!ENDIF!][!//
[!IF "count(./OsSpinlock/*) > 0"!][!//
[!CALL "ArtiStateOf", "Kind" = "'Spinlock'", "Name" = "'SpinlockUnlocked'", "Literal" = "'ArtiSpinlockStateUnlocked'"!][!//
[!CALL "ArtiStateOf", "Kind" = "'Spinlock'", "Name" = "'SpinlockLocked'", "Literal" = "'ArtiSpinlockStateLocked'"!][!//
[!ENDIF!][!//
              </SUB-CONTAINERS>
            </ECUC-CONTAINER-VALUE>
[!/* ---- TypeMaps ---- */!][!//
[!CALL "ArtiTypeMapOpen", "Name" = "'TaskId'"!][!//
[!LOOP "node:order(./OsTask/*,'@index')"!][!//
[!CALL "ArtiPair", "Name" = "node:name(.)", "In" = "num:i(@index)", "Out" = "node:name(.)", "OutRef" = "concat($ArtiPkg, '/ArtiOs/', node:name(.))"!][!//
[!ENDLOOP!][!//
[!CALL "ArtiPair", "Name" = "'NO_TASK'", "In" = "$NoTask", "Out" = "'NO_TASK'"!][!//
[!CALL "ArtiTypeMapClose"!][!//
[!CALL "ArtiTypeMapOpen", "Name" = "'TaskPriority'"!][!//
[!LOOP "node:order(./OsTask/*,'@index')"!][!//
[!CALL "ArtiPair", "Name" = "node:name(.)", "In" = "num:i(@index)", "Out" = "node:value(./OsTaskPriority)"!][!//
[!ENDLOOP!][!//
[!CALL "ArtiPair", "Name" = "'NO_TASK'", "In" = "$NoTask", "Out" = "'-'"!][!//
[!CALL "ArtiTypeMapClose"!][!//
[!CALL "ArtiTypeMapOpen", "Name" = "'Isr2Id'"!][!//
[!LOOP "node:order(./OsIsr/*,'@index')"!][!IF "OsIsrCategory = 'CATEGORY_2'"!][!//
[!CALL "ArtiPair", "Name" = "node:name(.)", "In" = "num:i(@index)", "Out" = "node:name(.)", "OutRef" = "concat($ArtiPkg, '/ArtiOs/', node:name(.))"!][!//
[!ENDIF!][!ENDLOOP!][!//
[!CALL "ArtiPair", "Name" = "'NO_ISR'", "In" = "$NoIsr", "Out" = "'NO_ISR'"!][!//
[!CALL "ArtiTypeMapClose"!][!//
[!CALL "ArtiTypeMapOpen", "Name" = "'TaskState'"!][!//
[!CALL "ArtiPair", "Name" = "'RUNNING'", "In" = "'0'", "Out" = "'RUNNING'", "OutRef" = "concat($ArtiPkg, '/ArtiValues/ArtiStates/S_TaskRunning')"!][!//
[!CALL "ArtiPair", "Name" = "'READY'", "In" = "'1'", "Out" = "'READY'", "OutRef" = "concat($ArtiPkg, '/ArtiValues/ArtiStates/S_TaskReady')"!][!//
[!CALL "ArtiPair", "Name" = "'WAITING'", "In" = "'2'", "Out" = "'WAITING'", "OutRef" = "concat($ArtiPkg, '/ArtiValues/ArtiStates/S_TaskWaiting')"!][!//
[!CALL "ArtiPair", "Name" = "'SUSPENDED'", "In" = "'3'", "Out" = "'SUSPENDED'", "OutRef" = "concat($ArtiPkg, '/ArtiValues/ArtiStates/S_TaskSuspended')"!][!//
[!CALL "ArtiTypeMapClose"!][!//
[!CALL "ArtiTypeMapOpen", "Name" = "'AppMode'"!][!//
[!LOOP "node:order(./OsAppMode/*,'@index')"!][!//
[!CALL "ArtiPair", "Name" = "node:name(.)", "In" = "num:i(@index + 1)", "Out" = "node:name(.)", "OutRef" = "concat($OsValuePkg, '/', node:name(.))"!][!//
[!ENDLOOP!][!//
[!CALL "ArtiTypeMapClose"!][!//
[!CALL "ArtiTypeMapOpen", "Name" = "'ApplicationId'"!][!//
[!LOOP "node:order(./OsApplication/*,'@index')"!][!//
[!CALL "ArtiPair", "Name" = "node:name(.)", "In" = "num:i(@index)", "Out" = "node:name(.)"!][!//
[!ENDLOOP!][!//
[!CALL "ArtiPair", "Name" = "'NO_APPLICATION'", "In" = "num:i(count(./OsApplication/*))", "Out" = "'NO_APPLICATION'"!][!//
[!CALL "ArtiTypeMapClose"!][!//
[!/* Stacks and contexts: decode the address a task currently uses (ORTI TASK.STACK / TASK.CONTEXT) */!][!//
[!CALL "ArtiTypeMapOpen", "Name" = "'TaskStack'"!][!//
[!LOOP "node:order(./OsTask/*,'@index')"!][!//
[!CALL "ArtiPair", "Name" = "node:name(.)", "InExpr" = "concat(node:name(.), '_StackBase')", "Out" = "node:name(.)", "OutRef" = "concat($ArtiPkg, '/ArtiOs/', node:name(.), '_stack')"!][!//
[!ENDLOOP!][!//
[!CALL "ArtiTypeMapClose"!][!//
[!CALL "ArtiTypeMapOpen", "Name" = "'TaskContext'"!][!//
[!LOOP "node:order(./OsTask/*,'@index')"!][!//
[!CALL "ArtiPair", "Name" = "node:name(.)", "InExpr" = "concat(node:name(.), '_Context')", "Out" = "node:name(.)", "OutRef" = "concat($ArtiPkg, '/ArtiOs/', node:name(.), '_ContextInfo')"!][!//
[!ENDLOOP!][!//
[!CALL "ArtiTypeMapClose"!][!//
[!CALL "ArtiTypeMapOpen", "Name" = "'AlarmState'"!][!//
[!CALL "ArtiPair", "Name" = "'ALARM_ENABLED'", "In" = "'0'", "Out" = "'ALARM_ENABLED'"!][!//
[!CALL "ArtiPair", "Name" = "'ALARM_DISABLED'", "In" = "'1'", "Out" = "'ALARM_DISABLED'"!][!//
[!CALL "ArtiTypeMapClose"!][!//
[!CALL "ArtiTypeMapOpen", "Name" = "'ResourceState'"!][!//
[!CALL "ArtiPair", "Name" = "'UNLOCKED'", "In" = "'0'", "Out" = "'UNLOCKED'"!][!//
[!CALL "ArtiPair", "Name" = "'LOCKED'", "In" = "'1'", "Out" = "'LOCKED'"!][!//
[!CALL "ArtiTypeMapClose"!][!//
[!/* Owner of a resource / spinlock: the kernel stores the global ObjectIDIndex of the holder.
     Same numbering as the ORTI RESOURCE_OWNER / SPINLOCK_OWNER enumeration, computed with the same
     Os_AppCommon.m macros (per application: tasks, then ISRs - all of them take a number, only CATEGORY_2
     ones are named - then the objects counted by CurrentAppObjectCnt). */!][!//
[!IF "$OwnerTypeMap != ''"!][!//
[!CALL "ArtiTypeMapOpen", "Name" = "'ObjectOwner'"!][!//
[!VAR "ObjectID" = "0"!][!VAR "CurrentAppObjectCnt" = "0"!][!//
[!LOOP "node:order(./OsApplication/*,'@index')"!][!//
[!LOOP "node:order(./OsAppTaskRef/*,'@index')"!][!//
[!CALL "ArtiPair", "Name" = "concat('Task_', node:name(node:ref(.)))", "In" = "num:i($ObjectID)", "Out" = "concat('Task ', node:name(node:ref(.)))"!][!//
[!VAR "ObjectID" = "$ObjectID + 1"!][!//
[!ENDLOOP!][!//
[!LOOP "node:order(./OsAppIsrRef/*,'@index')"!][!//
[!IF "node:ref(.)/OsIsrCategory = 'CATEGORY_2'"!][!CALL "ArtiPair", "Name" = "concat('ISR_', node:name(node:ref(.)))", "In" = "num:i($ObjectID)", "Out" = "concat('ISR ', node:name(node:ref(.)))"!][!ENDIF!][!//
[!VAR "ObjectID" = "$ObjectID + 1"!][!//
[!ENDLOOP!][!//
[!VAR "AppID" = "num:i(./@index)"!][!//
[!VAR "IocCbkObjectIDCount" = "0"!][!//
[!CALL "Os_Calculate_IocCallBack_ObjectCount", "AppID" = "$AppID", "IocCbkObjectIDCount" = "$IocCbkObjectIDCount"!][!//
[!VAR "HookObjectIDCount" = "0"!][!//
[!CALL "Os_Calculate_Hook_ObjectCount", "AppID" = "$AppID", "HookObjectIDCount" = "$HookObjectIDCount"!][!//
[!VAR "CurrentAppObjectCnt" = "num:i($CurrentAppObjectCnt + count(./OsAppTaskRef/*) + count(./OsAppIsrRef/*) + count(./OsAppCounterRef/*) + count(./OsAppAlarmRef/*) + count(./OsAppScheduleTableRef/*) + num:i($HookObjectIDCount) + num:i($IocCbkObjectIDCount))"!][!//
[!VAR "ObjectID" = "$CurrentAppObjectCnt"!][!//
[!ENDLOOP!][!//
[!CALL "ArtiPair", "Name" = "'NONE'", "In" = "'4294967295'", "Out" = "'-'"!][!//
[!CALL "ArtiTypeMapClose"!][!//
[!ENDIF!][!//
[!CALL "ArtiTypeMapOpen", "Name" = "'TaskType'"!][!//
[!CALL "ArtiPair", "Name" = "'BASIC'", "In" = "'0'", "Out" = "'BASIC'"!][!//
[!CALL "ArtiPair", "Name" = "'EXTENDED'", "In" = "'1'", "Out" = "'EXTENDED'"!][!//
[!CALL "ArtiTypeMapClose"!][!//
[!CALL "ArtiTypeMapOpen", "Name" = "'AlarmAction'"!][!//
[!CALL "ArtiPair", "Name" = "'ALARM_ACTIVATETASK'", "In" = "'0'", "Out" = "'ALARM_ACTIVATETASK'"!][!//
[!CALL "ArtiPair", "Name" = "'ALARM_SETEVENT'", "In" = "'1'", "Out" = "'ALARM_SETEVENT'"!][!//
[!CALL "ArtiPair", "Name" = "'ALARM_CALLBACK'", "In" = "'2'", "Out" = "'ALARM_CALLBACK'"!][!//
[!CALL "ArtiPair", "Name" = "'ALARM_INCREMENTCOUNTER'", "In" = "'3'", "Out" = "'ALARM_INCREMENTCOUNTER'"!][!//
[!CALL "ArtiTypeMapClose"!][!//
[!/* LOCKED: the value is the address of the Os_LockConfig_<resource> the object holds; "none" differs per object kind (ORTI) */!][!//
[!CALL "ArtiTypeMapOpen", "Name" = "'LockedByTask'"!][!//
[!LOOP "node:order(./OsResource/*,'@index')"!][!//
[!CALL "ArtiPair", "Name" = "node:name(.)", "InExpr" = "concat('LockAddr_', node:name(.))", "Out" = "node:name(.)"!][!//
[!ENDLOOP!][!//
[!CALL "ArtiPair", "Name" = "'NONE'", "In" = "'0'", "Out" = "'-'"!][!//
[!CALL "ArtiTypeMapClose"!][!//
[!CALL "ArtiTypeMapOpen", "Name" = "'LockedByResource'"!][!//
[!LOOP "node:order(./OsResource/*,'@index')"!][!//
[!CALL "ArtiPair", "Name" = "node:name(.)", "InExpr" = "concat('LockAddr_', node:name(.))", "Out" = "node:name(.)"!][!//
[!ENDLOOP!][!//
[!CALL "ArtiPair", "Name" = "'NONE'", "In" = "'4294967295'", "Out" = "'-'"!][!//
[!CALL "ArtiTypeMapClose"!][!//
[!IF "count(./OsScheduleTable/*) > 0"!][!//
[!CALL "ArtiTypeMapOpen", "Name" = "'ScheduleTableState'"!][!//
[!CALL "ArtiPair", "Name" = "'STOPPED'", "In" = "'0'", "Out" = "'STOPPED'", "OutRef" = "concat($ArtiPkg, '/ArtiValues/ArtiStates/S_SchedTableStopped')"!][!//
[!CALL "ArtiPair", "Name" = "'NEXT'", "In" = "'1'", "Out" = "'NEXT'", "OutRef" = "concat($ArtiPkg, '/ArtiValues/ArtiStates/S_SchedTableNext')"!][!//
[!CALL "ArtiPair", "Name" = "'WAITING'", "In" = "'2'", "Out" = "'WAITING'", "OutRef" = "concat($ArtiPkg, '/ArtiValues/ArtiStates/S_SchedTableWaiting')"!][!//
[!CALL "ArtiPair", "Name" = "'RUNNING'", "In" = "'3'", "Out" = "'RUNNING'", "OutRef" = "concat($ArtiPkg, '/ArtiValues/ArtiStates/S_SchedTableRunning')"!][!//
[!CALL "ArtiPair", "Name" = "'RUNNING_AND_SYNCHRONOUS'", "In" = "'4'", "Out" = "'RUNNING_AND_SYNCHRONOUS'", "OutRef" = "concat($ArtiPkg, '/ArtiValues/ArtiStates/S_SchedTableRunningAndSynchronous')"!][!//
[!CALL "ArtiTypeMapClose"!][!//
[!CALL "ArtiTypeMapOpen", "Name" = "'ScheduleTableNext'"!][!//
[!LOOP "node:order(./OsScheduleTable/*,'@index')"!][!//
[!CALL "ArtiPair", "Name" = "node:name(.)", "In" = "num:i(@index)", "Out" = "node:name(.)"!][!//
[!ENDLOOP!][!//
[!CALL "ArtiPair", "Name" = "'NONE'", "In" = "'255'", "Out" = "'-'"!][!//
[!CALL "ArtiTypeMapClose"!][!//
[!ENDIF!][!//
[!IF "count(./OsSpinlock/*) > 0"!][!//
[!CALL "ArtiTypeMapOpen", "Name" = "'SpinlockState'"!][!//
[!CALL "ArtiPair", "Name" = "'UNLOCKED'", "In" = "'0'", "Out" = "'UNLOCKED'", "OutRef" = "concat($ArtiPkg, '/ArtiValues/ArtiStates/S_SpinlockUnlocked')"!][!//
[!CALL "ArtiPair", "Name" = "'LOCKED'", "In" = "'1'", "Out" = "'LOCKED'", "OutRef" = "concat($ArtiPkg, '/ArtiValues/ArtiStates/S_SpinlockLocked')"!][!//
[!CALL "ArtiTypeMapClose"!][!//
[!CALL "ArtiTypeMapOpen", "Name" = "'SpinlockLockMethod'"!][!//
[!CALL "ArtiPair", "Name" = "'LOCK_ALL_INTERRUPTS'", "In" = "'0'", "Out" = "'LOCK_ALL_INTERRUPTS'"!][!//
[!CALL "ArtiPair", "Name" = "'LOCK_CAT2_INTERRUPTS'", "In" = "'1'", "Out" = "'LOCK_CAT2_INTERRUPTS'"!][!//
[!CALL "ArtiPair", "Name" = "'LOCK_NOTHING'", "In" = "'2'", "Out" = "'LOCK_NOTHING'"!][!//
[!CALL "ArtiPair", "Name" = "'LOCK_WITH_RES_SCHEDULER'", "In" = "'3'", "Out" = "'LOCK_WITH_RES_SCHEDULER'"!][!//
[!CALL "ArtiTypeMapClose"!][!//
[!ENDIF!][!//
[!CALL "ArtiTypeMapOpen", "Name" = "'LastError'"!][!//
[!VAR "Errors" = "'E_OK:0,E_OS_ACCESS:1,E_OS_CALLEVEL:2,E_OS_ID:3,E_OS_LIMIT:4,E_OS_NOFUNC:5,E_OS_RESOURCE:6,E_OS_STATE:7,E_OS_VALUE:8,E_OS_SERVICEID:9,E_OS_ILLEGAL_ADDRESS:10,E_OS_MISSINGEND:11,E_OS_DISABLEDINT:12,E_OS_STACKFAULT:13,E_OS_PROTECTION_MEMORY:14,E_OS_PROTECTION_TIME:15,E_OS_PROTECTION_ARRIVAL:16,E_OS_PROTECTION_LOCKED:17,E_OS_PROTECTION_EXCEPTION:18,E_OS_SPINLOCK:19,E_OS_INTERFERENCE_DEADLOCK:20,E_OS_NESTING_DEADLOCK:21,E_OS_CORE:22,E_OS_PARAM_POINTER:23,E_OS_SYS_API_ERROR:24,E_OS_STATUS_ACCESSRIGHTS:25,E_OS_SYS_UNDEFINED_IRQ:32,E_OS_NO_PRE_TASK:33'"!][!//
[!LOOP "text:split($Errors, ',')"!][!//
[!CALL "ArtiPair", "Name" = "text:split(., ':')[1]", "In" = "text:split(., ':')[2]", "Out" = "text:split(., ':')[1]"!][!//
[!ENDLOOP!][!//
[!CALL "ArtiTypeMapClose"!][!//
[!CALL "ArtiTypeMapOpen", "Name" = "'ServiceId'"!][!//
[!VAR "Services" = "'NOSERVICE:0,GETAPPLICATIONID:2,GETISRID:4,CALLTRUSTEDFUNCTION:6,CHECKISRMEMORYACCESS:8,CHECKTASKMEMORYACCESS:10,CHECKOBJECTACCESS:12,CHECKOBJECTOWNERSHIP:14,STARTSCHEDULETABLEREL:16,STARTSCHEDULETABLEABS:18,STOPSCHEDULETABLE:20,NEXTSCHEDULETABLE:22,STARTSCHEDULETABLESYNCHRON:24,SYNCSCHEDULETABLE:26,SETSCHEDULETABLEASYNC:28,GETSCHEDULETABLESTATUS:30,INCREMENTCOUNTER:32,GETCOUNTERVALUE:34,GETELAPSEDVALUE:36,TERMINATEAPPLICATION:38,ALLOWACCESS:40,GETAPPLICATIONSTATE:42,GETNUMBEROFACTIVATEDCORES:44,GETCOREID:46,STARTCORE:48,GETSPINLOCK:52,RELEASESPINLOCK:54,TRYTOGETSPINLOCK:56,SHUTDOWNALLCORES:58,CONTROLIDLE:60,IOCSENDIOCIDSENDERID:62,IOCWRITEIOCIDSENDERID:64,IOCSENDGROUPIOCID:66,IOCWRITEGROUPIOCID:68,IOCRECEIVEIOCID:70,IOCREADIOCIDRECEIVERID:72,IOCRECEIVEGROUPIOCID:74,IOCREADGROUPIOCID:76,IOCEMPTYQUEUE:78,GETCURRENTAPPLICATIONID:80,READPERIPHERAL8:82,READPERIPHERAL16:84,READPERIPHERAL32:86,WRITEPERIPHERAL8:88,WRITEPERIPHERAL16:90,WRITEPERIPHERAL32:92,MODIFYPERIPHERAL8:94,MODIFYPERIPHERAL32:96,DISABLEINTERRUPTSOURCE:98,ENABLEINTERRUPTSOURCE:100,CLEARPENDINGINTERRUPT:102,ACTIVATETASKASYN:104,SETEVENTASYN:106,MODIFYPERIPHERAL16:108,ISOSSTARTED:110,STARTOS:418,GETACTIVATEAPPLICATIONMODE:422,DISABLEALLINTERRUPTS:424,ENABLEALLINTERRUPTS:426,SUSPENDALLINTERRUPTS:428,RESUMEALLINTERRUPTS:430,SUSPENDOSINTERRUPTS:432,RESUMEOSINTERRUPTS:434,ACTIVATETASK:436,TERMINATETASK:438,CHAINTASK:440,GETTASKID:442,GETTASKSTATE:444,SCHEDULE:446,SETEVENT:448,CLEAREVENT:450,GETEVENT:452,WAITEVENT:454,GETALARMBASE:456,GETALARM:458,SETRELALARM:460,SETABSALARM:462,CANCELALARM:464,GETRESOURCE:466,RELEASERESOURCE:468,POSTISR:470,IOCCALLCALLBACK:472,DOALARM:474,SHUTDOWNOS:476'"!][!//
[!LOOP "text:split($Services, ',')"!][!//
[!CALL "ArtiPair", "Name" = "text:split(., ':')[1]", "In" = "text:split(., ':')[2]", "Out" = "text:split(., ':')[1]"!][!//
[!ENDLOOP!][!//
[!CALL "ArtiTypeMapClose"!][!//
[!/* ---- Type maps of the hook parameters (add-arti-hook-tracing D2). All inputs stay within 0..65535
     (ECUC_Arti_00024). Instance parameter: the OS core index = Os_Inf_GetCoreId() (A1). ---- */!][!//
[!CALL "ArtiTypeMapOpen", "Name" = "'ArtiCoreIndex'"!][!//
[!LOOP "node:order(./OsCoreIdMappingConfig/*,'@index')"!][!//
[!VAR "CoreNo" = "num:i(node:value(./OsPhysicalCoreId))"!][!IF "node:value(./OsCoreId) != ''"!][!VAR "CoreNo" = "num:i(node:ref(./OsCoreId)/EcucCoreId)"!][!ENDIF!][!//
[!CALL "ArtiPair", "Name" = "concat('Core', $CoreNo)", "In" = "$CoreNo", "Out" = "concat('Core', $CoreNo)"!][!//
[!ENDLOOP!][!//
[!CALL "ArtiTypeMapClose"!][!//
[!/* kernel Os_hook_types.h ProtectionReturnType */!][!//
[!CALL "ArtiTypeMapOpen", "Name" = "'ProtectionReaction'"!][!//
[!LOOP "text:split('PRO_IGNORE:0,PRO_TERMINATETASKISR:1,PRO_TERMINATEAPPL:2,PRO_TERMINATEAPPL_RESTART:3,PRO_SHUTDOWN:4', ',')"!][!//
[!CALL "ArtiPair", "Name" = "text:split(., ':')[1]", "In" = "text:split(., ':')[2]", "Out" = "text:split(., ':')[1]"!][!//
[!ENDLOOP!][!//
[!CALL "ArtiTypeMapClose"!][!//
[!/* Object IDs = @index, invalid ID = count (plugin Os_spinlock_Cfg.h, Os_alarm_Cfg.h, Os_counter_Cfg.h,
     Os_scheduletable_Cfg.h) */!][!//
[!CALL "ArtiTypeMapOpen", "Name" = "'SpinlockId'"!][!//
[!LOOP "node:order(./OsSpinlock/*,'@index')"!][!CALL "ArtiPair", "Name" = "node:name(.)", "In" = "num:i(@index)", "Out" = "node:name(.)"!][!ENDLOOP!][!//
[!CALL "ArtiPair", "Name" = "'INVALID_SPINLOCK'", "In" = "num:i(count(./OsSpinlock/*))", "Out" = "'INVALID_SPINLOCK'"!][!//
[!CALL "ArtiTypeMapClose"!][!//
[!CALL "ArtiTypeMapOpen", "Name" = "'AlarmId'"!][!//
[!LOOP "node:order(./OsAlarm/*,'@index')"!][!CALL "ArtiPair", "Name" = "node:name(.)", "In" = "num:i(@index)", "Out" = "node:name(.)"!][!ENDLOOP!][!//
[!CALL "ArtiPair", "Name" = "'INVALID_ALARM'", "In" = "num:i(count(./OsAlarm/*))", "Out" = "'INVALID_ALARM'"!][!//
[!CALL "ArtiTypeMapClose"!][!//
[!CALL "ArtiTypeMapOpen", "Name" = "'CounterId'"!][!//
[!LOOP "node:order(./OsCounter/*,'@index')"!][!CALL "ArtiPair", "Name" = "node:name(.)", "In" = "num:i(@index)", "Out" = "node:name(.)"!][!ENDLOOP!][!//
[!CALL "ArtiPair", "Name" = "'INVALID_COUNTER'", "In" = "num:i(count(./OsCounter/*))", "Out" = "'INVALID_COUNTER'"!][!//
[!CALL "ArtiTypeMapClose"!][!//
[!CALL "ArtiTypeMapOpen", "Name" = "'ScheduleTableId'"!][!//
[!LOOP "node:order(./OsScheduleTable/*,'@index')"!][!CALL "ArtiPair", "Name" = "node:name(.)", "In" = "num:i(@index)", "Out" = "node:name(.)"!][!ENDLOOP!][!//
[!CALL "ArtiPair", "Name" = "'INVALID_SCHEDULETABLE'", "In" = "num:i(count(./OsScheduleTable/*))", "Out" = "'INVALID_SCHEDULETABLE'"!][!//
[!CALL "ArtiTypeMapClose"!][!//
[!/* Resource IDs follow plugin Os_resource_Cfg.h: per core in EcucCoreId order, the resources of that core
     by @index (a LINKED resource belongs to the core of the resource it is linked to), then the core's
     RES_SCHEDULER when OsUseResScheduler is on. */!][!//
[!CALL "ArtiTypeMapOpen", "Name" = "'ResourceId'"!][!//
[!VAR "ResourceId" = "0"!][!//
[!LOOP "node:order(./OsCoreIdMappingConfig/*,'num:i(node:ref(./OsCoreId)/EcucCoreId)')"!][!//
[!VAR "CurrentCoreId" = "num:i(node:ref(./OsCoreId)/EcucCoreId)"!][!//
[!LOOP "node:order(../../OsResource/*,'@index')"!][!//
[!IF "(OsResourceProperty = 'LINKED') and (OsResourceLinkedToResScheduler = 'false')"!][!//
[!VAR "ResourceCoreRef" = "node:ref(node:ref(node:ref(OsResourceLinkedResourceRef)/OsResourceCoreRef)/OsCoreId)/EcucCoreId"!][!//
[!ELSE!][!//
[!VAR "ResourceCoreRef" = "node:ref(node:ref(OsResourceCoreRef)/OsCoreId)/EcucCoreId"!][!//
[!ENDIF!][!//
[!IF "$ResourceCoreRef = $CurrentCoreId"!][!//
[!CALL "ArtiPair", "Name" = "node:name(.)", "In" = "num:i($ResourceId)", "Out" = "node:name(.)"!][!//
[!VAR "ResourceId" = "$ResourceId + 1"!][!//
[!ENDIF!][!//
[!ENDLOOP!][!//
[!IF "../../OsOS/OsUseResScheduler = 'true'"!][!//
[!CALL "ArtiPair", "Name" = "concat('RES_SCHEDULER_Core', $CurrentCoreId)", "In" = "num:i($ResourceId)", "Out" = "concat('RES_SCHEDULER_Core', $CurrentCoreId)"!][!//
[!VAR "ResourceId" = "$ResourceId + 1"!][!//
[!ENDIF!][!//
[!ENDLOOP!][!//
[!CALL "ArtiPair", "Name" = "'INVALID_RESOURCE'", "In" = "num:i($ResourceId)", "Out" = "'INVALID_RESOURCE'"!][!//
[!CALL "ArtiTypeMapClose"!][!//
[!/* ---- Class parameters: which TypeMap decodes each attribute ---- */!][!//
[!CALL "ArtiCP", "Name" = "'CurrentTask'", "TypeMap" = "'TaskId'"!][!//
[!CALL "ArtiCP", "Name" = "'CurrentIsr'", "TypeMap" = "'Isr2Id'"!][!//
[!CALL "ArtiCP", "Name" = "'CurrentApplication'", "TypeMap" = "'ApplicationId'"!][!//
[!CALL "ArtiCP", "Name" = "'LastError'", "TypeMap" = "'LastError'"!][!//
[!CALL "ArtiCP", "Name" = "'RunningTaskPriority'", "TypeMap" = "'TaskPriority'"!][!//
[!CALL "ArtiCP", "Name" = "'AppMode'", "TypeMap" = "'AppMode'"!][!//
[!CALL "ArtiCP", "Name" = "'ServiceTrace'", "TypeMap" = "'ServiceId'"!][!//
[!CALL "ArtiCP", "Name" = "'TaskState'", "TypeMap" = "'TaskState'"!][!//
[!CALL "ArtiCP", "Name" = "'TaskPriority'"!][!//
[!CALL "ArtiCP", "Name" = "'TaskStack'", "TypeMap" = "'TaskStack'"!][!//
[!CALL "ArtiCP", "Name" = "'TaskContext'", "TypeMap" = "'TaskContext'"!][!//
[!CALL "ArtiCP", "Name" = "'AlarmState'", "TypeMap" = "'AlarmState'"!][!//
[!CALL "ArtiCP", "Name" = "'ResourceState'", "TypeMap" = "'ResourceState'"!][!//
[!/* ---- Expressions / constants with their instance parameters ---- */!][!//
[!CALL "ArtiConstIP", "Name" = "'StackFillPattern'", "Str" = "'0x00000000'"!][!//
[!CALL "ArtiExprIP", "Name" = "'AppMode'", "Str" = "'Os_OrtiRunningData[0].CurrentAppMode'"!][!//
[!LOOP "node:order(./OsCoreIdMappingConfig/*,'@index')"!][!//
[!VAR "CoreNo" = "num:i(node:value(./OsPhysicalCoreId))"!][!IF "node:value(./OsCoreId) != ''"!][!VAR "CoreNo" = "num:i(node:ref(./OsCoreId)/EcucCoreId)"!][!ENDIF!][!//
[!VAR "Rd" = "concat('Os_OrtiRunningData[', $CoreNo, ']')"!][!//
[!VAR "Cn" = "concat('Core', $CoreNo)"!][!//
[!CALL "ArtiExprIP", "Name" = "concat($Cn, '_RunningTask')", "Str" = "concat($Rd, '.RunningTaskType')"!][!//
[!CALL "ArtiExprIP", "Name" = "concat($Cn, '_RunningIsr')", "Str" = "concat($Rd, '.RunningISRType')"!][!//
[!CALL "ArtiExprIP", "Name" = "concat($Cn, '_LastError')", "Str" = "concat($Rd, '.LastError')"!][!//
[!CALL "ArtiExprIP", "Name" = "concat($Cn, '_CurrentApplication')", "Str" = "concat('Os_AppRunningTimeData_Core', $CoreNo, '.Current_ApplicationID')"!][!//
[!CALL "ArtiExprIP", "Name" = "concat($Cn, '_ServiceId')", "Str" = "concat($Rd, '.ServiceId')"!][!//
[!ENDLOOP!][!//
[!LOOP "node:order(./OsTask/*,'@index')"!][!//
[!VAR "N" = "node:name(.)"!][!//
[!CALL "ArtiExprIP", "Name" = "concat($N, '_State')", "Str" = "concat($N, '_RunningData.State')"!][!//
[!CALL "ArtiExprIP", "Name" = "concat($N, '_Activations')", "Str" = "concat($N, '_RunningData.ActivationCount')"!][!//
[!CALL "ArtiExprIP", "Name" = "concat($N, '_StackBase')", "Str" = "concat($N, '_stack[0]')", "AddressOf" = "'true'"!][!//
[!CALL "ArtiExprIP", "Name" = "concat($N, '_Context')", "Str" = "concat($N, '_ContextInfo')", "AddressOf" = "'true'"!][!//
[!CALL "ArtiConstIP", "Name" = "concat($N, '_StackSize')", "Str" = "num:i(node:value(./TaskStackSize))"!][!//
[!CALL "ArtiConstIP", "Name" = "concat($N, '_Priority')", "Str" = "node:value(./OsTaskPriority)"!][!//
[!ENDLOOP!][!//
[!/* The kernel only has <name>_stack / <name>_ContextInfo for Tasks and CATEGORY_2 ISRs */!][!//
[!LOOP "node:order(./OsIsr/*,'@index')"!][!IF "OsIsrCategory = 'CATEGORY_2'"!][!//
[!VAR "N" = "node:name(.)"!][!//
[!CALL "ArtiExprIP", "Name" = "concat($N, '_StackBase')", "Str" = "concat($N, '_stack[0]')", "AddressOf" = "'true'"!][!//
[!CALL "ArtiExprIP", "Name" = "concat($N, '_Context')", "Str" = "concat($N, '_ContextInfo')", "AddressOf" = "'true'"!][!//
[!CALL "ArtiConstIP", "Name" = "concat($N, '_StackSize')", "Str" = "num:i(node:value(./IsrStackSize))"!][!//
[!ENDIF!][!ENDLOOP!][!//
[!LOOP "node:order(./OsAlarm/*,'@index')"!][!//
[!VAR "N" = "node:name(.)"!][!//
[!CALL "ArtiExprIP", "Name" = "concat($N, '_State')", "Str" = "concat($N, '_RunningData.State')"!][!//
[!CALL "ArtiExprIP", "Name" = "concat($N, '_Cycle')", "Str" = "concat($N, '_RunningData.Cycle')"!][!//
[!ENDLOOP!][!//
[!LOOP "node:order(./OsResource/*,'@index')"!][!//
[!VAR "N" = "node:name(.)"!][!//
[!CALL "ArtiExprIP", "Name" = "concat($N, '_State')", "Str" = "concat('Os_LockConfig_', $N, '.Previous == 0xFFFFFFFF ? 0:1')"!][!//
[!ENDLOOP!][!//
[!LOOP "node:order(./OsEvent/*,'@index')"!][!//
[!CALL "ArtiConst", "Name" = "concat(node:name(.), '_EVENTMASK')", "Str" = "num:i(node:value(./OsEventMask))"!][!//
[!ENDLOOP!][!//
[!/* ORTI attributes without a dedicated ARTI attribute: values read by the generic components */!][!//
[!LOOP "node:order(./OsResource/*,'@index')"!][!//
[!VAR "N" = "node:name(.)"!][!//
[!CALL "ArtiExprIP", "Name" = "concat('LockAddr_', $N)", "Str" = "concat('Os_LockConfig_', $N)", "AddressOf" = "'true'"!][!//
[!CALL "ArtiExprIP", "Name" = "concat($N, '_LOCKED')", "Str" = "concat('Os_LockConfig_', $N, '.Previous')"!][!//
[!CALL "ArtiExprIP", "Name" = "concat($N, '_RESOURCE_OWNER')", "Str" = "concat('Os_', $N, '_RunningData.OwnerObjectID')"!][!//
[!CALL "ArtiExprIP", "Name" = "concat($N, '_PRIORITY_TYPE')", "Str" = "concat('Os_ResourceConfig_', $N, '.CeilingIsrLevel == 0xFFFFFFFF ? 0:1')"!][!//
[!CALL "ArtiExprIP", "Name" = "concat($N, '_PRIORITY')", "Str" = "concat('Os_ResourceConfig_', $N, '.CeilingIsrLevel == 0xFFFFFFFF ? Os_ResourceConfig_', $N, '.CeilingPriority : Os_ResourceConfig_', $N, '.CeilingIsrLevel')"!][!//
[!ENDLOOP!][!//
[!LOOP "node:order(./OsTask/*,'@index')"!][!//
[!VAR "N" = "node:name(.)"!][!//
[!CALL "ArtiExprIP", "Name" = "concat($N, '_OSTASKTYPE')", "Str" = "concat('Task_', $N, '_ConfigRef.IsExtended')"!][!//
[!CALL "ArtiConst", "Name" = "concat($N, '_OSTASKSCHEDULE')", "Str" = "node:value(./OsTaskSchedule)"!][!//
[!CALL "ArtiExprIP", "Name" = "concat($N, '_OSTASKMAXACTIVATION')", "Str" = "concat('Task_', $N, '_ConfigRef.MaxActivationCount')"!][!//
[!CALL "ArtiExprIP", "Name" = "concat($N, '_REMAININGACTIVATIONS')", "Str" = "concat('Task_', $N, '_ConfigRef.MaxActivationCount - ', $N, '_RunningData.ActivationCount')"!][!//
[!CALL "ArtiExprIP", "Name" = "concat($N, '_EVENTMASK')", "Str" = "concat($N, '_RunningData.EventWait')"!][!//
[!CALL "ArtiExprIP", "Name" = "concat($N, '_EVENTSETFLAG')", "Str" = "concat($N, '_RunningData.EventSet')"!][!//
[!CALL "ArtiExprIP", "Name" = "concat($N, '_LOCKED')", "Str" = "concat($N, '_RunningData.LockList')"!][!//
[!ENDLOOP!][!//
[!LOOP "node:order(./OsIsr/*,'@index')"!][!//
[!VAR "N" = "node:name(.)"!][!//
[!CALL "ArtiExprIP", "Name" = "concat($N, '_PRIORITY')", "Str" = "concat($N, '.IsrHwConfig.priority')"!][!//
[!/* <name>_RunningData exists for CATEGORY_2 ISRs only */!][!//
[!IF "OsIsrCategory = 'CATEGORY_2'"!][!CALL "ArtiExprIP", "Name" = "concat($N, '_LOCKED')", "Str" = "concat($N, '_RunningData.LockList')"!][!ENDIF!][!//
[!ENDLOOP!][!//
[!LOOP "node:order(./OsScheduleTable/*,'@index')"!][!//
[!VAR "N" = "node:name(.)"!][!//
[!CALL "ArtiExprIP", "Name" = "concat($N, '_STATE')", "Str" = "concat('Os_', $N, '_RunningData.State')"!][!//
[!CALL "ArtiExprIP", "Name" = "concat($N, '_SCHEDULETABLENEXT')", "Str" = "concat('Os_', $N, '_RunningData.NextSchTID')"!][!//
[!ENDLOOP!][!//
[!LOOP "node:order(./OsSpinlock/*,'@index')"!][!//
[!VAR "N" = "node:name(.)"!][!//
[!CALL "ArtiExprIP", "Name" = "concat($N, '_STATE')", "Str" = "concat('Os_LockStatus_', $N, '.lockStatus')"!][!//
[!CALL "ArtiExprIP", "Name" = "concat($N, '_LOCKED')", "Str" = "concat('Os_LockConfig_', $N, '.Previous')"!][!//
[!CALL "ArtiExprIP", "Name" = "concat($N, '_SPINLOCK_OWNER')", "Str" = "concat('Os_', $N, '_RunningData.OwnerObjectID')"!][!//
[!CALL "ArtiExprIP", "Name" = "concat($N, '_LOCK_METHOD')", "Str" = "concat('Os_SpinlockConfig_', $N, '.OsSpinlockLockMethod')"!][!//
[!ENDLOOP!][!//
[!/* OS_CONFIG: static settings of the Os, shown like the ORTI OS_CONFIG object */!][!//
[!CALL "ArtiConst", "Name" = "'OsConfig_ScalabilityClass'", "Str" = "node:value(./OsOS/OsScalabilityClass)"!][!//
[!CALL "ArtiConst", "Name" = "'OsConfig_StatusLevel'", "Str" = "node:value(./OsOS/OsStatus)"!][!//
[!IF "node:value(./OsOS/OsStackMonitoring) = 'true'"!][!CALL "ArtiConst", "Name" = "'OsConfig_OsStackMonitoring'", "Str" = "'TRUE'"!][!ELSE!][!CALL "ArtiConst", "Name" = "'OsConfig_OsStackMonitoring'", "Str" = "'FALSE'"!][!ENDIF!][!//
[!LOOP "node:order(./OsAlarm/*,'@index')"!][!//
[!VAR "N" = "node:name(.)"!][!//
[!CALL "ArtiExprIP", "Name" = "concat($N, '_ACTION')", "Str" = "concat('Alarm_', $N, '_ConfigRef.ActionType')"!][!//
[!/* ORTI: ALARMTIME is not supported by the kernel */!][!//
[!CALL "ArtiConst", "Name" = "concat($N, '_ALARMTIME')", "Str" = "'0'"!][!//
[!ENDLOOP!][!//
[!/* ---- Trace hooks (SWS OS 7.17): one per enabled event of Os_ArtiEvents.m ---- */!][!//
[!LOOP "text:split($ArtiEvents, ';')"!][!//
[!CALL "ArtiHook", "Ctx" = "text:split(., ':')[1]", "Class" = "text:split(., ':')[2]", "Event" = "text:split(., ':')[3]", "TypeMap" = "text:split(., ':')[4]"!][!//
[!ENDLOOP!][!//
              </SUB-CONTAINERS>
            </ECUC-CONTAINER-VALUE>
<!-- ============================== ArtiOs ============================== -->
            <ECUC-CONTAINER-VALUE>
              <SHORT-NAME>ArtiOs</SHORT-NAME>
              <DEFINITION-REF DEST="ECUC-PARAM-CONF-CONTAINER-DEF">[!"$Def"!]/ArtiOs</DEFINITION-REF>
              <REFERENCE-VALUES>
[!IF "count(./OsEvent/*) > 0"!][!CALL "ArtiRef", "RefDef" = "'ArtiOs/ArtiOsGenericComponentRef'", "Target" = "concat($ArtiPkg, '/ArtiGeneric/GC_OsEvent')"!][!ENDIF!][!//
[!IF "count(./OsScheduleTable/*) > 0"!][!CALL "ArtiRef", "RefDef" = "'ArtiOs/ArtiOsGenericComponentRef'", "Target" = "concat($ArtiPkg, '/ArtiGeneric/GC_OsScheduleTable')"!][!ENDIF!][!//
[!IF "count(./OsSpinlock/*) > 0"!][!CALL "ArtiRef", "RefDef" = "'ArtiOs/ArtiOsGenericComponentRef'", "Target" = "concat($ArtiPkg, '/ArtiGeneric/GC_OsSpinlock')"!][!ENDIF!][!//
[!CALL "ArtiRef", "RefDef" = "'ArtiOs/ArtiOsGenericComponentRef'", "Target" = "concat($ArtiPkg, '/ArtiGeneric/GC_OsConfig')"!][!//
              </REFERENCE-VALUES>
              <SUB-CONTAINERS>
            <ECUC-CONTAINER-VALUE>
              <SHORT-NAME>ArtiOsClass</SHORT-NAME>
              <DEFINITION-REF DEST="ECUC-PARAM-CONF-CONTAINER-DEF">[!"$Def"!]/ArtiOs/ArtiOsClass</DEFINITION-REF>
              <REFERENCE-VALUES>
[!CALL "ArtiRef", "RefDef" = "'ArtiOs/ArtiOsClass/ArtiOsClassAppModeRef'", "Target" = "concat($ArtiPkg, '/ArtiValues/CP_AppMode')"!][!//
[!CALL "ArtiRef", "RefDef" = "'ArtiOs/ArtiOsClass/ArtiOsClassServiceTraceRef'", "Target" = "concat($ArtiPkg, '/ArtiValues/CP_ServiceTrace')"!][!//
[!CALL "ArtiRef", "RefDef" = "'ArtiOs/ArtiOsClass/ArtiOsClassGenericComponentRef'", "Target" = "concat($ArtiPkg, '/ArtiGeneric/GC_OsConfig')"!][!//
              </REFERENCE-VALUES>
            </ECUC-CONTAINER-VALUE>
            <ECUC-CONTAINER-VALUE>
              <SHORT-NAME>Os</SHORT-NAME>
              <DEFINITION-REF DEST="ECUC-PARAM-CONF-CONTAINER-DEF">[!"$Def"!]/ArtiOs/ArtiOsInstance</DEFINITION-REF>
              <REFERENCE-VALUES>
[!CALL "ArtiRef", "RefDef" = "'ArtiOs/ArtiOsInstance/ArtiOsInstanceAppModeRef'", "Target" = "concat($ArtiPkg, '/ArtiValues/IP_AppMode')"!][!//
[!CALL "ArtiRef", "RefDef" = "'ArtiOs/ArtiOsInstance/ArtiOsInstanceEcucRef'", "Target" = "concat($OsValuePkg, '/', node:name(./OsOS))"!][!//
[!/* Service trace is per core in the kernel; the OS-level attribute shows core 0, as ORTI did */!][!//
[!CALL "ArtiRef", "RefDef" = "'ArtiOs/ArtiOsInstance/ArtiOsInstanceServiceTraceRef'", "Target" = "concat($ArtiPkg, '/ArtiValues/IP_', $FirstCore, '_ServiceId')"!][!//
[!CALL "ArtiRef", "RefDef" = "'ArtiOs/ArtiOsInstance/ArtiOsInstanceGenericComponentRef'", "Target" = "concat($ArtiPkg, '/ArtiGeneric/GI_OsConfig')"!][!//
[!LOOP "text:split($ArtiEvents, ';')"!][!//
[!CALL "ArtiRef", "RefDef" = "'ArtiOs/ArtiOsInstance/ArtiOsInstanceHookRef'", "Target" = "concat($ArtiPkg, '/ArtiValues/H_', text:split(., ':')[3])"!][!//
[!ENDLOOP!][!//
              </REFERENCE-VALUES>
            </ECUC-CONTAINER-VALUE>
            <ECUC-CONTAINER-VALUE>
              <SHORT-NAME>ArtiOsTaskClass</SHORT-NAME>
              <DEFINITION-REF DEST="ECUC-PARAM-CONF-CONTAINER-DEF">[!"$Def"!]/ArtiOs/ArtiOsTaskClass</DEFINITION-REF>
              <REFERENCE-VALUES>
[!CALL "ArtiRef", "RefDef" = "'ArtiOs/ArtiOsTaskClass/ArtiOsTaskClassContextRef'", "Target" = "concat($ArtiPkg, '/ArtiValues/CP_TaskContext')"!][!//
[!CALL "ArtiRef", "RefDef" = "'ArtiOs/ArtiOsTaskClass/ArtiOsTaskClassCurrentTaskStateRef'", "Target" = "concat($ArtiPkg, '/ArtiValues/CP_TaskState')"!][!//
[!CALL "ArtiRef", "RefDef" = "'ArtiOs/ArtiOsTaskClass/ArtiOsTaskClassPriorityRef'", "Target" = "concat($ArtiPkg, '/ArtiValues/CP_TaskPriority')"!][!//
[!CALL "ArtiRef", "RefDef" = "'ArtiOs/ArtiOsTaskClass/ArtiOsTaskClassStackRef'", "Target" = "concat($ArtiPkg, '/ArtiValues/CP_TaskStack')"!][!//
[!IF "count(./OsTask/*) > 0"!][!CALL "ArtiRef", "RefDef" = "'ArtiOs/ArtiOsTaskClass/ArtiOsTaskClassClassGenericComponentRef'", "Target" = "concat($ArtiPkg, '/ArtiGeneric/GC_OsTask')"!][!ENDIF!][!//
              </REFERENCE-VALUES>
            </ECUC-CONTAINER-VALUE>
[!LOOP "node:order(./OsTask/*,'@index')"!][!//
[!VAR "N" = "node:name(.)"!][!//
            <ECUC-CONTAINER-VALUE>
              <SHORT-NAME>[!"$N"!]</SHORT-NAME>
              <DEFINITION-REF DEST="ECUC-PARAM-CONF-CONTAINER-DEF">[!"$Def"!]/ArtiOs/ArtiOsTaskInstance</DEFINITION-REF>
              <PARAMETER-VALUES>
                <ECUC-NUMERICAL-PARAM-VALUE>
                  <DEFINITION-REF DEST="ECUC-INTEGER-PARAM-DEF">[!"$Def"!]/ArtiOs/ArtiOsTaskInstance/ArtiOsTaskInstanceId</DEFINITION-REF>
                  <VALUE>[!"num:i(@index)"!]</VALUE>
                </ECUC-NUMERICAL-PARAM-VALUE>
              </PARAMETER-VALUES>
              <REFERENCE-VALUES>
[!CALL "ArtiRef", "RefDef" = "'ArtiOs/ArtiOsTaskInstance/ArtiOsTaskInstanceContextRef'", "Target" = "concat($ArtiPkg, '/ArtiValues/IP_', $N, '_Context')"!][!//
[!CALL "ArtiRef", "RefDef" = "'ArtiOs/ArtiOsTaskInstance/ArtiOsTaskInstanceCurrentActivationsRef'", "Target" = "concat($ArtiPkg, '/ArtiValues/IP_', $N, '_Activations')"!][!//
[!CALL "ArtiRef", "RefDef" = "'ArtiOs/ArtiOsTaskInstance/ArtiOsTaskInstanceCurrentTaskStateRef'", "Target" = "concat($ArtiPkg, '/ArtiValues/IP_', $N, '_State')"!][!//
[!CALL "ArtiRef", "RefDef" = "'ArtiOs/ArtiOsTaskInstance/ArtiOsTaskInstanceEcucRef'", "Target" = "concat($OsValuePkg, '/', $N)"!][!//
[!CALL "ArtiRef", "RefDef" = "'ArtiOs/ArtiOsTaskInstance/ArtiOsTaskInstancePriorityRef'", "Target" = "concat($ArtiPkg, '/ArtiValues/IP_', $N, '_Priority')"!][!//
[!CALL "ArtiRef", "RefDef" = "'ArtiOs/ArtiOsTaskInstance/ArtiOsTaskInstanceStackRef'", "Target" = "concat($ArtiPkg, '/ArtiValues/IP_', $N, '_StackBase')"!][!//
[!CALL "ArtiRef", "RefDef" = "'ArtiOs/ArtiOsTaskInstance/ArtiOsTaskInstanceGenericComponentRef'", "Target" = "concat($ArtiPkg, '/ArtiGeneric/GI_', $N)"!][!//
              </REFERENCE-VALUES>
            </ECUC-CONTAINER-VALUE>
[!ENDLOOP!][!//
            <ECUC-CONTAINER-VALUE>
              <SHORT-NAME>ArtiOsIsrClass</SHORT-NAME>
              <DEFINITION-REF DEST="ECUC-PARAM-CONF-CONTAINER-DEF">[!"$Def"!]/ArtiOs/ArtiOsIsrClass</DEFINITION-REF>
[!IF "count(./OsIsr/*) > 0"!][!//
              <REFERENCE-VALUES>
[!CALL "ArtiRef", "RefDef" = "'ArtiOs/ArtiOsIsrClass/ArtiOsIsrClassGenericComponentRef'", "Target" = "concat($ArtiPkg, '/ArtiGeneric/GC_OsIsr')"!][!//
              </REFERENCE-VALUES>
[!ENDIF!][!//
            </ECUC-CONTAINER-VALUE>
[!LOOP "node:order(./OsIsr/*,'@index')"!][!//
            <ECUC-CONTAINER-VALUE>
              <SHORT-NAME>[!"node:name(.)"!]</SHORT-NAME>
              <DEFINITION-REF DEST="ECUC-PARAM-CONF-CONTAINER-DEF">[!"$Def"!]/ArtiOs/ArtiOsIsrInstance</DEFINITION-REF>
              <PARAMETER-VALUES>
                <ECUC-TEXTUAL-PARAM-VALUE>
                  <DEFINITION-REF DEST="ECUC-ENUMERATION-PARAM-DEF">[!"$Def"!]/ArtiOs/ArtiOsIsrInstance/ArtiOsIsrInstanceCategory</DEFINITION-REF>
                  <VALUE>[!"node:value(./OsIsrCategory)"!]</VALUE>
                </ECUC-TEXTUAL-PARAM-VALUE>
                <ECUC-NUMERICAL-PARAM-VALUE>
                  <DEFINITION-REF DEST="ECUC-INTEGER-PARAM-DEF">[!"$Def"!]/ArtiOs/ArtiOsIsrInstance/ArtiOsIsrInstanceId</DEFINITION-REF>
                  <VALUE>[!"num:i(@index)"!]</VALUE>
                </ECUC-NUMERICAL-PARAM-VALUE>
              </PARAMETER-VALUES>
              <REFERENCE-VALUES>
[!CALL "ArtiRef", "RefDef" = "'ArtiOs/ArtiOsIsrInstance/ArtiOsIsrInstanceEcucRef'", "Target" = "concat($OsValuePkg, '/', node:name(.))"!][!//
[!CALL "ArtiRef", "RefDef" = "'ArtiOs/ArtiOsIsrInstance/ArtiOsIsrInstanceGenericComponentRef'", "Target" = "concat($ArtiPkg, '/ArtiGeneric/GI_', node:name(.))"!][!//
              </REFERENCE-VALUES>
            </ECUC-CONTAINER-VALUE>
[!ENDLOOP!][!//
[!CALL "ArtiEmptyClass", "Kind" = "'ArtiOsStackClass'"!][!//
[!LOOP "node:order(./OsTask/*,'@index')"!][!CALL "ArtiStack", "Name" = "node:name(.)"!][!ENDLOOP!][!//
[!LOOP "node:order(./OsIsr/*,'@index')"!][!IF "OsIsrCategory = 'CATEGORY_2'"!][!CALL "ArtiStack", "Name" = "node:name(.)"!][!ENDIF!][!ENDLOOP!][!//
[!CALL "ArtiEmptyClass", "Kind" = "'ArtiOsContextClass'"!][!//
[!LOOP "node:order(./OsTask/*,'@index')"!][!CALL "ArtiContext", "Name" = "node:name(.)"!][!ENDLOOP!][!//
[!LOOP "node:order(./OsIsr/*,'@index')"!][!IF "OsIsrCategory = 'CATEGORY_2'"!][!CALL "ArtiContext", "Name" = "node:name(.)"!][!ENDIF!][!ENDLOOP!][!//
[!IF "count(./OsAlarm/*) > 0"!][!//
            <ECUC-CONTAINER-VALUE>
              <SHORT-NAME>ArtiOsAlarmClass</SHORT-NAME>
              <DEFINITION-REF DEST="ECUC-PARAM-CONF-CONTAINER-DEF">[!"$Def"!]/ArtiOs/ArtiOsAlarmClass</DEFINITION-REF>
              <REFERENCE-VALUES>
[!CALL "ArtiRef", "RefDef" = "'ArtiOs/ArtiOsAlarmClass/ArtiOsAlarmClassStateRef'", "Target" = "concat($ArtiPkg, '/ArtiValues/CP_AlarmState')"!][!//
[!CALL "ArtiRef", "RefDef" = "'ArtiOs/ArtiOsAlarmClass/ArtiOsAlarmClassGenericComponentClassRef'", "Target" = "concat($ArtiPkg, '/ArtiGeneric/GC_OsAlarm')"!][!//
              </REFERENCE-VALUES>
            </ECUC-CONTAINER-VALUE>
[!ENDIF!][!//
[!LOOP "node:order(./OsAlarm/*,'@index')"!][!//
[!VAR "N" = "node:name(.)"!][!//
            <ECUC-CONTAINER-VALUE>
              <SHORT-NAME>[!"$N"!]</SHORT-NAME>
              <DEFINITION-REF DEST="ECUC-PARAM-CONF-CONTAINER-DEF">[!"$Def"!]/ArtiOs/ArtiOsAlarmInstance</DEFINITION-REF>
              <PARAMETER-VALUES>
                <ECUC-TEXTUAL-PARAM-VALUE>
                  <DEFINITION-REF DEST="ECUC-STRING-PARAM-DEF">[!"$Def"!]/ArtiOs/ArtiOsAlarmInstance/ArtiOsAlarmInstanceCounter</DEFINITION-REF>
                  <VALUE>[!"node:name(node:ref(./OsAlarmCounterRef))"!]</VALUE>
                </ECUC-TEXTUAL-PARAM-VALUE>
              </PARAMETER-VALUES>
              <REFERENCE-VALUES>
[!CALL "ArtiRef", "RefDef" = "'ArtiOs/ArtiOsAlarmInstance/ArtiOsAlarmInstanceCycleTimeRef'", "Target" = "concat($ArtiPkg, '/ArtiValues/IP_', $N, '_Cycle')"!][!//
[!CALL "ArtiRef", "RefDef" = "'ArtiOs/ArtiOsAlarmInstance/ArtiOsAlarmInstanceEcuCRef'", "Target" = "concat($OsValuePkg, '/', $N)"!][!//
[!CALL "ArtiRef", "RefDef" = "'ArtiOs/ArtiOsAlarmInstance/ArtiOsAlarmInstanceStateRef'", "Target" = "concat($ArtiPkg, '/ArtiValues/IP_', $N, '_State')"!][!//
[!CALL "ArtiRef", "RefDef" = "'ArtiOs/ArtiOsAlarmInstance/ArtiOsAlarmInstanceGenericComponentInstanceRef'", "Target" = "concat($ArtiPkg, '/ArtiGeneric/GI_', $N)"!][!//
              </REFERENCE-VALUES>
            </ECUC-CONTAINER-VALUE>
[!ENDLOOP!][!//
[!IF "count(./OsResource/*) > 0"!][!//
            <ECUC-CONTAINER-VALUE>
              <SHORT-NAME>ArtiOsResourceClass</SHORT-NAME>
              <DEFINITION-REF DEST="ECUC-PARAM-CONF-CONTAINER-DEF">[!"$Def"!]/ArtiOs/ArtiOsResourceClass</DEFINITION-REF>
              <REFERENCE-VALUES>
[!CALL "ArtiRef", "RefDef" = "'ArtiOs/ArtiOsResourceClass/ArtiOsResourceClassStateRef'", "Target" = "concat($ArtiPkg, '/ArtiValues/CP_ResourceState')"!][!//
[!CALL "ArtiRef", "RefDef" = "'ArtiOs/ArtiOsResourceClass/ArtiOsResourceClassGenericComponentClassRef'", "Target" = "concat($ArtiPkg, '/ArtiGeneric/GC_OsResource')"!][!//
              </REFERENCE-VALUES>
            </ECUC-CONTAINER-VALUE>
[!ENDIF!][!//
[!LOOP "node:order(./OsResource/*,'@index')"!][!//
[!VAR "N" = "node:name(.)"!][!//
            <ECUC-CONTAINER-VALUE>
              <SHORT-NAME>[!"$N"!]</SHORT-NAME>
              <DEFINITION-REF DEST="ECUC-PARAM-CONF-CONTAINER-DEF">[!"$Def"!]/ArtiOs/ArtiOsResourceInstance</DEFINITION-REF>
              <REFERENCE-VALUES>
[!CALL "ArtiRef", "RefDef" = "'ArtiOs/ArtiOsResourceInstance/ArtiOsResourceInstanceEcuCRef'", "Target" = "concat($OsValuePkg, '/', $N)"!][!//
[!CALL "ArtiRef", "RefDef" = "'ArtiOs/ArtiOsResourceInstance/ArtiOsResourceInstanceStateRef'", "Target" = "concat($ArtiPkg, '/ArtiValues/IP_', $N, '_State')"!][!//
[!CALL "ArtiRef", "RefDef" = "'ArtiOs/ArtiOsResourceInstance/ArtiOsResourceInstanceGenericComponentInstanceRef'", "Target" = "concat($ArtiPkg, '/ArtiGeneric/GI_', $N)"!][!//
              </REFERENCE-VALUES>
            </ECUC-CONTAINER-VALUE>
[!ENDLOOP!][!//
              </SUB-CONTAINERS>
            </ECUC-CONTAINER-VALUE>
<!-- ============================== ArtiHardware ============================== -->
            <ECUC-CONTAINER-VALUE>
              <SHORT-NAME>ArtiHardware</SHORT-NAME>
              <DEFINITION-REF DEST="ECUC-PARAM-CONF-CONTAINER-DEF">[!"$Def"!]/ArtiHardware</DEFINITION-REF>
              <SUB-CONTAINERS>
            <ECUC-CONTAINER-VALUE>
              <SHORT-NAME>ArtiHardwareCoreClass</SHORT-NAME>
              <DEFINITION-REF DEST="ECUC-PARAM-CONF-CONTAINER-DEF">[!"$Def"!]/ArtiHardware/ArtiHardwareCoreClass</DEFINITION-REF>
              <REFERENCE-VALUES>
[!CALL "ArtiRef", "RefDef" = "'ArtiHardware/ArtiHardwareCoreClass/ArtiHardwareCoreClassCurrentApplicationRef'", "Target" = "concat($ArtiPkg, '/ArtiValues/CP_CurrentApplication')"!][!//
[!CALL "ArtiRef", "RefDef" = "'ArtiHardware/ArtiHardwareCoreClass/ArtiHardwareCoreClassCurrentIsrRef'", "Target" = "concat($ArtiPkg, '/ArtiValues/CP_CurrentIsr')"!][!//
[!CALL "ArtiRef", "RefDef" = "'ArtiHardware/ArtiHardwareCoreClass/ArtiHardwareCoreClassCurrentTaskRef'", "Target" = "concat($ArtiPkg, '/ArtiValues/CP_CurrentTask')"!][!//
[!CALL "ArtiRef", "RefDef" = "'ArtiHardware/ArtiHardwareCoreClass/ArtiHardwareCoreClassLastErrorRef'", "Target" = "concat($ArtiPkg, '/ArtiValues/CP_LastError')"!][!//
[!CALL "ArtiRef", "RefDef" = "'ArtiHardware/ArtiHardwareCoreClass/ArtiHardwareCoreClassRunningTaskPriorityRef'", "Target" = "concat($ArtiPkg, '/ArtiValues/CP_RunningTaskPriority')"!][!//
              </REFERENCE-VALUES>
            </ECUC-CONTAINER-VALUE>
[!LOOP "node:order(./OsCoreIdMappingConfig/*,'@index')"!][!//
[!VAR "CoreNo" = "num:i(node:value(./OsPhysicalCoreId))"!][!IF "node:value(./OsCoreId) != ''"!][!VAR "CoreNo" = "num:i(node:ref(./OsCoreId)/EcucCoreId)"!][!ENDIF!][!//
[!VAR "Cn" = "concat('Core', $CoreNo)"!][!//
            <ECUC-CONTAINER-VALUE>
              <SHORT-NAME>[!"$Cn"!]</SHORT-NAME>
              <DEFINITION-REF DEST="ECUC-PARAM-CONF-CONTAINER-DEF">[!"$Def"!]/ArtiHardware/ArtiHardwareCoreInstance</DEFINITION-REF>
              <PARAMETER-VALUES>
                <ECUC-NUMERICAL-PARAM-VALUE>
                  <DEFINITION-REF DEST="ECUC-INTEGER-PARAM-DEF">[!"$Def"!]/ArtiHardware/ArtiHardwareCoreInstance/ArtiHardwareCoreInstanceCoreId</DEFINITION-REF>
                  <VALUE>[!"$CoreNo"!]</VALUE>
                </ECUC-NUMERICAL-PARAM-VALUE>
              </PARAMETER-VALUES>
              <REFERENCE-VALUES>
[!CALL "ArtiRef", "RefDef" = "'ArtiHardware/ArtiHardwareCoreInstance/ArtiHardwareCoreInstanceCurrentApplicationRef'", "Target" = "concat($ArtiPkg, '/ArtiValues/IP_', $Cn, '_CurrentApplication')"!][!//
[!CALL "ArtiRef", "RefDef" = "'ArtiHardware/ArtiHardwareCoreInstance/ArtiHardwareCoreInstanceCurrentIsrRef'", "Target" = "concat($ArtiPkg, '/ArtiValues/IP_', $Cn, '_RunningIsr')"!][!//
[!CALL "ArtiRef", "RefDef" = "'ArtiHardware/ArtiHardwareCoreInstance/ArtiHardwareCoreInstanceCurrentTaskRef'", "Target" = "concat($ArtiPkg, '/ArtiValues/IP_', $Cn, '_RunningTask')"!][!//
[!/* EB stores reference values with an "ASPath:" prefix; strip it so both engines emit a plain path */!][!//
[!IF "node:value(./OsCoreId) != ''"!][!//
[!CALL "ArtiRef", "RefDef" = "'ArtiHardware/ArtiHardwareCoreInstance/ArtiHardwareCoreInstanceEcucCoreRef'", "Target" = "text:replace(node:value(./OsCoreId), 'ASPath:', '')"!][!//
[!ENDIF!][!//
[!CALL "ArtiRef", "RefDef" = "'ArtiHardware/ArtiHardwareCoreInstance/ArtiHardwareCoreInstanceLastErrorRef'", "Target" = "concat($ArtiPkg, '/ArtiValues/IP_', $Cn, '_LastError')"!][!//
[!/* Same expression as the current task; CP_RunningTaskPriority decodes it to a priority */!][!//
[!CALL "ArtiRef", "RefDef" = "'ArtiHardware/ArtiHardwareCoreInstance/ArtiHardwareCoreInstanceRunningTaskPriorityRef'", "Target" = "concat($ArtiPkg, '/ArtiValues/IP_', $Cn, '_RunningTask')"!][!//
              </REFERENCE-VALUES>
            </ECUC-CONTAINER-VALUE>
[!ENDLOOP!][!//
              </SUB-CONTAINERS>
            </ECUC-CONTAINER-VALUE>
<!-- ============================== ArtiGeneric ============================== -->
            <ECUC-CONTAINER-VALUE>
              <SHORT-NAME>ArtiGeneric</SHORT-NAME>
              <DEFINITION-REF DEST="ECUC-PARAM-CONF-CONTAINER-DEF">[!"$Def"!]/ArtiGeneric</DEFINITION-REF>
              <SUB-CONTAINERS>
[!IF "count(./OsEvent/*) > 0"!][!//
[!CALL "ArtiGenClassOpen", "Class" = "'OsEvent'"!][!//
[!CALL "ArtiGenClassParam", "Class" = "'OsEvent'", "Param" = "'EVENTMASK'"!][!//
[!CALL "ArtiGenClassClose"!][!//
[!LOOP "node:order(./OsEvent/*,'@index')"!][!//
[!CALL "ArtiGenInstOpen", "Class" = "'OsEvent'", "Name" = "node:name(.)"!][!//
[!CALL "ArtiGenInstParam", "Class" = "'OsEvent'", "Name" = "node:name(.)", "Param" = "'EVENTMASK'"!][!//
[!CALL "ArtiGenInstClose"!][!//
[!ENDLOOP!][!//
[!ENDIF!][!//
[!IF "count(./OsTask/*) > 0"!][!//
[!CALL "ArtiGenClassOpen", "Class" = "'OsTask'"!][!//
[!CALL "ArtiGenClassParam", "Class" = "'OsTask'", "Param" = "'OSTASKTYPE'", "TypeMap" = "'TaskType'"!][!//
[!CALL "ArtiGenClassParam", "Class" = "'OsTask'", "Param" = "'OSTASKSCHEDULE'"!][!//
[!CALL "ArtiGenClassParam", "Class" = "'OsTask'", "Param" = "'OSTASKMAXACTIVATION'"!][!//
[!CALL "ArtiGenClassParam", "Class" = "'OsTask'", "Param" = "'REMAININGACTIVATIONS'"!][!//
[!CALL "ArtiGenClassParam", "Class" = "'OsTask'", "Param" = "'EVENTMASK'"!][!//
[!CALL "ArtiGenClassParam", "Class" = "'OsTask'", "Param" = "'EVENTSETFLAG'"!][!//
[!CALL "ArtiGenClassParam", "Class" = "'OsTask'", "Param" = "'LOCKED'", "TypeMap" = "'LockedByTask'"!][!//
[!CALL "ArtiGenClassClose"!][!//
[!LOOP "node:order(./OsTask/*,'@index')"!][!//
[!VAR "N" = "node:name(.)"!][!//
[!CALL "ArtiGenInstOpen", "Class" = "'OsTask'", "Name" = "$N"!][!//
[!CALL "ArtiGenInstParam", "Class" = "'OsTask'", "Name" = "$N", "Param" = "'OSTASKTYPE'", "Kind" = "'Expression'"!][!//
[!CALL "ArtiGenInstParam", "Class" = "'OsTask'", "Name" = "$N", "Param" = "'OSTASKSCHEDULE'"!][!//
[!CALL "ArtiGenInstParam", "Class" = "'OsTask'", "Name" = "$N", "Param" = "'OSTASKMAXACTIVATION'", "Kind" = "'Expression'"!][!//
[!CALL "ArtiGenInstParam", "Class" = "'OsTask'", "Name" = "$N", "Param" = "'REMAININGACTIVATIONS'", "Kind" = "'Expression'"!][!//
[!CALL "ArtiGenInstParam", "Class" = "'OsTask'", "Name" = "$N", "Param" = "'EVENTMASK'", "Kind" = "'Expression'"!][!//
[!CALL "ArtiGenInstParam", "Class" = "'OsTask'", "Name" = "$N", "Param" = "'EVENTSETFLAG'", "Kind" = "'Expression'"!][!//
[!CALL "ArtiGenInstParam", "Class" = "'OsTask'", "Name" = "$N", "Param" = "'LOCKED'", "Kind" = "'Expression'"!][!//
[!CALL "ArtiGenInstClose"!][!//
[!ENDLOOP!][!//
[!ENDIF!][!//
[!IF "count(./OsIsr/*) > 0"!][!//
[!CALL "ArtiGenClassOpen", "Class" = "'OsIsr'"!][!//
[!CALL "ArtiGenClassParam", "Class" = "'OsIsr'", "Param" = "'PRIORITY'"!][!//
[!CALL "ArtiGenClassParam", "Class" = "'OsIsr'", "Param" = "'LOCKED'", "TypeMap" = "'LockedByTask'"!][!//
[!CALL "ArtiGenClassClose"!][!//
[!LOOP "node:order(./OsIsr/*,'@index')"!][!//
[!VAR "N" = "node:name(.)"!][!//
[!CALL "ArtiGenInstOpen", "Class" = "'OsIsr'", "Name" = "$N"!][!//
[!CALL "ArtiGenInstParam", "Class" = "'OsIsr'", "Name" = "$N", "Param" = "'PRIORITY'", "Kind" = "'Expression'"!][!//
[!IF "OsIsrCategory = 'CATEGORY_2'"!][!CALL "ArtiGenInstParam", "Class" = "'OsIsr'", "Name" = "$N", "Param" = "'LOCKED'", "Kind" = "'Expression'"!][!ENDIF!][!//
[!CALL "ArtiGenInstClose"!][!//
[!ENDLOOP!][!//
[!ENDIF!][!//
[!IF "count(./OsScheduleTable/*) > 0"!][!//
[!CALL "ArtiGenClassOpen", "Class" = "'OsScheduleTable'"!][!//
[!CALL "ArtiGenClassParam", "Class" = "'OsScheduleTable'", "Param" = "'STATE'", "TypeMap" = "'ScheduleTableState'"!][!//
[!CALL "ArtiGenClassParam", "Class" = "'OsScheduleTable'", "Param" = "'SCHEDULETABLENEXT'", "TypeMap" = "'ScheduleTableNext'"!][!//
[!CALL "ArtiGenClassClose"!][!//
[!LOOP "node:order(./OsScheduleTable/*,'@index')"!][!//
[!VAR "N" = "node:name(.)"!][!//
[!CALL "ArtiGenInstOpen", "Class" = "'OsScheduleTable'", "Name" = "$N"!][!//
[!CALL "ArtiGenInstParam", "Class" = "'OsScheduleTable'", "Name" = "$N", "Param" = "'STATE'", "Kind" = "'Expression'"!][!//
[!CALL "ArtiGenInstParam", "Class" = "'OsScheduleTable'", "Name" = "$N", "Param" = "'SCHEDULETABLENEXT'", "Kind" = "'Expression'"!][!//
[!CALL "ArtiGenInstClose"!][!//
[!ENDLOOP!][!//
[!ENDIF!][!//
[!IF "count(./OsSpinlock/*) > 0"!][!//
[!CALL "ArtiGenClassOpen", "Class" = "'OsSpinlock'"!][!//
[!CALL "ArtiGenClassParam", "Class" = "'OsSpinlock'", "Param" = "'STATE'", "TypeMap" = "'SpinlockState'"!][!//
[!CALL "ArtiGenClassParam", "Class" = "'OsSpinlock'", "Param" = "'LOCKED'", "TypeMap" = "'LockedByResource'"!][!//
[!CALL "ArtiGenClassParam", "Class" = "'OsSpinlock'", "Param" = "'SPINLOCK_OWNER'", "TypeMap" = "$OwnerTypeMap"!][!//
[!CALL "ArtiGenClassParam", "Class" = "'OsSpinlock'", "Param" = "'LOCK_METHOD'", "TypeMap" = "'SpinlockLockMethod'"!][!//
[!CALL "ArtiGenClassClose"!][!//
[!LOOP "node:order(./OsSpinlock/*,'@index')"!][!//
[!VAR "N" = "node:name(.)"!][!//
[!CALL "ArtiGenInstOpen", "Class" = "'OsSpinlock'", "Name" = "$N"!][!//
[!CALL "ArtiGenInstParam", "Class" = "'OsSpinlock'", "Name" = "$N", "Param" = "'STATE'", "Kind" = "'Expression'"!][!//
[!CALL "ArtiGenInstParam", "Class" = "'OsSpinlock'", "Name" = "$N", "Param" = "'LOCKED'", "Kind" = "'Expression'"!][!//
[!CALL "ArtiGenInstParam", "Class" = "'OsSpinlock'", "Name" = "$N", "Param" = "'SPINLOCK_OWNER'", "Kind" = "'Expression'"!][!//
[!CALL "ArtiGenInstParam", "Class" = "'OsSpinlock'", "Name" = "$N", "Param" = "'LOCK_METHOD'", "Kind" = "'Expression'"!][!//
[!CALL "ArtiGenInstClose"!][!//
[!ENDLOOP!][!//
[!ENDIF!][!//
[!/* OS_CONFIG: one instance, named OsConfig (an Os object with that name would clash on GI_OsConfig) */!][!//
[!CALL "ArtiGenClassOpen", "Class" = "'OsConfig'"!][!//
[!CALL "ArtiGenClassParam", "Class" = "'OsConfig'", "Param" = "'ScalabilityClass'"!][!//
[!CALL "ArtiGenClassParam", "Class" = "'OsConfig'", "Param" = "'StatusLevel'"!][!//
[!CALL "ArtiGenClassParam", "Class" = "'OsConfig'", "Param" = "'OsStackMonitoring'"!][!//
[!CALL "ArtiGenClassClose"!][!//
[!CALL "ArtiGenInstOpen", "Class" = "'OsConfig'", "Name" = "'OsConfig'"!][!//
[!CALL "ArtiGenInstParam", "Class" = "'OsConfig'", "Name" = "'OsConfig'", "Param" = "'ScalabilityClass'"!][!//
[!CALL "ArtiGenInstParam", "Class" = "'OsConfig'", "Name" = "'OsConfig'", "Param" = "'StatusLevel'"!][!//
[!CALL "ArtiGenInstParam", "Class" = "'OsConfig'", "Name" = "'OsConfig'", "Param" = "'OsStackMonitoring'"!][!//
[!CALL "ArtiGenInstClose"!][!//
[!IF "count(./OsAlarm/*) > 0"!][!//
[!CALL "ArtiGenClassOpen", "Class" = "'OsAlarm'"!][!//
[!CALL "ArtiGenClassParam", "Class" = "'OsAlarm'", "Param" = "'ACTION'", "TypeMap" = "'AlarmAction'"!][!//
[!CALL "ArtiGenClassParam", "Class" = "'OsAlarm'", "Param" = "'ALARMTIME'"!][!//
[!CALL "ArtiGenClassClose"!][!//
[!LOOP "node:order(./OsAlarm/*,'@index')"!][!//
[!VAR "N" = "node:name(.)"!][!//
[!CALL "ArtiGenInstOpen", "Class" = "'OsAlarm'", "Name" = "$N"!][!//
[!CALL "ArtiGenInstParam", "Class" = "'OsAlarm'", "Name" = "$N", "Param" = "'ACTION'", "Kind" = "'Expression'"!][!//
[!CALL "ArtiGenInstParam", "Class" = "'OsAlarm'", "Name" = "$N", "Param" = "'ALARMTIME'"!][!//
[!CALL "ArtiGenInstClose"!][!//
[!ENDLOOP!][!//
[!ENDIF!][!//
[!IF "count(./OsResource/*) > 0"!][!//
[!CALL "ArtiGenClassOpen", "Class" = "'OsResource'"!][!//
[!CALL "ArtiGenClassParam", "Class" = "'OsResource'", "Param" = "'LOCKED'", "TypeMap" = "'LockedByResource'"!][!//
[!CALL "ArtiGenClassParam", "Class" = "'OsResource'", "Param" = "'RESOURCE_OWNER'", "TypeMap" = "$OwnerTypeMap"!][!//
[!CALL "ArtiGenClassParam", "Class" = "'OsResource'", "Param" = "'PRIORITY_TYPE'"!][!//
[!CALL "ArtiGenClassParam", "Class" = "'OsResource'", "Param" = "'PRIORITY'"!][!//
[!CALL "ArtiGenClassClose"!][!//
[!LOOP "node:order(./OsResource/*,'@index')"!][!//
[!VAR "N" = "node:name(.)"!][!//
[!CALL "ArtiGenInstOpen", "Class" = "'OsResource'", "Name" = "$N"!][!//
[!CALL "ArtiGenInstParam", "Class" = "'OsResource'", "Name" = "$N", "Param" = "'LOCKED'", "Kind" = "'Expression'"!][!//
[!CALL "ArtiGenInstParam", "Class" = "'OsResource'", "Name" = "$N", "Param" = "'RESOURCE_OWNER'", "Kind" = "'Expression'"!][!//
[!CALL "ArtiGenInstParam", "Class" = "'OsResource'", "Name" = "$N", "Param" = "'PRIORITY_TYPE'", "Kind" = "'Expression'"!][!//
[!CALL "ArtiGenInstParam", "Class" = "'OsResource'", "Name" = "$N", "Param" = "'PRIORITY'", "Kind" = "'Expression'"!][!//
[!CALL "ArtiGenInstClose"!][!//
[!ENDLOOP!][!//
[!ENDIF!][!//
              </SUB-CONTAINERS>
            </ECUC-CONTAINER-VALUE>
          </CONTAINERS>
        </ECUC-MODULE-CONFIGURATION-VALUES>
      </ELEMENTS>
    </AR-PACKAGE>
  </AR-PACKAGES>
</AUTOSAR>
[!ELSE!][!//
<!-- OsUseArti is disabled: no ARTI description is generated. -->
<AUTOSAR xmlns="http://autosar.org/schema/r4.0" xmlns:xsi="http://www.w3.org/2001/XMLSchema-instance" xsi:schemaLocation="http://autosar.org/schema/r4.0 AUTOSAR_00047.xsd"/>
[!ENDIF!][!//
[!ENDSELECT!][!//
