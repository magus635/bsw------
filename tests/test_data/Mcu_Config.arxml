AUTOSAR XML (schema 4.0)
package /McuConfig
  module config Mcu
    McuGeneralConfig: McuDevErrorDetect=true, McuDmaEnable=true
    McuClockConfig
      McuClockSource_PLL (McuClockSource): McuClockFrequency=80000000, McuClockSourceType=MCU_CLOCK_PLL
