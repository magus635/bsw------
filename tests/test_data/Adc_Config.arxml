AUTOSAR XML (schema 4.0)
package /AdcConfig
  module config Adc
    AdcConfigSet:
      AdcPrescale = 128
      AdcResolution = ADC_RESOLUTION_12BIT
      AdcDevErrorDetect = true
      AdcSamplingTime = 56
      AdcDmaEnable = true
      AdcClockSourceRef = McuClockSource_PLL
