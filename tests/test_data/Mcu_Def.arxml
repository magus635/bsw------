AUTOSAR XML (schema 4.0)
package /AUTOSAR/EcucDefs
  module definition Mcu  # MCU Driver Module
    container McuClockConfig
      container McuClockSource
        integer McuClockFrequency: 1000000..200000000, default-value=80000000
        enumeration McuClockSourceType: {MCU_CLOCK_INTERNAL, MCU_CLOCK_PLL}, default-value=MCU_CLOCK_PLL
