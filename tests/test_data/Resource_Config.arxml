AUTOSAR XML (schema 4.0)
package /ResourceConfig
  module config Resource
    ResourceGeneral: NumOfCores=4
    ResourceCoreConfigSet
      4 x ResourceCoreConfig:
        ResourceCoreConfig_0: ResourceCoreId=CORE0, ResourceCoreEnable=true
        ResourceCoreConfig_1: ResourceCoreId=CORE1, ResourceCoreEnable=true
        ResourceCoreConfig_2: ResourceCoreId=CORE2, ResourceCoreEnable=false
        ResourceCoreConfig_3: ResourceCoreId=CORE3, ResourceCoreEnable=false
