AUTOSAR XML (schema 4.0)
package /AUTOSAR/EcucDefs
  module definition Adc  # ADC Driver Module
    container AdcConfigSet
      integer AdcPrescale: 1..256, default-value=8
      enumeration AdcResolution: {ADC_RESOLUTION_8BIT, ADC_RESOLUTION_12BIT}, default-value=ADC_RESOLUTION_12BIT
      reference AdcClockSourceRef: destination=McuClockSource  # Reference to MCU clock
