AUTOSAR XML (schema 4.0)
package /AUTOSAR/EcucDefs
  module definition Resource  # Resource Manager Module for Multi-Core Resource Allocation
    container ResourceCoreConfigSet  # Container for core configuration set
      container ResourceCoreConfig [1..*]  # Configuration for a single core
        string ResourceCoreId: default-value=CORE0  # Identifier of the core (e.g., CORE0, CORE1)
        boolean ResourceCoreEnable: default-value=true  # Enable or disable this core
        container ResourceAllocation [1..*]  # Allocation of a module resource to this core
          string ResourceModule: default-value=CAN  # Name of the module (e.g., CAN, SPI, ADC)
          reference ResourceModuleRef: destination=CanController  # Reference to the specific module instance (e.g., CanController)
    container ResourceGeneral  # General resource configuration
      integer NumOfCores: 1..8, default-value=4  # Total number of cores available in the MCU
