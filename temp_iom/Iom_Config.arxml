AUTOSAR XML (schema 4-4-0)
package /Iom
  module config Iom: implementation-config-variant=VARIANT-POST-BUILD
    CommonPublishedInformation:
      ArReleaseMajorVersion = 4
      ArReleaseMinorVersion = 4
      ArReleaseRevisionVersion = 0
      ModuleId = 255
      SwMajorVersion = 1
      SwMinorVersion = 2
      SwPatchVersion = 0
      VendorId = 175
    IomGeneralConfiguration: IomDevErrorDetect=1, IomGetPpuGlitchApi=1, IomGtmExor=0, IomPpuFilterApi=1, IomPpuPrecalerApi=0, IomSafetyErrorDetect=1, IomVersionInfoApi=1
    IomModuleConfiguration: index=0
      IomClkConfiguration: IomClkConfiguration=1
      IomEMUConfiguration
        IomEventCombModCount:
          BlockEventOutputRunTime = 1
          IomEMUThreshold0 = IOM_EVENTCOUNTERTHRESHOLD_10
          IomEMUThreshold{1..3} = IOM_EVENTCOUNTERTHRESHOLD_DISABLE
      IomGtmConfiguration:
        IomGtmInput{0..7} = IOM_DISABLE_GTM_INPUT
      IomLPUConfiguration_0 (IomLPUConfiguration):
        index = 0
        IomLPUEveActiveEdgeSelect = IOM_LPUEVENTTRIGGER_FALLINGEDGE
        IomLPUEveWinActiveEdgeSelect = IOM_LPUEVENTWINDOWCLEAREVENT_RISINGEDGE
        IomLPUEventSrcSelect = IOM_LPUEVENTSOURCE_MON
        IomLPUEventWinSelect = IOM_LPUEVENTWINDOWCONTROLSOURCE_MON
        IomLPUEventWinTime = 0
        IomLPUInvEventWin = 1
        IomLPUInvMonSignal = 0
        IomLPUInvReferSignal = 0
        IomLPUMonInputSel = CH2
        IomLPURefInputSel = CH3
        IomLPURunMode = IOM_LPUEVENTWINDOWRUNCONTROL_FREERUNNING
        IomLPUUnitNo = 0
        IomLPUchannelInputEMUSel = IOM_EVENTCOUNTERCHANNEL_NOCOUNTER
      IomPPUConfiguration_2 (IomPPUConfiguration):
        index = 0
        IomPPUFilterMode = BOTHEDGES_DD
        IomPPUFilterTime = 1
        IomPPUMonInputSel = CHANNEL0_IOM_MONINPUT_GTMTOUT24
        IomPPUPrescalerCompareVal = 0
        IomPPUReferInputSel = CHANNEL0_IOM_REFINPUT_GTMTOUT2
        IomPPUUnitNo = 2
      IomPPUConfiguration_3 (IomPPUConfiguration):
        index = 1
        IomPPUFilterMode = BOTHEDGES_DD
        IomPPUFilterTime = 1
        IomPPUMonInputSel = CHANNEL0_IOM_MONINPUT_GTMTOUT25
        IomPPUPrescalerCompareVal = 0
        IomPPUReferInputSel = CHANNEL0_IOM_REFINPUT_GTMTOUT3
        IomPPUUnitNo = 3
