AUTOSAR XML (schema 00046)
package /THA6_AS440_FuSa
  ecuc definition collection Dio_EcuParameterDefinition: module=Dio
  module definition Dio [0..1]: refined-module-def=Dio, variants pre-compile  # None
    container DioConfig  # This container contains the configuration parameters and sub containers of the AUTOSAR DIO module.
      container DioPort [1..40]: multiplicity set at pre-compile, requires-index=true  # Configuration of individual DIO ports, consisting of channels and possible channel groups. Note: This container definition does not explicitly define a symbolic name parameter.Instead, the container's short name will be used in the Ecu Configuration Description to specify the symbolic name of the port. This symbolic name is #defined in the code. Hence the container's short name must be unique and should not clash with other symbolic names and published symbolic names. Also they must comply with C standard. Refer to AUTOSAR_SWS_DIO_Driver.pdf for an example on the configuration of the DIO module
        integer DioPortId: 0..40, set at pre-compile, default-value=0  # Numeric identifier of the DIO port. Notes: 1. This numeric value should correspond to the port number. E.g.: Port0 should be numbered 0, Port1 as 1, ... , Port40 as 40. 2. This value will be assigned to the DIO port symbolic name (i.e. the SHORT-NAME of the container DioPort). 3. Not all MCU ports may be used for DIO, thus there may be "gaps" in the list of all IDs.
        reference DioPortEcucPartitionRef [0..*]: scope=ECU, multiplicity set at pre-compile, set at pre-compile, destination=EcucPartition  # Maps the Dio Port to zero a multiple ECUC partitions. The ECUC partitions referenced are a subset of the ECUC partitions where the Dio driver is mapped to. Tags: atp.Status=draft
        container DioChannel [0..16]: multiplicity set at pre-compile, requires-index=true  # Container for configuration of an individual DIO channel. Note: Besides a HW specific channel name which is typically fixed for a specific micro controller, additional symbolic names can be defined per channel. This container definition does not explicitly define a symbolic name parameter. Instead, the container's short name will be used in the Ecu Configuration Description to specify the symbolic name of the channel. This symbolic name is #defined in the code. Hence the container's short name must be unique and should not clash with other symbolic names and published symbolic names. Also they must comply with C standard.
          integer DioChannelId: 0..15, set at pre-compile, default-value=0  # Numeric identifier of the DIO channel. Notes: 1. This numeric value should correspond to the pin number within the port 2. This value will be assigned to the DIO channel symbolic name (i.e. the SHORT-NAME of the container DioChannel).
          reference DioChannelEcucPartitionRef [0..*]: scope=ECU, multiplicity set at pre-compile, set at pre-compile, destination=EcucPartition  # Maps the Dio Channel to zero a multiple ECUC partitions. The ECUC partitions referenced are a subset of the ECUC partitions where the related Dio port is mapped to. Tags: atp.Status=draft
        container DioChannelGroup [0..*]: multiplicity set at pre-compile, requires-index=true  # Container for configuration of DIO channel groups. A channel group represents several adjoining DIO channels represented by a logical group. A DIO channel group shall belong to only one DIO port. To specify a DIO channel group, the mask and the offset values are to be defined by the user. There can be as many groups as required by the user.
          string DioChannelGroupIdentification: set at pre-compile, default-value=DioChGrpId_P0_0  # Identifier of the DIO channel group. The DIO channel group configuration is stored as a data sturcture of type Dio_ChannelGroupType. A DIO channel group is identified in the APIs of the DIO driver by a pointer to this configuration data structure. The string in this parameter will be used as the symbolic name for identifying the Dio Channel group. This symbolic name is #defined in the code with the pointer to the configuration data structure assigned to it. Hence this symbolic name must be unique and should not clash with other symbolic names and published symbolic names. Also they must comply with C standard. While calling the API to operate on this Dio channel group, this identifier is to be inserted in the API call of the calling module to get the address of the variable in memory which holds the channel group information.
          integer DioPortMask: 0..65535, set at pre-compile, default-value=0  # Configuration of the mask value for identifying the channel group within a Port. This parameter shall be the mask which defines the positions of the channelgroup. The data type depends on the port width. For e.g., consider an 8-bit port whose channels 4:1 form the channel group. In this case the mask value must be 0x1E.
          integer DioPortOffset: 0..15, set at pre-compile, derivation=informal-formula=verbatim=l-5=position of the first bit of dioportmask which is set to '1' counted from lsb, default-value=0  # The position of the Channel Group on the port, counted from the LSB.calculationFormula = Position of the first bit of DioPortMask which is set to value 1 counted from LSB .The user need not edit the value of this parameter, since its value is derived from the value of DioPortMaskby the code generator.
          reference DioChannelGroupEcucPartitionRef [0..*]: scope=ECU, multiplicity set at pre-compile, set at pre-compile, destination=EcucPartition  # Maps the Dio Channel Group to zero a multiple ECUC partitions. The ECUC partitions referenced are a subset of the ECUC partitions where the related Dio port is mapped to. Tags: atp.Status=draft
    container DioGeneral  # General DIO module configuration parameters.
      boolean DioDevErrorDetect: set at pre-compile, default-value=false  # Pre-processor switch to enable/disable the Development Error Detection and Notification - STD_ON : Development Error Detection and notification is enabled - STD_OFF: Development Error Detection and notification is disabled
      boolean DioFlipChannelApi: set at pre-compile, default-value=false  # Pre-processor switch to add / remove the service Dio_FlipChannel() from the code - STD_ON : The API Dio_FlipChannel() is available in the code - STD_OFF: The API Dio_FlipChannel() is not available in the code
      boolean DioMaskedWritePortApi: set at pre-compile, default-value=false  # Adds / removes the service Dio_MaskedWritePort() from the code.
      boolean DioVersionInfoApi: set at pre-compile, default-value=false  # Pre-processor switch to add / remove the service Dio_GetVersionInfo() from the code - STD_ON : The API Dio_GetVersionInfo() is available in the code - STD_OFF: The API Dio_GetVersionInfo() is not available in the code
      reference DioEcucPartitionRef [0..*]: scope=ECU, multiplicity set at pre-compile, set at pre-compile, destination=EcucPartition  # Maps the Dio driver to zero a multiple ECUC partitions to make the modules API available in this partition. Tags: atp.Status=draft
    container CommonPublishedInformation  # Common container, aggregated by all modules. It contains published information about vendor and versions.
      integer ArReleaseMajorVersion: 0..255, origin=ChipowerTech, set at published-information, default-value=4  # Major version number of AUTOSAR specification on which the appropriate implementation is based on.
      integer ArReleaseMinorVersion: 0..255, origin=ChipowerTech, set at published-information, default-value=4  # Minor version number of AUTOSAR specification on which the appropriate implementation is based on.
      integer ArReleaseRevisionVersion: 0..255, origin=ChipowerTech, set at published-information, default-value=0  # Revision version number of AUTOSAR specification on which the appropriate implementation is based on.
      integer ModuleId: 0..255, origin=ChipowerTech, set at published-information, default-value=120  # Module ID of this module from Module List
      integer SwMajorVersion: 0..255, origin=ChipowerTech, set at published-information, default-value=1  # Major version number of the vendor specific implementation of the module. The numbering is vendor specific.
      integer SwMinorVersion: 0..255, origin=ChipowerTech, set at published-information, default-value=0  # Minor version number of the vendor specific implementation of the module. The numbering is vendor specific.
      integer SwPatchVersion: 0..255, origin=ChipowerTech, set at published-information, default-value=0  # Patch level version number of the vendor specific implementation of the module. The numbering is vendor specific.
      integer VendorId: 0..255, origin=ChipowerTech, set at published-information, default-value=175  # Vendor ID of the dedicated implementation of this module according to the AUTOSAR vendor list.
