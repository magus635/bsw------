AUTOSAR XML (schema 4-4-0)
package /Configuration
  AUTOSAR (): uuid=adbe47b7-8beb-413d-86e4-c237b8e45938
    THA6_AS440_FuSa (): uuid=03aaeb7e-a92d-421f-9e03-dc3c6b7a87b7
      Can (): uuid=42a0fa76-ea29-47d7-8bdf-517a214b4fa1  # This container holds the configuration of a single CAN Driver.
        17 x :
          CanConfigSet: uuid=534b6a93-2780-415f-918a-9d5e75f16dc1  # This container contains the configuration parameters and sub containers of the AUTOSAR Can module.
            11 x parameter:
              CanControllerActivation: value=false, type=BOOLEAN, uuid=0ac634ed-c37f-427c-8433-9a5b4e8d6094  # Defines if a CAN controller is used in the configuration.
              CanControllerBaseAddress: value=0, type=INTEGER, min-value=0, max-value=4294967295, uuid=8fe41244-4781-4ab2-ab97-22591f1171f1  # Specifies the CAN controller base address.
              CanHardwareChannel: value=CAN_CONTROLLER_00, type=ENUM, uuid=04f808a6-15f4-4ea6-8c96-e683ff0a896d  # This parameter provides the Real Hardware controller ID which is unique in the CAN Driver
              CanControllerId: value=1, type=INTEGER, min-value=0, max-value=255, uuid=aeb66391-50f5-462b-bfe0-08110c15bebc  # This parameter provides the controller ID which is unique in a given CAN Driver. The value for this parameter starts with 0 and continue without any gaps.
              CanRxProcessing: value=POLLING, type=ENUM, uuid=d8ecb590-ef9c-4649-ad18-78f9674d5867  # Enables / disables API Can_MainFunction_Read() for handling PDU reception events in polling mode.
              CanTxProcessing: value=POLLING, type=ENUM, uuid=891b276c-ddcf-4628-96e1-ca2199302ba8  # Enables / disables API Can_MainFunction_Write() for handling PDU transmission events in polling mode.
              CanBusoffProcessing: value=POLLING, type=ENUM, uuid=21ab64ac-fb8b-4fcd-ad8f-47090a4cc61f  # Enables / disables API Can_MainFunction_BusOff() for handling busoff events in polling mode.
              CanWakeupProcessing: value=POLLING, type=ENUM, uuid=71a190da-cdcf-47f4-ace9-97514703ec04  # Enables / disables API Can_MainFunction_Wakeup() for handling wakeup events in polling mode.
              CanWakeupFunctionalityAPI: value=false, type=BOOLEAN, uuid=a2fa6a09-d053-4c7d-839a-df8221c354fa  # Adds / removes the service Can_CheckWakeup() from the code.
              CanFDSupport: value=false, type=BOOLEAN, uuid=ce771f09-5ee5-462d-abbf-33d980a4c198  # Selects support of CanFD features in Can driver.
              CanWakeupSupport: value=false, type=BOOLEAN, uuid=4fbc957b-100c-4d46-a820-b7ccee656a8e  # CAN driver support for wakeup over CAN Bus.
            12 x :
              CanController: uuid=9be929d0-b297-4ef4-aebf-6f84c09c6700  # This container contains the configuration parameters of the CAN controller(s).
                11 x parameter:
                  CanControllerActivation: value=false, type=BOOLEAN, uuid=6f02eebf-9858-4c83-89df-c26d5aa3aece  # Defines if a CAN controller is used in the configuration.
                  CanControllerBaseAddress: value=0, type=INTEGER, min-value=0, max-value=4294967295, uuid=0803784f-f65d-4760-ae59-3e6cd12302f0  # Specifies the CAN controller base address.
                  CanHardwareChannel: value=CAN_CONTROLLER_00, type=ENUM, uuid=55b30030-a574-49fc-98cd-abfab47f9ee6  # This parameter provides the Real Hardware controller ID which is unique in the CAN Driver
                  CanControllerId: value=1, type=INTEGER, min-value=0, max-value=255, uuid=46de9ade-e631-4d22-9f47-8248a300ccec  # This parameter provides the controller ID which is unique in a given CAN Driver. The value for this parameter starts with 0 and continue without any gaps.
                  CanRxProcessing: value=POLLING, type=ENUM, uuid=e0ba7dea-953d-4010-8418-384ea13f7ad0  # Enables / disables API Can_MainFunction_Read() for handling PDU reception events in polling mode.
                  CanTxProcessing: value=POLLING, type=ENUM, uuid=6179e9f2-2663-44d7-8530-73173866508a  # Enables / disables API Can_MainFunction_Write() for handling PDU transmission events in polling mode.
                  CanBusoffProcessing: value=POLLING, type=ENUM, uuid=0135e42d-b16c-48be-a4b5-59ed00e49b57  # Enables / disables API Can_MainFunction_BusOff() for handling busoff events in polling mode.
                  CanWakeupProcessing: value=POLLING, type=ENUM, uuid=f7814e59-7655-4aaf-93b0-67ae8cdc68ea  # Enables / disables API Can_MainFunction_Wakeup() for handling wakeup events in polling mode.
                  CanWakeupFunctionalityAPI: value=false, type=BOOLEAN, uuid=5b175f0d-1d5e-48d7-aacd-1e1606b25cb0  # Adds / removes the service Can_CheckWakeup() from the code.
                  CanFDSupport: value=false, type=BOOLEAN, uuid=6f4366ee-e054-4255-9979-116c34da83ba  # Selects support of CanFD features in Can driver.
                  CanWakeupSupport: value=false, type=BOOLEAN, uuid=2f1b33d3-9084-4b4e-8746-be00ae241dfb  # CAN driver support for wakeup over CAN Bus.
                3 x :
                  CanControllerBaudrateConfig: uuid=8ed84d5c-905a-4056-a504-ff1676edd8cf  # This container contains bit timing related configuration parameters of the CAN controller(s).
                    7 x parameter:
                      CanControllerBaudRateConfigID: value=0, type=INTEGER, min-value=0, max-value=65535, uuid=a1bf5db5-f875-4965-b17a-4e66a3bf9f86  # Uniquely identifies a specific baud rate configuration. This ID is used by SetBaudrate API.
                      CanControllerBaudRate: value=0.0, type=FLOAT, min-value=0.0, max-value=1000.0, uuid=968fa8ca-b448-44ea-a9fb-0e7fee625732  # Specifies the baudrate of the controller in kbps.
                      CanControllerPRESDIV: value=2, type=INTEGER, min-value=0, max-value=511, uuid=081dedb4-65ac-4a65-8d0e-0c9f909ebe56  # Specifies the Prescaler Division Factor.Defines the ratio between the module clock frequency and the serial clock frequency.
                      CanControllerPropSeg: value=7, type=INTEGER, min-value=0, max-value=255, uuid=628cc1b1-6fcb-4441-b551-f87c6cb34eb6  # Specifies propagation delay in time quantas.
                      CanControllerSeg1: value=7, type=INTEGER, min-value=0, max-value=255, uuid=035e76ef-a58c-473d-8584-9c7673ec97a4  # Specifies phase segment 1 in time quantas.
                      CanControllerSeg2: value=2, type=INTEGER, min-value=0, max-value=127, uuid=ce08e8dd-ff32-48a7-b8db-ac08de6b75ad  # Specifies phase segment 2 in time quantas.
                      CanControllerSyncJumpWidth: value=1, type=INTEGER, min-value=0, max-value=127, uuid=29aea631-9c9d-4caf-bd76-010a4d16602f  # Specifies the synchronization jump width for the controller in time quantas.
                    CanControllerFdBaudrateConfig (): uuid=8000f101-c4ad-4870-8399-a358a0ebad12  # This optional container contains bit timing related configuration parameters of the CAN controller(s) for payload and CRC of a CAN FD frame. If this container exists the controller supports CAN FD frames.
                      9 x parameter:
                        CanControllerFdBaudRate: value=0.0, type=FLOAT, min-value=0.0, max-value=8000.0, uuid=3a99d32b-0f46-40a1-a4b3-dc647c0f0278  # Specifies the data segment baud rate of the controller in kbps.
                        CanControllerFdBaudRatePRESDIV: value=1, type=INTEGER, min-value=0, max-value=31, uuid=27310fe5-d1e4-456d-add7-befc470b0f21  # Specifies the Extended Prescaler Division Factor.
                        CanControllerPropSeg: value=3, type=INTEGER, min-value=0, max-value=31, uuid=8a2a1a42-1af3-437c-96ce-6d10daa3cd19  # Specifies propagation delay in time quantas.
                        CanControllerSeg1: value=3, type=INTEGER, min-value=0, max-value=31, uuid=40089929-2c51-4fea-ba92-e120eeaee06a  # Specifies phase segment 1 in time quantas.
                        CanControllerSeg2: value=1, type=INTEGER, min-value=0, max-value=15, uuid=cc2d9e8e-7815-499a-8e7a-4154a24cb820  # Specifies phase segment 2 in time quantas.
                        CanControllerSyncJumpWidth: value=3, type=INTEGER, min-value=0, max-value=15, uuid=5579ce58-393b-4b61-be18-a26f113fed25  # Specifies the synchronization jump width for the controller in time quantas.
                        CanControllerSspOffset: value=0, type=INTEGER, min-value=0, max-value=127, uuid=8941ac9d-7447-49f2-8e95-aa52a7a3b3a9  # Specifies the Transmitter Delay Compensation Offset in minimum time quanta.
                        CanFDBytePayload: value=64, type=INTEGER, min-value=0, max-value=64, uuid=28613625-0228-401d-b679-0c0c0084562d  # Data Length Code:<br/> CAN and CAN FD: transmit frame has 0-8 data bytes.<br/> CAN FD: transmit frame has 12/16/20/24/32/48/64 data bytes.
                        CanControllerTxBitRateSwitch: value=true, type=BOOLEAN, uuid=b0b73032-0d3c-40e4-9fe2-a645d105381f  # Specifies if the bit rate switching shall be used for transmissions.
                  CanControllerFdBaudrateConfig: uuid=8814bb76-c685-46d9-9d4f-9675e4c95b41  # This optional container contains bit timing related configuration parameters of the CAN controller(s) for payload and CRC of a CAN FD frame. If this container exists the controller supports CAN FD frames.
                    9 x parameter:
                      CanControllerFdBaudRate: value=0.0, type=FLOAT, min-value=0.0, max-value=8000.0, uuid=6b7c4935-1514-4c71-b9c8-93a42faeae15  # Specifies the data segment baud rate of the controller in kbps.
                      CanControllerFdBaudRatePRESDIV: value=1, type=INTEGER, min-value=0, max-value=31, uuid=1653d080-65b0-4ae5-a0f0-bd59ea3cc4f2  # Specifies the Extended Prescaler Division Factor.
                      CanControllerPropSeg: value=3, type=INTEGER, min-value=0, max-value=31, uuid=bbb21aa5-ab9a-4c0c-a93d-e219a59fdb50  # Specifies propagation delay in time quantas.
                      CanControllerSeg1: value=3, type=INTEGER, min-value=0, max-value=31, uuid=3671aec0-89ef-456f-900a-b7cc637c7693  # Specifies phase segment 1 in time quantas.
                      CanControllerSeg2: value=1, type=INTEGER, min-value=0, max-value=15, uuid=373d5c2e-57cf-4995-8c7e-a365a26059e5  # Specifies phase segment 2 in time quantas.
                      CanControllerSyncJumpWidth: value=3, type=INTEGER, min-value=0, max-value=15, uuid=d4394623-c60d-4cc3-90cd-607ff4bd1962  # Specifies the synchronization jump width for the controller in time quantas.
                      CanControllerSspOffset: value=0, type=INTEGER, min-value=0, max-value=127, uuid=ae45a7b2-e06c-4bfe-93c0-2b826d64335f  # Specifies the Transmitter Delay Compensation Offset in minimum time quanta.
                      CanFDBytePayload: value=64, type=INTEGER, min-value=0, max-value=64, uuid=0cd2ac8a-ca16-4e3b-9799-236365da4b9a  # Data Length Code:<br/> CAN and CAN FD: transmit frame has 0-8 data bytes.<br/> CAN FD: transmit frame has 12/16/20/24/32/48/64 data bytes.
                      CanControllerTxBitRateSwitch: value=true, type=BOOLEAN, uuid=0183f1c7-db3a-4d81-9046-893367053812  # Specifies if the bit rate switching shall be used for transmissions.
                  CanTTController: uuid=edb911fe-7010-47ca-84d2-32231e663654  # CanTTController is specified in the SWS TTCAN and contains the configuration parameters of the TTCAN controller(s) (which are needed in addition to the configuration parameters of the CAN controller(s)).
                    18 x parameter:
                      CanTTControllerApplWatchdogLimit: value=0, type=INTEGER, min-value=0, max-value=255, uuid=3483426f-3c42-49e1-b549-70859ba58366  # Defines the maximum time period (unit is 256 times NTU) after which the application has to serve the watchdog.
                      CanTTControllerCycleCountMax: value=0, type=INTEGER, min-value=0, max-value=63, uuid=d3e7a2ab-2000-4416-8965-88da8e376853  # Defines the value for cycle_count_max.
                      CanTTControllerExpectedTxTrigger: value=0, type=INTEGER, min-value=0, max-value=255, uuid=aa4d670e-ae11-4cf0-a9a1-7f55fbaa408d  # Number of expected_tx_trigger.
                      CanTTControllerExternalClockSynchronisation: value=false, type=BOOLEAN, uuid=aac82f9b-db36-4076-85d2-9c4286881310  # Enables/disables the external clock synchronization.
                      CanTTControllerGlobalTimeFiltering: value=false, type=BOOLEAN, uuid=9565bb3e-e552-4c4f-b10b-a578f1dffb73  # Enables/disables the global time filtering.
                      CanTTControllerInitialRefOffset: value=0, type=INTEGER, min-value=0, max-value=127, uuid=4e442085-9c66-4924-b561-8ea77d7fda3a  # Defines the initial value for ref trigger offset.
                      CanTTControllerInterruptEnable: value=0, type=INTEGER, min-value=0, max-value=1023, uuid=f55b0b93-6ffb-429e-bb65-80bcccfb46c9  # Enables/disables the respective interrupts.
                      CanTTControllerLevel2: value=false, type=BOOLEAN, uuid=4c201500-70bd-4d9d-adb9-c9e46c0d2cef  # Defines whether Level 2 or Level 1 is used.
                      CanTTControllerNTUConfig: value=0.0, type=FLOAT, min-value=0.0, max-value=100.0, uuid=27a77a94-f910-4f9f-8863-2d3a1e33378a  # Defines the config value for NTU (network time unit).
                      CanTTControllerOperationMode: value=CAN_TT_EVENT_SYNC_TIME_TRIGGERED, type=ENUM, uuid=ff1918e7-e59e-4804-a6af-169334bc6f90  # Defines the operation mode.
                      CanTTControllerSyncDeviation: value=0.0, type=FLOAT, min-value=0.0, max-value=100.0, uuid=a6fd369e-834e-4599-bce4-7215c102173b  # Defines the maximum synchronization deviation:
                      CanTTControllerTURRestore: value=false, type=BOOLEAN, uuid=0a81256b-66d2-44e6-a9b7-f79513e62be9  # Enables/disables the TUR restore.
                      CanTTControllerTimeMaster: value=false, type=BOOLEAN, uuid=d1982483-0490-4407-b52c-71b9dfba7052  # Defines whether the controller acts as a potential time master.
                      CanTTControllerTimeMasterPriority: value=0, type=INTEGER, min-value=0, max-value=7, uuid=908cbdd4-db9f-4c8b-8f4d-a1b76d69afd5  # Defines the time master priority.
                      CanTTControllerTxEnableWindowLength: value=1, type=INTEGER, min-value=1, max-value=16, uuid=c91c2eaf-af19-4a41-8ec4-1e2253d1290f  # Length of the tx enable window given in CAN bit times.
                      CanTTControllerWatchTriggerGapTimeMark: value=0, type=INTEGER, min-value=0, max-value=65535, uuid=1b49abe2-5bce-4030-9660-16dcb1048e8d  # watch trigger time mark after a gap
                      CanTTControllerWatchTriggerTimeMark: value=0, type=INTEGER, min-value=0, max-value=65535, uuid=7579d033-e5f7-4372-b3da-7c451ee26281  # watch trigger time mark
                      CanTTIRQProcessing: value=INTERRUPT, type=ENUM, uuid=ab8ee895-d54a-46fa-a0e4-61b16869ad38  # Enables / disables API Can_MainFunction_BusOff() for handling busoff events in polling mode.
              CanControllerBaudrateConfig: uuid=0da1f8d9-7b2f-43e0-a883-d804c73cbcd0  # This container contains bit timing related configuration parameters of the CAN controller(s).
                7 x parameter:
                  CanControllerBaudRateConfigID: value=0, type=INTEGER, min-value=0, max-value=65535, uuid=8edebe01-5d03-4e1f-be14-5c8ac650a1aa  # Uniquely identifies a specific baud rate configuration. This ID is used by SetBaudrate API.
                  CanControllerBaudRate: value=0.0, type=FLOAT, min-value=0.0, max-value=1000.0, uuid=129cb237-97a5-4e73-97d2-c88482ec97a4  # Specifies the baudrate of the controller in kbps.
                  CanControllerPRESDIV: value=2, type=INTEGER, min-value=0, max-value=511, uuid=b8b9a390-55db-492b-bccc-c80e73cdc7c5  # Specifies the Prescaler Division Factor.Defines the ratio between the module clock frequency and the serial clock frequency.
                  CanControllerPropSeg: value=7, type=INTEGER, min-value=0, max-value=255, uuid=84ec78dc-e6ca-4eb5-a18d-eee60b28f7ea  # Specifies propagation delay in time quantas.
                  CanControllerSeg1: value=50, type=INTEGER, min-value=0, max-value=255, uuid=2652953a-5d54-4312-9f96-98cb08b30835  # Specifies phase segment 1 in time quantas.
                  CanControllerSeg2: value=2, type=INTEGER, min-value=0, max-value=127, uuid=2e004d8f-e88e-44c7-8ee6-17d79113c53d  # Specifies phase segment 2 in time quantas.
                  CanControllerSyncJumpWidth: value=1, type=INTEGER, min-value=0, max-value=127, uuid=3b5b233a-d112-4852-a6c8-6b516288c013  # Specifies the synchronization jump width for the controller in time quantas.
                CanControllerFdBaudrateConfig (): uuid=7bc7f774-da3e-4fed-9e7d-b2c14892a3dd  # This optional container contains bit timing related configuration parameters of the CAN controller(s) for payload and CRC of a CAN FD frame. If this container exists the controller supports CAN FD frames.
                  9 x parameter:
                    CanControllerFdBaudRate: value=0.0, type=FLOAT, min-value=0.0, max-value=8000.0, uuid=6643f59a-d56f-48c5-88c1-19b09bed6559  # Specifies the data segment baud rate of the controller in kbps.
                    CanControllerFdBaudRatePRESDIV: value=1, type=INTEGER, min-value=0, max-value=31, uuid=3241038d-de18-48c3-8f13-1ade0c59bf7c  # Specifies the Extended Prescaler Division Factor.
                    CanControllerPropSeg: value=3, type=INTEGER, min-value=0, max-value=31, uuid=7a2f5664-e050-4a17-ac1c-92d2da5c1898  # Specifies propagation delay in time quantas.
                    CanControllerSeg1: value=3, type=INTEGER, min-value=0, max-value=31, uuid=1dbba0b2-ab19-4caf-b2bc-1b90ea0d2bd1  # Specifies phase segment 1 in time quantas.
                    CanControllerSeg2: value=1, type=INTEGER, min-value=0, max-value=15, uuid=4136dd57-3e22-4c71-ad2b-5c4605f9e350  # Specifies phase segment 2 in time quantas.
                    CanControllerSyncJumpWidth: value=3, type=INTEGER, min-value=0, max-value=15, uuid=880a7850-db9b-4f6e-b083-c82e101a6ca9  # Specifies the synchronization jump width for the controller in time quantas.
                    CanControllerSspOffset: value=0, type=INTEGER, min-value=0, max-value=127, uuid=c97dee1a-013e-4296-8d21-0f70d2401780  # Specifies the Transmitter Delay Compensation Offset in minimum time quanta.
                    CanFDBytePayload: value=64, type=INTEGER, min-value=0, max-value=64, uuid=fe76c56c-e63a-41ea-856e-96ad94016a02  # Data Length Code:<br/> CAN and CAN FD: transmit frame has 0-8 data bytes.<br/> CAN FD: transmit frame has 12/16/20/24/32/48/64 data bytes.
                    CanControllerTxBitRateSwitch: value=true, type=BOOLEAN, uuid=99f291ab-1e7d-41bd-8a64-3dc476ff439f  # Specifies if the bit rate switching shall be used for transmissions.
              CanControllerFdBaudrateConfig: uuid=f3e16996-d75a-4158-8eb4-f39355ba2acb  # This optional container contains bit timing related configuration parameters of the CAN controller(s) for payload and CRC of a CAN FD frame. If this container exists the controller supports CAN FD frames.
                9 x parameter:
                  CanControllerFdBaudRate: value=0.0, type=FLOAT, min-value=0.0, max-value=8000.0, uuid=0d458c0c-acbf-4f9d-828c-fadcd59de83b  # Specifies the data segment baud rate of the controller in kbps.
                  CanControllerFdBaudRatePRESDIV: value=1, type=INTEGER, min-value=0, max-value=31, uuid=be87d2cf-6043-4458-b373-8259b9496a4e  # Specifies the Extended Prescaler Division Factor.
                  CanControllerPropSeg: value=3, type=INTEGER, min-value=0, max-value=31, uuid=0d8c210f-bffc-4f32-9aaf-1ca3c8960615  # Specifies propagation delay in time quantas.
                  CanControllerSeg1: value=3, type=INTEGER, min-value=0, max-value=31, uuid=9dd37723-468b-4551-814d-f40584080d96  # Specifies phase segment 1 in time quantas.
                  CanControllerSeg2: value=1, type=INTEGER, min-value=0, max-value=15, uuid=8d0a4a2f-4b17-4498-9bd2-ddac5166ed97  # Specifies phase segment 2 in time quantas.
                  CanControllerSyncJumpWidth: value=3, type=INTEGER, min-value=0, max-value=15, uuid=0d9bb721-afa8-4279-b9a1-1ee2cf096c6b  # Specifies the synchronization jump width for the controller in time quantas.
                  CanControllerSspOffset: value=0, type=INTEGER, min-value=0, max-value=127, uuid=41894245-66a7-41a4-9b8a-b6bcf0a46026  # Specifies the Transmitter Delay Compensation Offset in minimum time quanta.
                  CanFDBytePayload: value=64, type=INTEGER, min-value=0, max-value=64, uuid=bc0d72c8-3bd4-42cf-a4f3-1de3806935a1  # Data Length Code:<br/> CAN and CAN FD: transmit frame has 0-8 data bytes.<br/> CAN FD: transmit frame has 12/16/20/24/32/48/64 data bytes.
                  CanControllerTxBitRateSwitch: value=true, type=BOOLEAN, uuid=1f41b06b-5a2f-4b67-a100-f1fcbf140d0d  # Specifies if the bit rate switching shall be used for transmissions.
              CanTTController: uuid=a81a9c35-5ef4-4df2-932e-9ab33583e2de  # CanTTController is specified in the SWS TTCAN and contains the configuration parameters of the TTCAN controller(s) (which are needed in addition to the configuration parameters of the CAN controller(s)).
                18 x parameter:
                  CanTTControllerApplWatchdogLimit: value=0, type=INTEGER, min-value=0, max-value=255, uuid=8a50402c-ad4d-4caa-a743-add4ce27d268  # Defines the maximum time period (unit is 256 times NTU) after which the application has to serve the watchdog.
                  CanTTControllerCycleCountMax: value=0, type=INTEGER, min-value=0, max-value=63, uuid=7c7fe98a-7460-4355-8bd1-8a7f6e478782  # Defines the value for cycle_count_max.
                  CanTTControllerExpectedTxTrigger: value=0, type=INTEGER, min-value=0, max-value=255, uuid=e09a7f84-a30a-4b60-87c7-e3f611c43440  # Number of expected_tx_trigger.
                  CanTTControllerExternalClockSynchronisation: value=false, type=BOOLEAN, uuid=90fe31eb-445b-4c7c-a62f-f4a290e570ac  # Enables/disables the external clock synchronization.
                  CanTTControllerGlobalTimeFiltering: value=false, type=BOOLEAN, uuid=72c1c18a-7fed-42b5-88e1-0261bb56574d  # Enables/disables the global time filtering.
                  CanTTControllerInitialRefOffset: value=0, type=INTEGER, min-value=0, max-value=127, uuid=6e9a14b3-72d4-4c65-b0fd-e1e6a63fb55d  # Defines the initial value for ref trigger offset.
                  CanTTControllerInterruptEnable: value=0, type=INTEGER, min-value=0, max-value=1023, uuid=b686c203-bb99-411c-8161-4a621d62f290  # Enables/disables the respective interrupts.
                  CanTTControllerLevel2: value=false, type=BOOLEAN, uuid=28d88777-e3ba-405c-9825-c5677cd56d8a  # Defines whether Level 2 or Level 1 is used.
                  CanTTControllerNTUConfig: value=0.0, type=FLOAT, min-value=0.0, max-value=100.0, uuid=c4bcc6d4-fad1-4dd6-aede-5d07e839d530  # Defines the config value for NTU (network time unit).
                  CanTTControllerOperationMode: value=CAN_TT_EVENT_SYNC_TIME_TRIGGERED, type=ENUM, uuid=fcde5f41-e312-44c6-bdb3-4c5f75bfbbf6  # Defines the operation mode.
                  CanTTControllerSyncDeviation: value=0.0, type=FLOAT, min-value=0.0, max-value=100.0, uuid=f6b4e5fe-4676-4d91-970e-577686449075  # Defines the maximum synchronization deviation:
                  CanTTControllerTURRestore: value=false, type=BOOLEAN, uuid=3ad26e29-a9f7-48c7-91e2-06a12fba532c  # Enables/disables the TUR restore.
                  CanTTControllerTimeMaster: value=false, type=BOOLEAN, uuid=a87af720-aa5d-4ecc-ab34-899492603bd9  # Defines whether the controller acts as a potential time master.
                  CanTTControllerTimeMasterPriority: value=0, type=INTEGER, min-value=0, max-value=7, uuid=fd1720fa-13e5-4a40-8270-58c70ac5c32e  # Defines the time master priority.
                  CanTTControllerTxEnableWindowLength: value=1, type=INTEGER, min-value=1, max-value=16, uuid=078bfa53-5c42-4ebb-8571-6aa4ea1b64c7  # Length of the tx enable window given in CAN bit times.
                  CanTTControllerWatchTriggerGapTimeMark: value=0, type=INTEGER, min-value=0, max-value=65535, uuid=96097765-4864-4e0f-9c1b-3fd1181734af  # watch trigger time mark after a gap
                  CanTTControllerWatchTriggerTimeMark: value=0, type=INTEGER, min-value=0, max-value=65535, uuid=afac0684-69c8-47c3-9e89-56b6c8408a0d  # watch trigger time mark
                  CanTTIRQProcessing: value=INTERRUPT, type=ENUM, uuid=79e281fc-ac1c-422b-8be2-0e4c38cd71b6  # Enables / disables API Can_MainFunction_BusOff() for handling busoff events in polling mode.
              CanHardwareObject: uuid=05495c50-a8ff-4f8e-9f57-48e7f7ec10c4  # This container contains the configurations (parameters) of CAN Hardware Objects.
                9 x parameter:
                  CanFdPaddingValue: value=0, type=INTEGER, min-value=0, max-value=255, uuid=c2ff5445-c21f-4cb5-819b-318ae60bb0fc  # Specifies the value which is used to pad unspecified data in CAN FD frames > 8 bytes for transmission. This is necessary due to the discrete possible values of the DLC if > 8 bytes.
                  CanHandleType: value=BASIC, type=ENUM, uuid=98fc4054-cfbb-4def-abf0-47bafae0704b  # Specifies the type (Full-CAN or Basic-CAN) of a hardware object.
                  CanHwObjectCount: value=1, type=INTEGER, min-value=1, max-value=64, uuid=018a6282-bc97-4f6a-a067-4e8935b51d51  # Number of hardware objects used to implement one HOH. In case of a HRH this parameter defines the number of elements in the hardware FIFO or the number of shadow buffers, in case of a HTH it defines the number of hardware objects used for multiplexed transmission or for a hardware FIFO used by a FullCAN HTH.
                  CanHwFIFOThreshold: value=1, type=INTEGER, min-value=1, max-value=64, uuid=662a2946-f97c-4907-b703-1d52421094b9  # Number of the threshold size of Rx/TxEvent FIFO buffer to copy the data.
                  CanIdType: value=STANDARD, type=ENUM, uuid=a58ae45f-e97d-4a48-a2b3-0db211995bed  # Specifies whether the IdValue is of type
                  CanObjectId: value=0, type=INTEGER, min-value=0, max-value=65535, uuid=698038a5-bbe9-41c7-89aa-f908fbc97afe  # Holds the handle ID of HRH or HTH. The value of this parameter is unique in a given CAN Driver, and it should start with 0 and continue without any gaps.
                  CanObjectType: value=RECEIVE, type=ENUM, uuid=ac371cc9-1652-4f60-88eb-7f042dc56a67  # Specifies if the HardwareObject is used as Transmit or as Receive object
                  CanTriggerTransmitEnable: value=false, type=BOOLEAN, uuid=18f576d4-a3a5-48a6-9604-da5734dff1e1  # This parameter defines if or if not Can supports the trigger-transmit API for this handle.
                  CanHardwareObjectUsesPolling: value=false, type=BOOLEAN, uuid=fcd997f5-9eff-4e94-8bf4-1d7ecbd32c55  # Enables polling of this hardware object.
                CanHwFilter (): uuid=8bc11b7a-b1f4-4fd1-8472-d90e42d3d726  # This container is only valid for HRHs and contains the configuration (parameters) of one hardware filter.
                  parameter CanHwFilterCode: value=0, type=INTEGER, min-value=0, max-value=4294967295, uuid=2d8832e2-32eb-4193-9331-1fc9dd236a62  # Specifies (together with the filter mask) the identifiers range that passes the hardware filter.
                  parameter CanHwFilterMask: value=2047, type=INTEGER, min-value=0, max-value=4294967295, uuid=3b18e601-5f1e-4ce4-8cd4-5c88f307aacf  # Describes a mask for hardware-based filtering of CAN identifiers. The CAN identifiers of incoming messages are masked with the appropriate CanFilterMaskValue. Bits holding a 0 mean don't care, i.e. do not compare the message's identifier in the respective bit position.
                CanTTHardwareObjectTrigger (): uuid=92a759c7-d29d-4727-9522-676f0424c45c  # CanTTHardwareObjectTrigger is specified in the SWS TTCAN and contains the configuration (parameters) of TTCAN triggers for Hardware Objects, which are additional to the configuration (parameters) of CAN Hardware Objects.
                  5 x parameter:
                    CanTTHardwareObjectBaseCycle: value=0, type=INTEGER, min-value=0, max-value=63, uuid=c1b60638-0e3d-40b7-8a98-5e23cf0ad07d  # Defines the cycle_offset.
                    CanTTHardwareObjectCycleRepetition: value=1, type=INTEGER, min-value=1, max-value=64, uuid=ac617ca2-d2a3-4a4d-8414-663f16c67858  # Defines the repeat_factor.
                    CanTTHardwareObjectTimeMark: value=0, type=INTEGER, min-value=0, max-value=65535, uuid=64fa364e-85ea-4c2e-af29-56ffafd7979f  # Defines the point in time, when the trigger will be activated.
                    CanTTHardwareObjectTriggerId: value=0, type=INTEGER, min-value=0, max-value=63, uuid=b343f86c-4d72-4125-9668-2005f5489e2e  # Sequential number which allows separation of different TTCAN triggers configured for one and the same hardware object.
                    CanTTHardwareObjectTriggerType: value=CAN_TT_RX_TRIGGER, type=ENUM, uuid=bb995167-901e-4669-891e-5eea876a30e7  # Defines the type of the trigger associated with the hardware object. This parameter depends on plain CAN parameter CAN_OBJECT_TYPE.
              CanHwFilter: uuid=eed8f628-801c-4730-81a1-ba1052b9832a  # This container is only valid for HRHs and contains the configuration (parameters) of one hardware filter.
                parameter CanHwFilterCode: value=0, type=INTEGER, min-value=0, max-value=4294967295, uuid=abfffc69-68fd-41dc-a104-e435ef0a2cb1  # Specifies (together with the filter mask) the identifiers range that passes the hardware filter.
                parameter CanHwFilterMask: value=2047, type=INTEGER, min-value=0, max-value=4294967295, uuid=59cef1ea-e2bf-483c-b907-04a8a668bd42  # Describes a mask for hardware-based filtering of CAN identifiers. The CAN identifiers of incoming messages are masked with the appropriate CanFilterMaskValue. Bits holding a 0 mean don't care, i.e. do not compare the message's identifier in the respective bit position.
              CanTTHardwareObjectTrigger: uuid=a82e3801-9e63-4c3a-98e7-538811ede1cc  # CanTTHardwareObjectTrigger is specified in the SWS TTCAN and contains the configuration (parameters) of TTCAN triggers for Hardware Objects, which are additional to the configuration (parameters) of CAN Hardware Objects.
                5 x parameter:
                  CanTTHardwareObjectBaseCycle: value=0, type=INTEGER, min-value=0, max-value=63, uuid=9355e31d-97df-4216-b7b7-db584c386ab5  # Defines the cycle_offset.
                  CanTTHardwareObjectCycleRepetition: value=1, type=INTEGER, min-value=1, max-value=64, uuid=693fa1cf-4b8d-4b16-8eba-316f6a661f81  # Defines the repeat_factor.
                  CanTTHardwareObjectTimeMark: value=0, type=INTEGER, min-value=0, max-value=65535, uuid=e0679529-85c3-4556-aebc-98d453ec44f8  # Defines the point in time, when the trigger will be activated.
                  CanTTHardwareObjectTriggerId: value=0, type=INTEGER, min-value=0, max-value=63, uuid=6c1240cb-b07f-4fcf-a5ca-961bbcdc7791  # Sequential number which allows separation of different TTCAN triggers configured for one and the same hardware object.
                  CanTTHardwareObjectTriggerType: value=CAN_TT_RX_TRIGGER, type=ENUM, uuid=15174bfd-42fa-4768-9cfe-21373d93986f  # Defines the type of the trigger associated with the hardware object. This parameter depends on plain CAN parameter CAN_OBJECT_TYPE.
              CanIcom: uuid=cd83f642-27f2-46c8-9ee4-a18f60dbe659  # This container contains the parameters for configuring pretended networking
                parameter CanIcomConfigId: value=1, type=INTEGER, min-value=1, max-value=255, uuid=369e8ee8-9b17-48e0-a4bb-f64881b1468d  # This parameter identifies the ID of the ICOM configuration.
                parameter CanIcomWakeOnBusOff: value=true, type=BOOLEAN, uuid=762589a4-c64c-4beb-9579-d882091511cc  # This parameter defines that the MCU shall wake if the bus off is detected or not.
                4 x :
                  CanIcomConfig: uuid=68aa8125-72f7-4644-af35-98d860b279ef  # This container contains the configuration parameters of the ICOM Configuration.
                    parameter CanIcomConfigId: value=1, type=INTEGER, min-value=1, max-value=255, uuid=d662b171-1c5b-4ca5-8310-4f63ae2efb9e  # This parameter identifies the ID of the ICOM configuration.
                    parameter CanIcomWakeOnBusOff: value=true, type=BOOLEAN, uuid=4195bc60-ff39-436c-a47c-19172a2661f4  # This parameter defines that the MCU shall wake if the bus off is detected or not.
                    3 x :
                      CanIcomWakeupCauses: uuid=c2483615-13f6-43ee-a894-f2d43eaf37b0  # This container contains the configuration parameters of the wakeup causes to leave the power saving mode.
                        5 x parameter:
                          CanIcomCounterValue: value=1, type=INTEGER, min-value=1, max-value=65536, uuid=45e6276e-6d3a-450b-a105-5168a7d79186  # This parameter defines that the MCU shall wake if the message with the ID is received n times on the communication channel.
                          CanIcomMessageId: value=0, type=INTEGER, min-value=0, max-value=536870912, uuid=2b6e97dc-0ac9-4571-aa3b-fbc2a004d65c  # This parameter defines the message ID the wakeup causes of this CanIcomRxMessage are configured for. In addition a mask (CanIcomMessageIdMask) can be defined, in that case it is possible to define a range of rx messages, which can create a wakeup condition.
                          CanIcomMessageIdMask: value=0, type=INTEGER, min-value=0, max-value=536870912, uuid=2dda118a-9b87-4631-8bfe-e702762b76f7  # Describes a mask for filtering of CAN identifiers. The CAN identifiers of incoming messages are masked with this CanIcomMessageIdMask. If the masked identifier matches the masked value of CanIcomMessageId, it can create a wakeup condition for this CanIcomRxMessage. Bits holding a 0 mean don't care, i.e. do not compare the message's identifier in the respective bit position. The mask shall be build by filling with leading 0.
                          CanIcomMissingMessageTimerValue: value=0.0, type=FLOAT, min-value=0.0, max-value=65535.0, uuid=b9dc9981-85e6-4a0f-8ecd-3a88be5a3464  # This parameter defines that the MCU shall wake if the message with the ID is not received for a specific time in s on the
                          CanIcomPayloadLengthError: value=false, type=BOOLEAN, uuid=d1a7882e-7f50-4bca-946c-c7ab557d3d10  # This parameter defines that the MCU shall wake if a payload error occurs
                        CanIcomRxMessage (): uuid=cb3e0e01-82fa-43ab-9bb3-5557b553c6ec  # This container contains the configuration parameters for the wakeup causes for matching received messages. It has to be configured as often as received messages are defined as wakeup cause.
                          5 x parameter:
                            CanIcomCounterValue: value=1, type=INTEGER, min-value=1, max-value=65536, uuid=072afdee-0c31-4e38-95dc-f392149f4fe4  # This parameter defines that the MCU shall wake if the message with the ID is received n times on the communication channel.
                            CanIcomMessageId: value=0, type=INTEGER, min-value=0, max-value=536870912, uuid=6cebac56-1b62-46c6-917b-c2fcca387134  # This parameter defines the message ID the wakeup causes of this CanIcomRxMessage are configured for. In addition a mask (CanIcomMessageIdMask) can be defined, in that case it is possible to define a range of rx messages, which can create a wakeup condition.
                            CanIcomMessageIdMask: value=0, type=INTEGER, min-value=0, max-value=536870912, uuid=09ac65a1-0397-4b98-aa4d-2a669be1cc24  # Describes a mask for filtering of CAN identifiers. The CAN identifiers of incoming messages are masked with this CanIcomMessageIdMask. If the masked identifier matches the masked value of CanIcomMessageId, it can create a wakeup condition for this CanIcomRxMessage. Bits holding a 0 mean don't care, i.e. do not compare the message's identifier in the respective bit position. The mask shall be build by filling with leading 0.
                            CanIcomMissingMessageTimerValue: value=0.0, type=FLOAT, min-value=0.0, max-value=65535.0, uuid=93085f37-b23f-41bd-8315-8c7e0f29a80e  # This parameter defines that the MCU shall wake if the message with the ID is not received for a specific time in s on the
                            CanIcomPayloadLengthError: value=false, type=BOOLEAN, uuid=82b88018-aa2e-4f2f-be25-b593235d2719  # This parameter defines that the MCU shall wake if a payload error occurs
                          CanIcomRxMessageSignalConfig (): uuid=0dc98b11-94ea-4677-b297-344ac5aa4298  # This container contains the configuration parameters for the wakeup causes for matching signals.
                            parameter CanIcomSignalMask: value=0, type=INTEGER, min-value=0, max-value=9223372036854775807, uuid=f3b0e431-2bff-4a07-a658-6fe0b9505e31  # This parameter shall be used to mask a signal in the payload of a CAN message.
                            parameter CanIcomSignalOperation: value=AND, type=ENUM, uuid=6bb41071-2b93-4ad0-9e7c-a4a05fb72c26  # This parameter defines the operation, which shall be used to verify the signal value creates a wakeup condition.
                            parameter CanIcomSignalValue: value=0, type=INTEGER, min-value=0, max-value=9223372036854775807, uuid=d33f1431-7073-4164-a02e-a0c97374655f  # This parameter shall be used to define a signal value which shall be compared (CanIcomSignalOperation) with the masked CanIcomSignalMask value of the received signal (CanIcomSignalRef).
                        CanIcomRxMessageSignalConfig (): uuid=82187fd4-ab0a-40db-b68a-5f89d9226a89  # This container contains the configuration parameters for the wakeup causes for matching signals.
                          parameter CanIcomSignalMask: value=0, type=INTEGER, min-value=0, max-value=9223372036854775807, uuid=d0a5608f-eff2-4394-820e-7035019a83ec  # This parameter shall be used to mask a signal in the payload of a CAN message.
                          parameter CanIcomSignalOperation: value=AND, type=ENUM, uuid=1890ae1a-578f-49bd-95ae-4c51331bc186  # This parameter defines the operation, which shall be used to verify the signal value creates a wakeup condition.
                          parameter CanIcomSignalValue: value=0, type=INTEGER, min-value=0, max-value=9223372036854775807, uuid=7c58dc9f-e2f2-4cce-8c3e-1cf44896ac42  # This parameter shall be used to define a signal value which shall be compared (CanIcomSignalOperation) with the masked CanIcomSignalMask value of the received signal (CanIcomSignalRef).
                      CanIcomRxMessage: uuid=d16e3c38-34e1-45b4-89d5-e651ddb2e996  # This container contains the configuration parameters for the wakeup causes for matching received messages. It has to be configured as often as received messages are defined as wakeup cause.
                        5 x parameter:
                          CanIcomCounterValue: value=1, type=INTEGER, min-value=1, max-value=65536, uuid=90534ac3-e15a-469b-a62f-339fb881468d  # This parameter defines that the MCU shall wake if the message with the ID is received n times on the communication channel.
                          CanIcomMessageId: value=0, type=INTEGER, min-value=0, max-value=536870912, uuid=0c82e3c9-3b46-4f73-ad2b-93a541ce9c16  # This parameter defines the message ID the wakeup causes of this CanIcomRxMessage are configured for. In addition a mask (CanIcomMessageIdMask) can be defined, in that case it is possible to define a range of rx messages, which can create a wakeup condition.
                          CanIcomMessageIdMask: value=0, type=INTEGER, min-value=0, max-value=536870912, uuid=24386c3b-0f2f-42d8-a176-722170a6cf3a  # Describes a mask for filtering of CAN identifiers. The CAN identifiers of incoming messages are masked with this CanIcomMessageIdMask. If the masked identifier matches the masked value of CanIcomMessageId, it can create a wakeup condition for this CanIcomRxMessage. Bits holding a 0 mean don't care, i.e. do not compare the message's identifier in the respective bit position. The mask shall be build by filling with leading 0.
                          CanIcomMissingMessageTimerValue: value=0.0, type=FLOAT, min-value=0.0, max-value=65535.0, uuid=ba3ee47f-4f0c-4a89-866a-d763d061c315  # This parameter defines that the MCU shall wake if the message with the ID is not received for a specific time in s on the
                          CanIcomPayloadLengthError: value=false, type=BOOLEAN, uuid=bb91d301-2827-4347-a87e-ffcd943046e0  # This parameter defines that the MCU shall wake if a payload error occurs
                        CanIcomRxMessageSignalConfig (): uuid=d767340a-d0b0-4fae-861a-9578c8bec0dc  # This container contains the configuration parameters for the wakeup causes for matching signals.
                          parameter CanIcomSignalMask: value=0, type=INTEGER, min-value=0, max-value=9223372036854775807, uuid=e5972db5-f43c-4505-88d0-add7ef16eab4  # This parameter shall be used to mask a signal in the payload of a CAN message.
                          parameter CanIcomSignalOperation: value=AND, type=ENUM, uuid=3b19875f-44a8-4fa3-98fa-380c2d07a02b  # This parameter defines the operation, which shall be used to verify the signal value creates a wakeup condition.
                          parameter CanIcomSignalValue: value=0, type=INTEGER, min-value=0, max-value=9223372036854775807, uuid=023a24a3-8808-4676-84f1-80caef529a2d  # This parameter shall be used to define a signal value which shall be compared (CanIcomSignalOperation) with the masked CanIcomSignalMask value of the received signal (CanIcomSignalRef).
                      CanIcomRxMessageSignalConfig: uuid=fabba128-968e-449c-adab-ca7aa75d64b8  # This container contains the configuration parameters for the wakeup causes for matching signals.
                        parameter CanIcomSignalMask: value=0, type=INTEGER, min-value=0, max-value=9223372036854775807, uuid=a6f07604-3a1e-442e-a5e9-c31d06b484ea  # This parameter shall be used to mask a signal in the payload of a CAN message.
                        parameter CanIcomSignalOperation: value=AND, type=ENUM, uuid=e16f7593-f3d0-442d-824c-99e8319efc3f  # This parameter defines the operation, which shall be used to verify the signal value creates a wakeup condition.
                        parameter CanIcomSignalValue: value=0, type=INTEGER, min-value=0, max-value=9223372036854775807, uuid=279f6b9b-8d21-4151-906b-5758ba185208  # This parameter shall be used to define a signal value which shall be compared (CanIcomSignalOperation) with the masked CanIcomSignalMask value of the received signal (CanIcomSignalRef).
                  CanIcomWakeupCauses: uuid=96d1cea7-97ad-41d0-a888-d3a19cecd7d2  # This container contains the configuration parameters of the wakeup causes to leave the power saving mode.
                    5 x parameter:
                      CanIcomCounterValue: value=1, type=INTEGER, min-value=1, max-value=65536, uuid=cbd5c2b4-8e21-4574-8582-9383508bd5c3  # This parameter defines that the MCU shall wake if the message with the ID is received n times on the communication channel.
                      CanIcomMessageId: value=0, type=INTEGER, min-value=0, max-value=536870912, uuid=fb2de7a4-0c6f-4ab3-80d1-d2184fa10203  # This parameter defines the message ID the wakeup causes of this CanIcomRxMessage are configured for. In addition a mask (CanIcomMessageIdMask) can be defined, in that case it is possible to define a range of rx messages, which can create a wakeup condition.
                      CanIcomMessageIdMask: value=0, type=INTEGER, min-value=0, max-value=536870912, uuid=18b09951-ef9e-42cb-a647-a23cd816e02f  # Describes a mask for filtering of CAN identifiers. The CAN identifiers of incoming messages are masked with this CanIcomMessageIdMask. If the masked identifier matches the masked value of CanIcomMessageId, it can create a wakeup condition for this CanIcomRxMessage. Bits holding a 0 mean don't care, i.e. do not compare the message's identifier in the respective bit position. The mask shall be build by filling with leading 0.
                      CanIcomMissingMessageTimerValue: value=0.0, type=FLOAT, min-value=0.0, max-value=65535.0, uuid=19bc0b71-149f-46bd-b9ec-2e0a5ad1a80d  # This parameter defines that the MCU shall wake if the message with the ID is not received for a specific time in s on the
                      CanIcomPayloadLengthError: value=false, type=BOOLEAN, uuid=d353d97e-f815-469c-84e6-394d04e030d5  # This parameter defines that the MCU shall wake if a payload error occurs
                    CanIcomRxMessage (): uuid=097760a0-b4cf-4b59-818c-76c5dc3f3f04  # This container contains the configuration parameters for the wakeup causes for matching received messages. It has to be configured as often as received messages are defined as wakeup cause.
                      5 x parameter:
                        CanIcomCounterValue: value=1, type=INTEGER, min-value=1, max-value=65536, uuid=32a83e93-9edd-422e-98a6-06e4fb7a0ef5  # This parameter defines that the MCU shall wake if the message with the ID is received n times on the communication channel.
                        CanIcomMessageId: value=0, type=INTEGER, min-value=0, max-value=536870912, uuid=b1411db2-1a35-423a-a363-fe064841a876  # This parameter defines the message ID the wakeup causes of this CanIcomRxMessage are configured for. In addition a mask (CanIcomMessageIdMask) can be defined, in that case it is possible to define a range of rx messages, which can create a wakeup condition.
                        CanIcomMessageIdMask: value=0, type=INTEGER, min-value=0, max-value=536870912, uuid=19d89f69-90c8-4673-8c9c-1ac9d5337ef0  # Describes a mask for filtering of CAN identifiers. The CAN identifiers of incoming messages are masked with this CanIcomMessageIdMask. If the masked identifier matches the masked value of CanIcomMessageId, it can create a wakeup condition for this CanIcomRxMessage. Bits holding a 0 mean don't care, i.e. do not compare the message's identifier in the respective bit position. The mask shall be build by filling with leading 0.
                        CanIcomMissingMessageTimerValue: value=0.0, type=FLOAT, min-value=0.0, max-value=65535.0, uuid=81c2df90-9ae9-4c45-ae33-80c3c3cc6213  # This parameter defines that the MCU shall wake if the message with the ID is not received for a specific time in s on the
                        CanIcomPayloadLengthError: value=false, type=BOOLEAN, uuid=8183a80a-e9de-4404-86a9-34a97eebb65e  # This parameter defines that the MCU shall wake if a payload error occurs
                      CanIcomRxMessageSignalConfig (): uuid=0798ec6e-4c9c-4b07-aa31-6e049362d59c  # This container contains the configuration parameters for the wakeup causes for matching signals.
                        parameter CanIcomSignalMask: value=0, type=INTEGER, min-value=0, max-value=9223372036854775807, uuid=a1ef7d7c-0a2b-460b-bf29-fd50a1dbed72  # This parameter shall be used to mask a signal in the payload of a CAN message.
                        parameter CanIcomSignalOperation: value=AND, type=ENUM, uuid=79105ee7-1fd5-4b36-bfd9-72444e4c12e3  # This parameter defines the operation, which shall be used to verify the signal value creates a wakeup condition.
                        parameter CanIcomSignalValue: value=0, type=INTEGER, min-value=0, max-value=9223372036854775807, uuid=bd84f907-83ba-4488-b768-d2a8e2b08ed0  # This parameter shall be used to define a signal value which shall be compared (CanIcomSignalOperation) with the masked CanIcomSignalMask value of the received signal (CanIcomSignalRef).
                    CanIcomRxMessageSignalConfig (): uuid=eead3e06-9322-4f78-b931-db94f8be84b8  # This container contains the configuration parameters for the wakeup causes for matching signals.
                      parameter CanIcomSignalMask: value=0, type=INTEGER, min-value=0, max-value=9223372036854775807, uuid=8b68906c-2978-4094-b88f-7cb129dabae1  # This parameter shall be used to mask a signal in the payload of a CAN message.
                      parameter CanIcomSignalOperation: value=AND, type=ENUM, uuid=5778eaf3-0e24-4a51-8eb0-9f7f73009042  # This parameter defines the operation, which shall be used to verify the signal value creates a wakeup condition.
                      parameter CanIcomSignalValue: value=0, type=INTEGER, min-value=0, max-value=9223372036854775807, uuid=40b29663-7b3b-491b-8891-8898c37a9196  # This parameter shall be used to define a signal value which shall be compared (CanIcomSignalOperation) with the masked CanIcomSignalMask value of the received signal (CanIcomSignalRef).
                  CanIcomRxMessage: uuid=2c6c7737-9aa7-4f6b-a052-c21564593a46  # This container contains the configuration parameters for the wakeup causes for matching received messages. It has to be configured as often as received messages are defined as wakeup cause.
                    5 x parameter:
                      CanIcomCounterValue: value=1, type=INTEGER, min-value=1, max-value=65536, uuid=a8c440a3-fa49-4b39-8917-a91bf8f41139  # This parameter defines that the MCU shall wake if the message with the ID is received n times on the communication channel.
                      CanIcomMessageId: value=0, type=INTEGER, min-value=0, max-value=536870912, uuid=47fb9ea5-f490-4e50-a94d-34e562fb582d  # This parameter defines the message ID the wakeup causes of this CanIcomRxMessage are configured for. In addition a mask (CanIcomMessageIdMask) can be defined, in that case it is possible to define a range of rx messages, which can create a wakeup condition.
                      CanIcomMessageIdMask: value=0, type=INTEGER, min-value=0, max-value=536870912, uuid=98ad4f59-fa7e-40ff-bf3f-1f47d1828e94  # Describes a mask for filtering of CAN identifiers. The CAN identifiers of incoming messages are masked with this CanIcomMessageIdMask. If the masked identifier matches the masked value of CanIcomMessageId, it can create a wakeup condition for this CanIcomRxMessage. Bits holding a 0 mean don't care, i.e. do not compare the message's identifier in the respective bit position. The mask shall be build by filling with leading 0.
                      CanIcomMissingMessageTimerValue: value=0.0, type=FLOAT, min-value=0.0, max-value=65535.0, uuid=b60859b4-38f6-4a11-953d-b1999d7fc940  # This parameter defines that the MCU shall wake if the message with the ID is not received for a specific time in s on the
                      CanIcomPayloadLengthError: value=false, type=BOOLEAN, uuid=060dbe81-4323-4f0d-86db-2f7ea058fd2f  # This parameter defines that the MCU shall wake if a payload error occurs
                    CanIcomRxMessageSignalConfig (): uuid=0e4a0ba6-9a8f-4851-bdcb-a52ecc35054b  # This container contains the configuration parameters for the wakeup causes for matching signals.
                      parameter CanIcomSignalMask: value=0, type=INTEGER, min-value=0, max-value=9223372036854775807, uuid=9b2272b1-c15e-4ccd-919a-36455f479325  # This parameter shall be used to mask a signal in the payload of a CAN message.
                      parameter CanIcomSignalOperation: value=AND, type=ENUM, uuid=29972a97-dbb6-4277-9396-634159288cae  # This parameter defines the operation, which shall be used to verify the signal value creates a wakeup condition.
                      parameter CanIcomSignalValue: value=0, type=INTEGER, min-value=0, max-value=9223372036854775807, uuid=1de2f9f9-35cf-48ef-b97c-59a5de40ae63  # This parameter shall be used to define a signal value which shall be compared (CanIcomSignalOperation) with the masked CanIcomSignalMask value of the received signal (CanIcomSignalRef).
                  CanIcomRxMessageSignalConfig: uuid=b42778b0-c67c-424f-a392-f495e78ed153  # This container contains the configuration parameters for the wakeup causes for matching signals.
                    parameter CanIcomSignalMask: value=0, type=INTEGER, min-value=0, max-value=9223372036854775807, uuid=1ecaeeb8-4ef7-4338-8325-525d6b7367a9  # This parameter shall be used to mask a signal in the payload of a CAN message.
                    parameter CanIcomSignalOperation: value=AND, type=ENUM, uuid=e9deb43b-de2b-42f7-9492-aa22e3578e0b  # This parameter defines the operation, which shall be used to verify the signal value creates a wakeup condition.
                    parameter CanIcomSignalValue: value=0, type=INTEGER, min-value=0, max-value=9223372036854775807, uuid=f0e27966-72d3-4016-b6cd-a1c791049b0f  # This parameter shall be used to define a signal value which shall be compared (CanIcomSignalOperation) with the masked CanIcomSignalMask value of the received signal (CanIcomSignalRef).
              CanIcomConfig: uuid=265604a5-cc92-435b-a766-84a16476d699  # This container contains the configuration parameters of the ICOM Configuration.
                parameter CanIcomConfigId: value=1, type=INTEGER, min-value=1, max-value=255, uuid=b6724605-a809-4553-b04f-5c8a67745b78  # This parameter identifies the ID of the ICOM configuration.
                parameter CanIcomWakeOnBusOff: value=true, type=BOOLEAN, uuid=4ea94ac9-b5f3-4d92-8bb0-03e7244e4ed4  # This parameter defines that the MCU shall wake if the bus off is detected or not.
                3 x :
                  CanIcomWakeupCauses: uuid=261121ea-4d43-447c-9d5f-4308ee6f967e  # This container contains the configuration parameters of the wakeup causes to leave the power saving mode.
                    5 x parameter:
                      CanIcomCounterValue: value=1, type=INTEGER, min-value=1, max-value=65536, uuid=ad7dafd3-2ad8-4542-9236-118336028bd4  # This parameter defines that the MCU shall wake if the message with the ID is received n times on the communication channel.
                      CanIcomMessageId: value=0, type=INTEGER, min-value=0, max-value=536870912, uuid=650782a2-3273-4ae0-8dda-ebc708b3a85f  # This parameter defines the message ID the wakeup causes of this CanIcomRxMessage are configured for. In addition a mask (CanIcomMessageIdMask) can be defined, in that case it is possible to define a range of rx messages, which can create a wakeup condition.
                      CanIcomMessageIdMask: value=0, type=INTEGER, min-value=0, max-value=536870912, uuid=64dad553-4c63-46b6-8f1a-3e953b8d9c01  # Describes a mask for filtering of CAN identifiers. The CAN identifiers of incoming messages are masked with this CanIcomMessageIdMask. If the masked identifier matches the masked value of CanIcomMessageId, it can create a wakeup condition for this CanIcomRxMessage. Bits holding a 0 mean don't care, i.e. do not compare the message's identifier in the respective bit position. The mask shall be build by filling with leading 0.
                      CanIcomMissingMessageTimerValue: value=0.0, type=FLOAT, min-value=0.0, max-value=65535.0, uuid=f26f19e8-de8f-4f07-885e-5f991d6a360b  # This parameter defines that the MCU shall wake if the message with the ID is not received for a specific time in s on the
                      CanIcomPayloadLengthError: value=false, type=BOOLEAN, uuid=c31593aa-256b-4c95-a93c-7b65a55f9b89  # This parameter defines that the MCU shall wake if a payload error occurs
                    CanIcomRxMessage (): uuid=eb773188-8d4b-4c12-8197-6400b67366cc  # This container contains the configuration parameters for the wakeup causes for matching received messages. It has to be configured as often as received messages are defined as wakeup cause.
                      5 x parameter:
                        CanIcomCounterValue: value=1, type=INTEGER, min-value=1, max-value=65536, uuid=03483064-e8ef-4c6a-b0ce-d4e9148a71de  # This parameter defines that the MCU shall wake if the message with the ID is received n times on the communication channel.
                        CanIcomMessageId: value=0, type=INTEGER, min-value=0, max-value=536870912, uuid=11db4804-4ee8-42bd-b6fe-495142f7dfa4  # This parameter defines the message ID the wakeup causes of this CanIcomRxMessage are configured for. In addition a mask (CanIcomMessageIdMask) can be defined, in that case it is possible to define a range of rx messages, which can create a wakeup condition.
                        CanIcomMessageIdMask: value=0, type=INTEGER, min-value=0, max-value=536870912, uuid=71313c31-99f8-4c52-b199-5fea4424cb13  # Describes a mask for filtering of CAN identifiers. The CAN identifiers of incoming messages are masked with this CanIcomMessageIdMask. If the masked identifier matches the masked value of CanIcomMessageId, it can create a wakeup condition for this CanIcomRxMessage. Bits holding a 0 mean don't care, i.e. do not compare the message's identifier in the respective bit position. The mask shall be build by filling with leading 0.
                        CanIcomMissingMessageTimerValue: value=0.0, type=FLOAT, min-value=0.0, max-value=65535.0, uuid=7e9b0713-033c-4c07-9a3d-0449a269ca12  # This parameter defines that the MCU shall wake if the message with the ID is not received for a specific time in s on the
                        CanIcomPayloadLengthError: value=false, type=BOOLEAN, uuid=1b2865b9-141a-4133-882d-edc6cbaa7ca8  # This parameter defines that the MCU shall wake if a payload error occurs
                      CanIcomRxMessageSignalConfig (): uuid=c114bd6b-1ed9-419c-8803-03445ce5c11d  # This container contains the configuration parameters for the wakeup causes for matching signals.
                        parameter CanIcomSignalMask: value=0, type=INTEGER, min-value=0, max-value=9223372036854775807, uuid=4ef361f3-12cb-4b3d-907a-b7e07aa6ff6e  # This parameter shall be used to mask a signal in the payload of a CAN message.
                        parameter CanIcomSignalOperation: value=AND, type=ENUM, uuid=209698f3-49d9-4640-8083-5016b02387cd  # This parameter defines the operation, which shall be used to verify the signal value creates a wakeup condition.
                        parameter CanIcomSignalValue: value=0, type=INTEGER, min-value=0, max-value=9223372036854775807, uuid=c7de5563-4248-470b-880f-f46bfb35548d  # This parameter shall be used to define a signal value which shall be compared (CanIcomSignalOperation) with the masked CanIcomSignalMask value of the received signal (CanIcomSignalRef).
                    CanIcomRxMessageSignalConfig (): uuid=00ed17e9-0f2d-45dc-b0e8-092791175608  # This container contains the configuration parameters for the wakeup causes for matching signals.
                      parameter CanIcomSignalMask: value=0, type=INTEGER, min-value=0, max-value=9223372036854775807, uuid=9e978eec-8339-4034-8689-a99936cd06a0  # This parameter shall be used to mask a signal in the payload of a CAN message.
                      parameter CanIcomSignalOperation: value=AND, type=ENUM, uuid=9248ff26-a6c8-4666-b46b-f5292721e012  # This parameter defines the operation, which shall be used to verify the signal value creates a wakeup condition.
                      parameter CanIcomSignalValue: value=0, type=INTEGER, min-value=0, max-value=9223372036854775807, uuid=8cd2952c-4c53-40e7-9db2-87cb06d06bdd  # This parameter shall be used to define a signal value which shall be compared (CanIcomSignalOperation) with the masked CanIcomSignalMask value of the received signal (CanIcomSignalRef).
                  CanIcomRxMessage: uuid=10251141-584e-432f-84a4-2306c2d107b6  # This container contains the configuration parameters for the wakeup causes for matching received messages. It has to be configured as often as received messages are defined as wakeup cause.
                    5 x parameter:
                      CanIcomCounterValue: value=1, type=INTEGER, min-value=1, max-value=65536, uuid=745bcf70-0f44-485b-9f8f-e20b75ab06ae  # This parameter defines that the MCU shall wake if the message with the ID is received n times on the communication channel.
                      CanIcomMessageId: value=0, type=INTEGER, min-value=0, max-value=536870912, uuid=f8f724c0-380a-4cad-9eee-ab80d81ef014  # This parameter defines the message ID the wakeup causes of this CanIcomRxMessage are configured for. In addition a mask (CanIcomMessageIdMask) can be defined, in that case it is possible to define a range of rx messages, which can create a wakeup condition.
                      CanIcomMessageIdMask: value=0, type=INTEGER, min-value=0, max-value=536870912, uuid=a6505dee-4759-4a97-9646-4f4443aa1828  # Describes a mask for filtering of CAN identifiers. The CAN identifiers of incoming messages are masked with this CanIcomMessageIdMask. If the masked identifier matches the masked value of CanIcomMessageId, it can create a wakeup condition for this CanIcomRxMessage. Bits holding a 0 mean don't care, i.e. do not compare the message's identifier in the respective bit position. The mask shall be build by filling with leading 0.
                      CanIcomMissingMessageTimerValue: value=0.0, type=FLOAT, min-value=0.0, max-value=65535.0, uuid=eb56cd55-ded3-4c18-a74a-d7dcc1d6878b  # This parameter defines that the MCU shall wake if the message with the ID is not received for a specific time in s on the
                      CanIcomPayloadLengthError: value=false, type=BOOLEAN, uuid=9025f538-c5e1-4a80-bc2f-2d2b2c6d2a9f  # This parameter defines that the MCU shall wake if a payload error occurs
                    CanIcomRxMessageSignalConfig (): uuid=215d865e-6bc7-4e6f-834a-d19e6f7e8750  # This container contains the configuration parameters for the wakeup causes for matching signals.
                      parameter CanIcomSignalMask: value=0, type=INTEGER, min-value=0, max-value=9223372036854775807, uuid=655aff92-fc1c-464d-bd62-5e6966da7d54  # This parameter shall be used to mask a signal in the payload of a CAN message.
                      parameter CanIcomSignalOperation: value=AND, type=ENUM, uuid=98252cf4-abb8-40fc-88d6-64414f4e1b75  # This parameter defines the operation, which shall be used to verify the signal value creates a wakeup condition.
                      parameter CanIcomSignalValue: value=0, type=INTEGER, min-value=0, max-value=9223372036854775807, uuid=e6bf2326-9e9f-4818-af17-adbbc67fdfab  # This parameter shall be used to define a signal value which shall be compared (CanIcomSignalOperation) with the masked CanIcomSignalMask value of the received signal (CanIcomSignalRef).
                  CanIcomRxMessageSignalConfig: uuid=83a4e4fb-9622-43ec-bfd3-b3552327e364  # This container contains the configuration parameters for the wakeup causes for matching signals.
                    parameter CanIcomSignalMask: value=0, type=INTEGER, min-value=0, max-value=9223372036854775807, uuid=83c8eac6-3c2e-44d8-8b29-53a409d52a88  # This parameter shall be used to mask a signal in the payload of a CAN message.
                    parameter CanIcomSignalOperation: value=AND, type=ENUM, uuid=ff85c55c-c3d3-42da-b789-9ebc7cd7ae0c  # This parameter defines the operation, which shall be used to verify the signal value creates a wakeup condition.
                    parameter CanIcomSignalValue: value=0, type=INTEGER, min-value=0, max-value=9223372036854775807, uuid=124ea978-a5d1-444d-aebc-50607a57ad85  # This parameter shall be used to define a signal value which shall be compared (CanIcomSignalOperation) with the masked CanIcomSignalMask value of the received signal (CanIcomSignalRef).
              CanIcomWakeupCauses: uuid=3961292e-3b39-47b2-b62a-7546fe1b13b9  # This container contains the configuration parameters of the wakeup causes to leave the power saving mode.
                5 x parameter:
                  CanIcomCounterValue: value=1, type=INTEGER, min-value=1, max-value=65536, uuid=84a22d1b-f75a-48f1-bad0-ec3de365c06b  # This parameter defines that the MCU shall wake if the message with the ID is received n times on the communication channel.
                  CanIcomMessageId: value=0, type=INTEGER, min-value=0, max-value=536870912, uuid=fd763c59-68f2-4d43-ae7e-e9f213f68e43  # This parameter defines the message ID the wakeup causes of this CanIcomRxMessage are configured for. In addition a mask (CanIcomMessageIdMask) can be defined, in that case it is possible to define a range of rx messages, which can create a wakeup condition.
                  CanIcomMessageIdMask: value=0, type=INTEGER, min-value=0, max-value=536870912, uuid=64cd9bf9-ba55-41f8-a9aa-ee7507fb88ee  # Describes a mask for filtering of CAN identifiers. The CAN identifiers of incoming messages are masked with this CanIcomMessageIdMask. If the masked identifier matches the masked value of CanIcomMessageId, it can create a wakeup condition for this CanIcomRxMessage. Bits holding a 0 mean don't care, i.e. do not compare the message's identifier in the respective bit position. The mask shall be build by filling with leading 0.
                  CanIcomMissingMessageTimerValue: value=0.0, type=FLOAT, min-value=0.0, max-value=65535.0, uuid=7896d609-d4a7-4507-aa27-1881a4f36035  # This parameter defines that the MCU shall wake if the message with the ID is not received for a specific time in s on the
                  CanIcomPayloadLengthError: value=false, type=BOOLEAN, uuid=f8552cd2-8197-4603-ada4-b9e453dcc4a3  # This parameter defines that the MCU shall wake if a payload error occurs
                CanIcomRxMessage (): uuid=3d0dc29d-f2ea-4025-a290-e81f46a21d5c  # This container contains the configuration parameters for the wakeup causes for matching received messages. It has to be configured as often as received messages are defined as wakeup cause.
                  5 x parameter:
                    CanIcomCounterValue: value=1, type=INTEGER, min-value=1, max-value=65536, uuid=bbeabec8-9e8a-45e9-b1a5-5019c7a035e2  # This parameter defines that the MCU shall wake if the message with the ID is received n times on the communication channel.
                    CanIcomMessageId: value=0, type=INTEGER, min-value=0, max-value=536870912, uuid=71a30925-7b0d-4804-b1fe-94bd456af32d  # This parameter defines the message ID the wakeup causes of this CanIcomRxMessage are configured for. In addition a mask (CanIcomMessageIdMask) can be defined, in that case it is possible to define a range of rx messages, which can create a wakeup condition.
                    CanIcomMessageIdMask: value=0, type=INTEGER, min-value=0, max-value=536870912, uuid=e7592461-bd54-4f4d-99d8-c46aefc44a0e  # Describes a mask for filtering of CAN identifiers. The CAN identifiers of incoming messages are masked with this CanIcomMessageIdMask. If the masked identifier matches the masked value of CanIcomMessageId, it can create a wakeup condition for this CanIcomRxMessage. Bits holding a 0 mean don't care, i.e. do not compare the message's identifier in the respective bit position. The mask shall be build by filling with leading 0.
                    CanIcomMissingMessageTimerValue: value=0.0, type=FLOAT, min-value=0.0, max-value=65535.0, uuid=3aaf24e1-059d-4c45-996a-1ac85a881c26  # This parameter defines that the MCU shall wake if the message with the ID is not received for a specific time in s on the
                    CanIcomPayloadLengthError: value=false, type=BOOLEAN, uuid=d4fb03ad-a185-48f5-ad11-cfd457e84c1a  # This parameter defines that the MCU shall wake if a payload error occurs
                  CanIcomRxMessageSignalConfig (): uuid=ef70daca-a52e-4993-a464-67d68bd27dd4  # This container contains the configuration parameters for the wakeup causes for matching signals.
                    parameter CanIcomSignalMask: value=0, type=INTEGER, min-value=0, max-value=9223372036854775807, uuid=80aac1f8-a7ca-45a7-bae4-29cb10730375  # This parameter shall be used to mask a signal in the payload of a CAN message.
                    parameter CanIcomSignalOperation: value=AND, type=ENUM, uuid=cbfb0d15-ce19-4312-a96d-ae3988700060  # This parameter defines the operation, which shall be used to verify the signal value creates a wakeup condition.
                    parameter CanIcomSignalValue: value=0, type=INTEGER, min-value=0, max-value=9223372036854775807, uuid=4ef66a2d-ccba-4c7f-ab37-ad9f58871679  # This parameter shall be used to define a signal value which shall be compared (CanIcomSignalOperation) with the masked CanIcomSignalMask value of the received signal (CanIcomSignalRef).
                CanIcomRxMessageSignalConfig (): uuid=9f5d58a8-254e-4dd8-8c74-8e06e47fa2f0  # This container contains the configuration parameters for the wakeup causes for matching signals.
                  parameter CanIcomSignalMask: value=0, type=INTEGER, min-value=0, max-value=9223372036854775807, uuid=ff13829a-27e3-4589-b9d0-8428e827d02b  # This parameter shall be used to mask a signal in the payload of a CAN message.
                  parameter CanIcomSignalOperation: value=AND, type=ENUM, uuid=12b7041e-1418-4448-8392-05922d3071cc  # This parameter defines the operation, which shall be used to verify the signal value creates a wakeup condition.
                  parameter CanIcomSignalValue: value=0, type=INTEGER, min-value=0, max-value=9223372036854775807, uuid=44338f20-1499-4c2c-ac7e-a58aef7b9c89  # This parameter shall be used to define a signal value which shall be compared (CanIcomSignalOperation) with the masked CanIcomSignalMask value of the received signal (CanIcomSignalRef).
              CanIcomRxMessage: uuid=a3c12342-d94d-4f78-b5c5-84003e80a216  # This container contains the configuration parameters for the wakeup causes for matching received messages. It has to be configured as often as received messages are defined as wakeup cause.
                5 x parameter:
                  CanIcomCounterValue: value=1, type=INTEGER, min-value=1, max-value=65536, uuid=da49e14c-c8ad-43e4-93ea-f1674b123d6d  # This parameter defines that the MCU shall wake if the message with the ID is received n times on the communication channel.
                  CanIcomMessageId: value=0, type=INTEGER, min-value=0, max-value=536870912, uuid=1019342f-01e0-4b88-823f-74fd4118a8ad  # This parameter defines the message ID the wakeup causes of this CanIcomRxMessage are configured for. In addition a mask (CanIcomMessageIdMask) can be defined, in that case it is possible to define a range of rx messages, which can create a wakeup condition.
                  CanIcomMessageIdMask: value=0, type=INTEGER, min-value=0, max-value=536870912, uuid=7226eb65-20b2-4f77-80f8-bef3849fb942  # Describes a mask for filtering of CAN identifiers. The CAN identifiers of incoming messages are masked with this CanIcomMessageIdMask. If the masked identifier matches the masked value of CanIcomMessageId, it can create a wakeup condition for this CanIcomRxMessage. Bits holding a 0 mean don't care, i.e. do not compare the message's identifier in the respective bit position. The mask shall be build by filling with leading 0.
                  CanIcomMissingMessageTimerValue: value=0.0, type=FLOAT, min-value=0.0, max-value=65535.0, uuid=6c9d9ea4-0098-4502-b0b4-b8840c9be213  # This parameter defines that the MCU shall wake if the message with the ID is not received for a specific time in s on the
                  CanIcomPayloadLengthError: value=false, type=BOOLEAN, uuid=f90afb29-f44c-42d5-9194-e0d42c88e49c  # This parameter defines that the MCU shall wake if a payload error occurs
                CanIcomRxMessageSignalConfig (): uuid=f82531c6-7b98-497c-b62a-482fa828440a  # This container contains the configuration parameters for the wakeup causes for matching signals.
                  parameter CanIcomSignalMask: value=0, type=INTEGER, min-value=0, max-value=9223372036854775807, uuid=3734846b-a873-4db1-9338-ff3066d8966d  # This parameter shall be used to mask a signal in the payload of a CAN message.
                  parameter CanIcomSignalOperation: value=AND, type=ENUM, uuid=b1745f33-93f6-4d0e-8654-9fbc99e0b5b5  # This parameter defines the operation, which shall be used to verify the signal value creates a wakeup condition.
                  parameter CanIcomSignalValue: value=0, type=INTEGER, min-value=0, max-value=9223372036854775807, uuid=02eb5bb7-6ff4-467a-906f-a42ecd078109  # This parameter shall be used to define a signal value which shall be compared (CanIcomSignalOperation) with the masked CanIcomSignalMask value of the received signal (CanIcomSignalRef).
              CanIcomRxMessageSignalConfig: uuid=641492c7-a2e0-4527-be02-9b980c8d91f7  # This container contains the configuration parameters for the wakeup causes for matching signals.
                parameter CanIcomSignalMask: value=0, type=INTEGER, min-value=0, max-value=9223372036854775807, uuid=6e21484b-3653-4e6f-9ca4-46b336785538  # This parameter shall be used to mask a signal in the payload of a CAN message.
                parameter CanIcomSignalOperation: value=AND, type=ENUM, uuid=3297d882-08b5-4dd7-8bb2-6ac865195088  # This parameter defines the operation, which shall be used to verify the signal value creates a wakeup condition.
                parameter CanIcomSignalValue: value=0, type=INTEGER, min-value=0, max-value=9223372036854775807, uuid=03e30357-7142-4855-916f-d3e8141929a9  # This parameter shall be used to define a signal value which shall be compared (CanIcomSignalOperation) with the masked CanIcomSignalMask value of the received signal (CanIcomSignalRef).
          CanController: uuid=b0dfbd34-0c3c-445c-8569-ef205ea8bd44  # This container contains the configuration parameters of the CAN controller(s).
            11 x parameter:
              CanControllerActivation: value=false, type=BOOLEAN, uuid=95637b65-4d25-4d6c-913f-b9464fa7ca9c  # Defines if a CAN controller is used in the configuration.
              CanControllerBaseAddress: value=0, type=INTEGER, min-value=0, max-value=4294967295, uuid=47f300a0-3f5a-441f-bfd1-7c16e20d259a  # Specifies the CAN controller base address.
              CanHardwareChannel: value=CAN_CONTROLLER_00, type=ENUM, uuid=a0b474b7-1425-46ab-b600-b31822dac0d2  # This parameter provides the Real Hardware controller ID which is unique in the CAN Driver
              CanControllerId: value=1, type=INTEGER, min-value=0, max-value=255, uuid=20859705-be64-4146-a326-9b032d19598f  # This parameter provides the controller ID which is unique in a given CAN Driver. The value for this parameter starts with 0 and continue without any gaps.
              CanRxProcessing: value=POLLING, type=ENUM, uuid=41fa8f83-4a2d-4998-aeb2-2cd164ee1c13  # Enables / disables API Can_MainFunction_Read() for handling PDU reception events in polling mode.
              CanTxProcessing: value=POLLING, type=ENUM, uuid=8c8cc9f7-e7aa-4fd6-960f-6416ae28e68c  # Enables / disables API Can_MainFunction_Write() for handling PDU transmission events in polling mode.
              CanBusoffProcessing: value=POLLING, type=ENUM, uuid=aad4346b-3e7b-401e-9dbe-a5ca8d13392c  # Enables / disables API Can_MainFunction_BusOff() for handling busoff events in polling mode.
              CanWakeupProcessing: value=POLLING, type=ENUM, uuid=ff513d3b-42b9-4a57-9c25-6f3181f12983  # Enables / disables API Can_MainFunction_Wakeup() for handling wakeup events in polling mode.
              CanWakeupFunctionalityAPI: value=false, type=BOOLEAN, uuid=f9843e62-bc26-4a26-bc50-7b62f7d7fdb3  # Adds / removes the service Can_CheckWakeup() from the code.
              CanFDSupport: value=false, type=BOOLEAN, uuid=3a4528b9-2267-45c4-88d8-661109f409a6  # Selects support of CanFD features in Can driver.
              CanWakeupSupport: value=false, type=BOOLEAN, uuid=c053d884-0434-484f-ad44-b05e5df082e6  # CAN driver support for wakeup over CAN Bus.
            3 x :
              CanControllerBaudrateConfig: uuid=7b620a2e-7b52-482f-8585-7a3a40b0d69a  # This container contains bit timing related configuration parameters of the CAN controller(s).
                7 x parameter:
                  CanControllerBaudRateConfigID: value=0, type=INTEGER, min-value=0, max-value=65535, uuid=89ddce26-ed80-41fc-83e2-8ad68158dbb6  # Uniquely identifies a specific baud rate configuration. This ID is used by SetBaudrate API.
                  CanControllerBaudRate: value=0.0, type=FLOAT, min-value=0.0, max-value=1000.0, uuid=587a4565-0b08-404f-9bdd-7f7cdfd0c9e8  # Specifies the baudrate of the controller in kbps.
                  CanControllerPRESDIV: value=2, type=INTEGER, min-value=0, max-value=511, uuid=3270f931-5e85-4047-b776-9cdb1c945926  # Specifies the Prescaler Division Factor.Defines the ratio between the module clock frequency and the serial clock frequency.
                  CanControllerPropSeg: value=7, type=INTEGER, min-value=0, max-value=255, uuid=9d4e290d-bee6-4e70-829b-b1879aba0f6b  # Specifies propagation delay in time quantas.
                  CanControllerSeg1: value=7, type=INTEGER, min-value=0, max-value=255, uuid=07a9d3c8-4554-40aa-a6d8-e7cb018596a9  # Specifies phase segment 1 in time quantas.
                  CanControllerSeg2: value=2, type=INTEGER, min-value=0, max-value=127, uuid=b1a65e94-4e25-4267-a17b-ceb7e7edd703  # Specifies phase segment 2 in time quantas.
                  CanControllerSyncJumpWidth: value=1, type=INTEGER, min-value=0, max-value=127, uuid=65edcdd1-1a07-4bf8-8ce5-dfe7e7ae5993  # Specifies the synchronization jump width for the controller in time quantas.
                CanControllerFdBaudrateConfig (): uuid=7c35433c-898b-45dd-b5b7-7ef99b28809e  # This optional container contains bit timing related configuration parameters of the CAN controller(s) for payload and CRC of a CAN FD frame. If this container exists the controller supports CAN FD frames.
                  9 x parameter:
                    CanControllerFdBaudRate: value=0.0, type=FLOAT, min-value=0.0, max-value=8000.0, uuid=50e7529c-b90e-4012-9e6c-317cf7db3d09  # Specifies the data segment baud rate of the controller in kbps.
                    CanControllerFdBaudRatePRESDIV: value=1, type=INTEGER, min-value=0, max-value=31, uuid=87c4aa22-17ee-4919-b715-659d6aca875f  # Specifies the Extended Prescaler Division Factor.
                    CanControllerPropSeg: value=3, type=INTEGER, min-value=0, max-value=31, uuid=e0c33d36-7fc5-4cd3-b5a6-30d4a28260aa  # Specifies propagation delay in time quantas.
                    CanControllerSeg1: value=3, type=INTEGER, min-value=0, max-value=31, uuid=abc324df-7cdb-4590-988d-b12ecf49fd7e  # Specifies phase segment 1 in time quantas.
                    CanControllerSeg2: value=1, type=INTEGER, min-value=0, max-value=15, uuid=2123f8bd-e37c-434c-80d2-d70a99c1321c  # Specifies phase segment 2 in time quantas.
                    CanControllerSyncJumpWidth: value=3, type=INTEGER, min-value=0, max-value=15, uuid=202f3415-b00c-45e7-b6cc-614f43803119  # Specifies the synchronization jump width for the controller in time quantas.
                    CanControllerSspOffset: value=0, type=INTEGER, min-value=0, max-value=127, uuid=dd9cfab8-9a57-41a6-9f3e-80566523cda5  # Specifies the Transmitter Delay Compensation Offset in minimum time quanta.
                    CanFDBytePayload: value=64, type=INTEGER, min-value=0, max-value=64, uuid=616269aa-f8f0-4f96-a165-5baa20bf7ab3  # Data Length Code:<br/> CAN and CAN FD: transmit frame has 0-8 data bytes.<br/> CAN FD: transmit frame has 12/16/20/24/32/48/64 data bytes.
                    CanControllerTxBitRateSwitch: value=true, type=BOOLEAN, uuid=52611cb0-616e-4621-91e7-f4d4dbf3d5e8  # Specifies if the bit rate switching shall be used for transmissions.
              CanControllerFdBaudrateConfig: uuid=04fa3bbf-8107-4492-ab32-e2ea0a929727  # This optional container contains bit timing related configuration parameters of the CAN controller(s) for payload and CRC of a CAN FD frame. If this container exists the controller supports CAN FD frames.
                9 x parameter:
                  CanControllerFdBaudRate: value=0.0, type=FLOAT, min-value=0.0, max-value=8000.0, uuid=33efc20a-8a79-4e51-9e14-341af9d7b343  # Specifies the data segment baud rate of the controller in kbps.
                  CanControllerFdBaudRatePRESDIV: value=1, type=INTEGER, min-value=0, max-value=31, uuid=781c05c1-dae3-4208-9a79-fb11cd941020  # Specifies the Extended Prescaler Division Factor.
                  CanControllerPropSeg: value=3, type=INTEGER, min-value=0, max-value=31, uuid=5b329553-e651-49b9-bf14-7539ec2fd9f8  # Specifies propagation delay in time quantas.
                  CanControllerSeg1: value=3, type=INTEGER, min-value=0, max-value=31, uuid=3f0753ad-09f3-4985-a222-326b6c65ab34  # Specifies phase segment 1 in time quantas.
                  CanControllerSeg2: value=1, type=INTEGER, min-value=0, max-value=15, uuid=9bb32918-a1a5-42e0-ac5e-d2c2991bb782  # Specifies phase segment 2 in time quantas.
                  CanControllerSyncJumpWidth: value=3, type=INTEGER, min-value=0, max-value=15, uuid=ec8ab780-0b60-4eba-987f-2584c88444f0  # Specifies the synchronization jump width for the controller in time quantas.
                  CanControllerSspOffset: value=0, type=INTEGER, min-value=0, max-value=127, uuid=48f0b48c-d6ce-4f0d-9c87-33174ce74b98  # Specifies the Transmitter Delay Compensation Offset in minimum time quanta.
                  CanFDBytePayload: value=64, type=INTEGER, min-value=0, max-value=64, uuid=97a4117a-1aa4-4a9b-97ff-976e099d4322  # Data Length Code:<br/> CAN and CAN FD: transmit frame has 0-8 data bytes.<br/> CAN FD: transmit frame has 12/16/20/24/32/48/64 data bytes.
                  CanControllerTxBitRateSwitch: value=true, type=BOOLEAN, uuid=4993c849-8389-4770-b77a-24bd433b8b01  # Specifies if the bit rate switching shall be used for transmissions.
              CanTTController: uuid=f7ef7414-5144-49ee-ad53-2e67524828f4  # CanTTController is specified in the SWS TTCAN and contains the configuration parameters of the TTCAN controller(s) (which are needed in addition to the configuration parameters of the CAN controller(s)).
                18 x parameter:
                  CanTTControllerApplWatchdogLimit: value=0, type=INTEGER, min-value=0, max-value=255, uuid=dc465c73-41c7-4289-96b6-c3523a31d20b  # Defines the maximum time period (unit is 256 times NTU) after which the application has to serve the watchdog.
                  CanTTControllerCycleCountMax: value=0, type=INTEGER, min-value=0, max-value=63, uuid=36cd220a-6096-44a5-988a-8310435d505d  # Defines the value for cycle_count_max.
                  CanTTControllerExpectedTxTrigger: value=0, type=INTEGER, min-value=0, max-value=255, uuid=cac667bd-f6a5-45b9-9a61-24afd3f9ba99  # Number of expected_tx_trigger.
                  CanTTControllerExternalClockSynchronisation: value=false, type=BOOLEAN, uuid=0d321e9f-0a11-4e70-ab10-e8b9b15c3f52  # Enables/disables the external clock synchronization.
                  CanTTControllerGlobalTimeFiltering: value=false, type=BOOLEAN, uuid=335d85e6-a2d4-4303-bea2-b2a893b988f3  # Enables/disables the global time filtering.
                  CanTTControllerInitialRefOffset: value=0, type=INTEGER, min-value=0, max-value=127, uuid=8b68442b-8126-420c-8674-66ba62af9502  # Defines the initial value for ref trigger offset.
                  CanTTControllerInterruptEnable: value=0, type=INTEGER, min-value=0, max-value=1023, uuid=abbf927b-4524-4c36-b1bc-eadb7f43ac60  # Enables/disables the respective interrupts.
                  CanTTControllerLevel2: value=false, type=BOOLEAN, uuid=f1c7bc03-1198-441c-a714-def6e0961d3f  # Defines whether Level 2 or Level 1 is used.
                  CanTTControllerNTUConfig: value=0.0, type=FLOAT, min-value=0.0, max-value=100.0, uuid=4a19d4f8-6cce-4d6f-8df6-f63611e012c4  # Defines the config value for NTU (network time unit).
                  CanTTControllerOperationMode: value=CAN_TT_EVENT_SYNC_TIME_TRIGGERED, type=ENUM, uuid=8e1c3255-470b-41c9-934b-d7870eab5ff4  # Defines the operation mode.
                  CanTTControllerSyncDeviation: value=0.0, type=FLOAT, min-value=0.0, max-value=100.0, uuid=61b5499c-804a-4318-8bbf-33307e724427  # Defines the maximum synchronization deviation:
                  CanTTControllerTURRestore: value=false, type=BOOLEAN, uuid=96794577-2a79-4aa0-bd50-f60341732a3d  # Enables/disables the TUR restore.
                  CanTTControllerTimeMaster: value=false, type=BOOLEAN, uuid=5a42daa4-3760-4724-9487-10435b1eba9c  # Defines whether the controller acts as a potential time master.
                  CanTTControllerTimeMasterPriority: value=0, type=INTEGER, min-value=0, max-value=7, uuid=6b9d24ef-752e-4c86-8bc4-0093172a448b  # Defines the time master priority.
                  CanTTControllerTxEnableWindowLength: value=1, type=INTEGER, min-value=1, max-value=16, uuid=7a78df5e-d4c8-4a98-aaf9-3545e8b91e13  # Length of the tx enable window given in CAN bit times.
                  CanTTControllerWatchTriggerGapTimeMark: value=0, type=INTEGER, min-value=0, max-value=65535, uuid=74c14833-866c-4ed3-891b-27c1dc26d5f5  # watch trigger time mark after a gap
                  CanTTControllerWatchTriggerTimeMark: value=0, type=INTEGER, min-value=0, max-value=65535, uuid=a4a243bc-bd64-462e-9a08-3d6c0221b27b  # watch trigger time mark
                  CanTTIRQProcessing: value=INTERRUPT, type=ENUM, uuid=83d8a3c1-66a5-4a56-a4bc-d3140a25ef89  # Enables / disables API Can_MainFunction_BusOff() for handling busoff events in polling mode.
          CanControllerBaudrateConfig: uuid=65c701c4-6061-48d7-bb61-09359e484b41  # This container contains bit timing related configuration parameters of the CAN controller(s).
            7 x parameter:
              CanControllerBaudRateConfigID: value=0, type=INTEGER, min-value=0, max-value=65535, uuid=1462d4be-549e-4149-b23a-2237133bd308  # Uniquely identifies a specific baud rate configuration. This ID is used by SetBaudrate API.
              CanControllerBaudRate: value=0.0, type=FLOAT, min-value=0.0, max-value=1000.0, uuid=a12faba2-73b1-48ca-a349-a08a8c823711  # Specifies the baudrate of the controller in kbps.
              CanControllerPRESDIV: value=2, type=INTEGER, min-value=0, max-value=511, uuid=d9ceec05-cd8e-4530-812e-a769939d8a22  # Specifies the Prescaler Division Factor.Defines the ratio between the module clock frequency and the serial clock frequency.
              CanControllerPropSeg: value=7, type=INTEGER, min-value=0, max-value=255, uuid=ad213419-1184-4add-bf27-ef6acf22311d  # Specifies propagation delay in time quantas.
              CanControllerSeg1: value=7, type=INTEGER, min-value=0, max-value=255, uuid=b2d7cb31-5c66-4233-ae68-0331142a4ef6  # Specifies phase segment 1 in time quantas.
              CanControllerSeg2: value=2, type=INTEGER, min-value=0, max-value=127, uuid=b8b90662-8b4c-438f-9cda-4b64d0174081  # Specifies phase segment 2 in time quantas.
              CanControllerSyncJumpWidth: value=1, type=INTEGER, min-value=0, max-value=127, uuid=d773f664-5a95-4e65-b37c-1ad0a6b82df3  # Specifies the synchronization jump width for the controller in time quantas.
            CanControllerFdBaudrateConfig (): uuid=2ee79fe9-25c8-4f39-b900-ba504b04b2f8  # This optional container contains bit timing related configuration parameters of the CAN controller(s) for payload and CRC of a CAN FD frame. If this container exists the controller supports CAN FD frames.
              9 x parameter:
                CanControllerFdBaudRate: value=0.0, type=FLOAT, min-value=0.0, max-value=8000.0, uuid=3108f021-4b58-40c1-8c11-daf1b81d0882  # Specifies the data segment baud rate of the controller in kbps.
                CanControllerFdBaudRatePRESDIV: value=1, type=INTEGER, min-value=0, max-value=31, uuid=e2e702ba-7e78-4561-b364-9ba09505640b  # Specifies the Extended Prescaler Division Factor.
                CanControllerPropSeg: value=3, type=INTEGER, min-value=0, max-value=31, uuid=a51c4618-6462-4264-83f2-d31a4f5fd174  # Specifies propagation delay in time quantas.
                CanControllerSeg1: value=3, type=INTEGER, min-value=0, max-value=31, uuid=c2c511ba-ef92-4dc2-b718-c63aa737a9b6  # Specifies phase segment 1 in time quantas.
                CanControllerSeg2: value=1, type=INTEGER, min-value=0, max-value=15, uuid=12240242-01f9-44d1-9783-a49e4ba91e05  # Specifies phase segment 2 in time quantas.
                CanControllerSyncJumpWidth: value=3, type=INTEGER, min-value=0, max-value=15, uuid=d008d582-239a-48cd-940f-288e4efea6d1  # Specifies the synchronization jump width for the controller in time quantas.
                CanControllerSspOffset: value=0, type=INTEGER, min-value=0, max-value=127, uuid=948bc4f1-9c4c-4eff-94b1-39a5bf15fa3c  # Specifies the Transmitter Delay Compensation Offset in minimum time quanta.
                CanFDBytePayload: value=64, type=INTEGER, min-value=0, max-value=64, uuid=1d7c2b2d-715e-4636-924d-ca0828e550bd  # Data Length Code:<br/> CAN and CAN FD: transmit frame has 0-8 data bytes.<br/> CAN FD: transmit frame has 12/16/20/24/32/48/64 data bytes.
                CanControllerTxBitRateSwitch: value=true, type=BOOLEAN, uuid=175f13bd-813e-48fd-9fee-63e6ddbe5502  # Specifies if the bit rate switching shall be used for transmissions.
          CanControllerFdBaudrateConfig: uuid=2b1d6731-0950-41b1-b223-0cb2f9b0800f  # This optional container contains bit timing related configuration parameters of the CAN controller(s) for payload and CRC of a CAN FD frame. If this container exists the controller supports CAN FD frames.
            9 x parameter:
              CanControllerFdBaudRate: value=0.0, type=FLOAT, min-value=0.0, max-value=8000.0, uuid=17d06d0c-45f0-4e5d-8b53-11ee9c9de29b  # Specifies the data segment baud rate of the controller in kbps.
              CanControllerFdBaudRatePRESDIV: value=1, type=INTEGER, min-value=0, max-value=31, uuid=f8981486-8990-4abd-9189-3ed2b14e0fb0  # Specifies the Extended Prescaler Division Factor.
              CanControllerPropSeg: value=3, type=INTEGER, min-value=0, max-value=31, uuid=c03717c2-8e2b-4d37-8763-4c28069cc4d1  # Specifies propagation delay in time quantas.
              CanControllerSeg1: value=3, type=INTEGER, min-value=0, max-value=31, uuid=3d4ed57d-45a7-475d-958f-baf2bd8924e1  # Specifies phase segment 1 in time quantas.
              CanControllerSeg2: value=1, type=INTEGER, min-value=0, max-value=15, uuid=364afe33-e84b-4d91-a51f-17eb281b3ba0  # Specifies phase segment 2 in time quantas.
              CanControllerSyncJumpWidth: value=3, type=INTEGER, min-value=0, max-value=15, uuid=3eafcd8d-adae-41f0-b22a-0674c719aaeb  # Specifies the synchronization jump width for the controller in time quantas.
              CanControllerSspOffset: value=0, type=INTEGER, min-value=0, max-value=127, uuid=b5a297a9-0fe0-4166-bc87-0895414614f8  # Specifies the Transmitter Delay Compensation Offset in minimum time quanta.
              CanFDBytePayload: value=64, type=INTEGER, min-value=0, max-value=64, uuid=d9a7df7f-087b-4c7b-b32b-a4ab7d81f1e6  # Data Length Code:<br/> CAN and CAN FD: transmit frame has 0-8 data bytes.<br/> CAN FD: transmit frame has 12/16/20/24/32/48/64 data bytes.
              CanControllerTxBitRateSwitch: value=true, type=BOOLEAN, uuid=3f0730ee-e56d-4071-94e3-c0be99cb7adf  # Specifies if the bit rate switching shall be used for transmissions.
          CanTTController: uuid=75eda868-2643-42a3-b991-dd96a723a91b  # CanTTController is specified in the SWS TTCAN and contains the configuration parameters of the TTCAN controller(s) (which are needed in addition to the configuration parameters of the CAN controller(s)).
            18 x parameter:
              CanTTControllerApplWatchdogLimit: value=0, type=INTEGER, min-value=0, max-value=255, uuid=2871a2e3-472d-4736-b389-6316dcbda8bd  # Defines the maximum time period (unit is 256 times NTU) after which the application has to serve the watchdog.
              CanTTControllerCycleCountMax: value=0, type=INTEGER, min-value=0, max-value=63, uuid=764d2a93-4c87-43ec-808c-a59228780036  # Defines the value for cycle_count_max.
              CanTTControllerExpectedTxTrigger: value=0, type=INTEGER, min-value=0, max-value=255, uuid=703a1739-547b-4f2f-8de0-b64d949e692a  # Number of expected_tx_trigger.
              CanTTControllerExternalClockSynchronisation: value=false, type=BOOLEAN, uuid=37eb89a5-2510-4721-ac3e-4923f088a3e0  # Enables/disables the external clock synchronization.
              CanTTControllerGlobalTimeFiltering: value=false, type=BOOLEAN, uuid=3efd78a7-0933-488f-b132-875d4c9d9a0c  # Enables/disables the global time filtering.
              CanTTControllerInitialRefOffset: value=0, type=INTEGER, min-value=0, max-value=127, uuid=346933fb-1252-4fe2-9a7c-7c4fabf38bd1  # Defines the initial value for ref trigger offset.
              CanTTControllerInterruptEnable: value=0, type=INTEGER, min-value=0, max-value=1023, uuid=4964c8c8-1ca1-443b-ad76-79939b8dde8a  # Enables/disables the respective interrupts.
              CanTTControllerLevel2: value=false, type=BOOLEAN, uuid=d50013b2-d0f4-43c6-a089-9fde08638d58  # Defines whether Level 2 or Level 1 is used.
              CanTTControllerNTUConfig: value=0.0, type=FLOAT, min-value=0.0, max-value=100.0, uuid=ebacbfbf-d0aa-4eb0-bf66-4dab6ddf1a41  # Defines the config value for NTU (network time unit).
              CanTTControllerOperationMode: value=CAN_TT_EVENT_SYNC_TIME_TRIGGERED, type=ENUM, uuid=44ccf1d9-12b4-44ff-92f4-9edac32c3755  # Defines the operation mode.
              CanTTControllerSyncDeviation: value=0.0, type=FLOAT, min-value=0.0, max-value=100.0, uuid=f0475591-3cc9-4730-bc1f-f2feead22c76  # Defines the maximum synchronization deviation:
              CanTTControllerTURRestore: value=false, type=BOOLEAN, uuid=49a9bf59-eb5b-45a6-a429-3a09237fb696  # Enables/disables the TUR restore.
              CanTTControllerTimeMaster: value=false, type=BOOLEAN, uuid=35caec33-8b5a-4aa2-bb5c-1e615b62d368  # Defines whether the controller acts as a potential time master.
              CanTTControllerTimeMasterPriority: value=0, type=INTEGER, min-value=0, max-value=7, uuid=6c7befe1-8dfc-470e-b0d2-bd8d5c77ab58  # Defines the time master priority.
              CanTTControllerTxEnableWindowLength: value=1, type=INTEGER, min-value=1, max-value=16, uuid=254d371a-cc19-4cdc-bfa1-a1c9cd5783d5  # Length of the tx enable window given in CAN bit times.
              CanTTControllerWatchTriggerGapTimeMark: value=0, type=INTEGER, min-value=0, max-value=65535, uuid=ed426863-fc9c-457a-a3bc-29525c8f6a82  # watch trigger time mark after a gap
              CanTTControllerWatchTriggerTimeMark: value=0, type=INTEGER, min-value=0, max-value=65535, uuid=8512dfb4-54dd-4d24-8ac1-2906018382a2  # watch trigger time mark
              CanTTIRQProcessing: value=INTERRUPT, type=ENUM, uuid=f9509d6d-69ee-41b9-8cb2-c540178b3989  # Enables / disables API Can_MainFunction_BusOff() for handling busoff events in polling mode.
          CanHardwareObject: uuid=47b3b770-8164-46fb-9691-0b46acecd3d9  # This container contains the configurations (parameters) of CAN Hardware Objects.
            9 x parameter:
              CanFdPaddingValue: value=0, type=INTEGER, min-value=0, max-value=255, uuid=b4468034-c75c-449c-bec8-4c30c05d33d5  # Specifies the value which is used to pad unspecified data in CAN FD frames > 8 bytes for transmission. This is necessary due to the discrete possible values of the DLC if > 8 bytes.
              CanHandleType: value=BASIC, type=ENUM, uuid=3517ac78-6104-448d-9492-dda90826c4e7  # Specifies the type (Full-CAN or Basic-CAN) of a hardware object.
              CanHwObjectCount: value=1, type=INTEGER, min-value=1, max-value=64, uuid=3926fa7b-3966-4233-a590-86b4fefc8bef  # Number of hardware objects used to implement one HOH. In case of a HRH this parameter defines the number of elements in the hardware FIFO or the number of shadow buffers, in case of a HTH it defines the number of hardware objects used for multiplexed transmission or for a hardware FIFO used by a FullCAN HTH.
              CanHwFIFOThreshold: value=1, type=INTEGER, min-value=1, max-value=64, uuid=c7a069fe-5ddc-4e50-8ca6-744acf2b1ea2  # Number of the threshold size of Rx/TxEvent FIFO buffer to copy the data.
              CanIdType: value=STANDARD, type=ENUM, uuid=3a9cb520-d596-4159-a49a-12283e2e3727  # Specifies whether the IdValue is of type
              CanObjectId: value=0, type=INTEGER, min-value=0, max-value=65535, uuid=2ad44f3b-7c83-4b63-9652-81fc9ef8d976  # Holds the handle ID of HRH or HTH. The value of this parameter is unique in a given CAN Driver, and it should start with 0 and continue without any gaps.
              CanObjectType: value=RECEIVE, type=ENUM, uuid=759258e0-1cb4-4e36-b006-b90a9b7db4ca  # Specifies if the HardwareObject is used as Transmit or as Receive object
              CanTriggerTransmitEnable: value=false, type=BOOLEAN, uuid=211672f2-2007-4622-ba46-85f7051200bd  # This parameter defines if or if not Can supports the trigger-transmit API for this handle.
              CanHardwareObjectUsesPolling: value=false, type=BOOLEAN, uuid=555ffd24-0526-479b-8f5d-9ad032c6ab48  # Enables polling of this hardware object.
            CanHwFilter (): uuid=e9c20ac7-90c3-4384-8731-3da58321de9c  # This container is only valid for HRHs and contains the configuration (parameters) of one hardware filter.
              parameter CanHwFilterCode: value=0, type=INTEGER, min-value=0, max-value=4294967295, uuid=504b84c7-642a-4f57-9cf1-ad0c39e839dd  # Specifies (together with the filter mask) the identifiers range that passes the hardware filter.
              parameter CanHwFilterMask: value=2047, type=INTEGER, min-value=0, max-value=4294967295, uuid=1f72975c-d2e1-42f9-9bad-41e41e957c48  # Describes a mask for hardware-based filtering of CAN identifiers. The CAN identifiers of incoming messages are masked with the appropriate CanFilterMaskValue. Bits holding a 0 mean don't care, i.e. do not compare the message's identifier in the respective bit position.
            CanTTHardwareObjectTrigger (): uuid=4885e458-320e-47ee-8133-959ac1fae2ba  # CanTTHardwareObjectTrigger is specified in the SWS TTCAN and contains the configuration (parameters) of TTCAN triggers for Hardware Objects, which are additional to the configuration (parameters) of CAN Hardware Objects.
              5 x parameter:
                CanTTHardwareObjectBaseCycle: value=0, type=INTEGER, min-value=0, max-value=63, uuid=94f51824-1dcc-43f7-9cbe-efcf086030f0  # Defines the cycle_offset.
                CanTTHardwareObjectCycleRepetition: value=1, type=INTEGER, min-value=1, max-value=64, uuid=92a19fe8-2108-4901-90bc-51d5119d379c  # Defines the repeat_factor.
                CanTTHardwareObjectTimeMark: value=0, type=INTEGER, min-value=0, max-value=65535, uuid=de1b1007-7efd-4789-b890-ac658b3470c3  # Defines the point in time, when the trigger will be activated.
                CanTTHardwareObjectTriggerId: value=0, type=INTEGER, min-value=0, max-value=63, uuid=d5aa5d18-4f3d-4096-97e4-9a25401c1ef2  # Sequential number which allows separation of different TTCAN triggers configured for one and the same hardware object.
                CanTTHardwareObjectTriggerType: value=CAN_TT_RX_TRIGGER, type=ENUM, uuid=7936b340-7dd8-4115-bd34-1a275b9d62ca  # Defines the type of the trigger associated with the hardware object. This parameter depends on plain CAN parameter CAN_OBJECT_TYPE.
          CanHwFilter: uuid=59086400-e727-4dfd-aa92-92f2fdd98014  # This container is only valid for HRHs and contains the configuration (parameters) of one hardware filter.
            parameter CanHwFilterCode: value=0, type=INTEGER, min-value=0, max-value=4294967295, uuid=ad027779-9c59-44a3-8f65-aa51bff00fa3  # Specifies (together with the filter mask) the identifiers range that passes the hardware filter.
            parameter CanHwFilterMask: value=2047, type=INTEGER, min-value=0, max-value=4294967295, uuid=af2fd990-cfba-464c-a4a8-f3955139e997  # Describes a mask for hardware-based filtering of CAN identifiers. The CAN identifiers of incoming messages are masked with the appropriate CanFilterMaskValue. Bits holding a 0 mean don't care, i.e. do not compare the message's identifier in the respective bit position.
          CanTTHardwareObjectTrigger: uuid=80331446-a875-402c-8daa-c93bf9bafe35  # CanTTHardwareObjectTrigger is specified in the SWS TTCAN and contains the configuration (parameters) of TTCAN triggers for Hardware Objects, which are additional to the configuration (parameters) of CAN Hardware Objects.
            5 x parameter:
              CanTTHardwareObjectBaseCycle: value=0, type=INTEGER, min-value=0, max-value=63, uuid=55fd284c-2954-4949-98cc-75866fbc3055  # Defines the cycle_offset.
              CanTTHardwareObjectCycleRepetition: value=1, type=INTEGER, min-value=1, max-value=64, uuid=7f174cb4-c085-4068-9ad6-1aba911b78c8  # Defines the repeat_factor.
              CanTTHardwareObjectTimeMark: value=0, type=INTEGER, min-value=0, max-value=65535, uuid=bdd5bbf0-f474-45ef-8806-0f4923d0b6e7  # Defines the point in time, when the trigger will be activated.
              CanTTHardwareObjectTriggerId: value=0, type=INTEGER, min-value=0, max-value=63, uuid=6aa80b15-885c-479b-8b31-92964b58e329  # Sequential number which allows separation of different TTCAN triggers configured for one and the same hardware object.
              CanTTHardwareObjectTriggerType: value=CAN_TT_RX_TRIGGER, type=ENUM, uuid=af6b58ee-0691-46a2-8910-ff21a4ccc480  # Defines the type of the trigger associated with the hardware object. This parameter depends on plain CAN parameter CAN_OBJECT_TYPE.
          CanIcom: uuid=3ecbafc0-ee0c-4290-9c00-668b9d53c0d9  # This container contains the parameters for configuring pretended networking
            parameter CanIcomConfigId: value=1, type=INTEGER, min-value=1, max-value=255, uuid=5e875461-0440-4166-bd2e-cb496e250b94  # This parameter identifies the ID of the ICOM configuration.
            parameter CanIcomWakeOnBusOff: value=true, type=BOOLEAN, uuid=9ef291b4-4395-4f2e-9579-9ff151fc6acc  # This parameter defines that the MCU shall wake if the bus off is detected or not.
            4 x :
              CanIcomConfig: uuid=b5243f14-3ebc-4561-8ae2-c2ab3fe10922  # This container contains the configuration parameters of the ICOM Configuration.
                parameter CanIcomConfigId: value=1, type=INTEGER, min-value=1, max-value=255, uuid=34c2ff56-3a85-4051-b150-87c163298f2e  # This parameter identifies the ID of the ICOM configuration.
                parameter CanIcomWakeOnBusOff: value=true, type=BOOLEAN, uuid=9ec1df1d-3808-4ae9-a956-491175b67e64  # This parameter defines that the MCU shall wake if the bus off is detected or not.
                3 x :
                  CanIcomWakeupCauses: uuid=2e1157d7-cfb8-4988-a488-feabfb20b5c9  # This container contains the configuration parameters of the wakeup causes to leave the power saving mode.
                    5 x parameter:
                      CanIcomCounterValue: value=1, type=INTEGER, min-value=1, max-value=65536, uuid=c0c2edbd-7c80-4556-a141-c2794c39ebe0  # This parameter defines that the MCU shall wake if the message with the ID is received n times on the communication channel.
                      CanIcomMessageId: value=0, type=INTEGER, min-value=0, max-value=536870912, uuid=13bf2d13-ee84-466a-b63c-5a9b978e0f48  # This parameter defines the message ID the wakeup causes of this CanIcomRxMessage are configured for. In addition a mask (CanIcomMessageIdMask) can be defined, in that case it is possible to define a range of rx messages, which can create a wakeup condition.
                      CanIcomMessageIdMask: value=0, type=INTEGER, min-value=0, max-value=536870912, uuid=b28483ab-4720-4f9c-a006-2bc6d7ffaf5e  # Describes a mask for filtering of CAN identifiers. The CAN identifiers of incoming messages are masked with this CanIcomMessageIdMask. If the masked identifier matches the masked value of CanIcomMessageId, it can create a wakeup condition for this CanIcomRxMessage. Bits holding a 0 mean don't care, i.e. do not compare the message's identifier in the respective bit position. The mask shall be build by filling with leading 0.
                      CanIcomMissingMessageTimerValue: value=0.0, type=FLOAT, min-value=0.0, max-value=65535.0, uuid=3df39d8f-c816-4eb5-a625-8988fbb15c06  # This parameter defines that the MCU shall wake if the message with the ID is not received for a specific time in s on the
                      CanIcomPayloadLengthError: value=false, type=BOOLEAN, uuid=9fcf3125-33c2-43a7-896a-3af79013d74d  # This parameter defines that the MCU shall wake if a payload error occurs
                    CanIcomRxMessage (): uuid=f1d14ebe-58d3-4f35-8877-48c83e444135  # This container contains the configuration parameters for the wakeup causes for matching received messages. It has to be configured as often as received messages are defined as wakeup cause.
                      5 x parameter:
                        CanIcomCounterValue: value=1, type=INTEGER, min-value=1, max-value=65536, uuid=9d2814ed-87f4-4caa-8e42-54221fd69ae2  # This parameter defines that the MCU shall wake if the message with the ID is received n times on the communication channel.
                        CanIcomMessageId: value=0, type=INTEGER, min-value=0, max-value=536870912, uuid=628c9f3f-0c29-4856-a840-8b956c830276  # This parameter defines the message ID the wakeup causes of this CanIcomRxMessage are configured for. In addition a mask (CanIcomMessageIdMask) can be defined, in that case it is possible to define a range of rx messages, which can create a wakeup condition.
                        CanIcomMessageIdMask: value=0, type=INTEGER, min-value=0, max-value=536870912, uuid=caa15027-057b-4614-9467-98832d110b12  # Describes a mask for filtering of CAN identifiers. The CAN identifiers of incoming messages are masked with this CanIcomMessageIdMask. If the masked identifier matches the masked value of CanIcomMessageId, it can create a wakeup condition for this CanIcomRxMessage. Bits holding a 0 mean don't care, i.e. do not compare the message's identifier in the respective bit position. The mask shall be build by filling with leading 0.
                        CanIcomMissingMessageTimerValue: value=0.0, type=FLOAT, min-value=0.0, max-value=65535.0, uuid=228f5e1b-51b4-4ae8-8ea7-ff9bdb4f4aa8  # This parameter defines that the MCU shall wake if the message with the ID is not received for a specific time in s on the
                        CanIcomPayloadLengthError: value=false, type=BOOLEAN, uuid=bb33a557-055b-45ca-93a2-bc6a2e05d1ee  # This parameter defines that the MCU shall wake if a payload error occurs
                      CanIcomRxMessageSignalConfig (): uuid=8522d406-367a-4d83-bbbc-4570466f80c2  # This container contains the configuration parameters for the wakeup causes for matching signals.
                        parameter CanIcomSignalMask: value=0, type=INTEGER, min-value=0, max-value=9223372036854775807, uuid=f8e49a8a-5fea-4c07-b84c-830176f37228  # This parameter shall be used to mask a signal in the payload of a CAN message.
                        parameter CanIcomSignalOperation: value=AND, type=ENUM, uuid=9343c98f-1287-419f-8dfd-995d85ea8b4a  # This parameter defines the operation, which shall be used to verify the signal value creates a wakeup condition.
                        parameter CanIcomSignalValue: value=0, type=INTEGER, min-value=0, max-value=9223372036854775807, uuid=24b66d23-b09b-4006-8613-c9329b3b9038  # This parameter shall be used to define a signal value which shall be compared (CanIcomSignalOperation) with the masked CanIcomSignalMask value of the received signal (CanIcomSignalRef).
                    CanIcomRxMessageSignalConfig (): uuid=b8c0fdc3-c023-47e9-99da-90e695edd686  # This container contains the configuration parameters for the wakeup causes for matching signals.
                      parameter CanIcomSignalMask: value=0, type=INTEGER, min-value=0, max-value=9223372036854775807, uuid=d792dac3-bc79-4589-b00c-f2ac820e4d53  # This parameter shall be used to mask a signal in the payload of a CAN message.
                      parameter CanIcomSignalOperation: value=AND, type=ENUM, uuid=6b7df724-fbd0-46fa-ac5a-fe89e97252d7  # This parameter defines the operation, which shall be used to verify the signal value creates a wakeup condition.
                      parameter CanIcomSignalValue: value=0, type=INTEGER, min-value=0, max-value=9223372036854775807, uuid=36e9c41a-684f-492f-8303-58d7eb47cddb  # This parameter shall be used to define a signal value which shall be compared (CanIcomSignalOperation) with the masked CanIcomSignalMask value of the received signal (CanIcomSignalRef).
                  CanIcomRxMessage: uuid=dc9ce088-c832-4acf-a446-e00f7a2866f7  # This container contains the configuration parameters for the wakeup causes for matching received messages. It has to be configured as often as received messages are defined as wakeup cause.
                    5 x parameter:
                      CanIcomCounterValue: value=1, type=INTEGER, min-value=1, max-value=65536, uuid=324ccd1b-27de-41ae-8be1-62736257603e  # This parameter defines that the MCU shall wake if the message with the ID is received n times on the communication channel.
                      CanIcomMessageId: value=0, type=INTEGER, min-value=0, max-value=536870912, uuid=31573039-ae98-416e-adec-6480ec433a7c  # This parameter defines the message ID the wakeup causes of this CanIcomRxMessage are configured for. In addition a mask (CanIcomMessageIdMask) can be defined, in that case it is possible to define a range of rx messages, which can create a wakeup condition.
                      CanIcomMessageIdMask: value=0, type=INTEGER, min-value=0, max-value=536870912, uuid=99eb88cd-5994-4274-9624-75766b9a5906  # Describes a mask for filtering of CAN identifiers. The CAN identifiers of incoming messages are masked with this CanIcomMessageIdMask. If the masked identifier matches the masked value of CanIcomMessageId, it can create a wakeup condition for this CanIcomRxMessage. Bits holding a 0 mean don't care, i.e. do not compare the message's identifier in the respective bit position. The mask shall be build by filling with leading 0.
                      CanIcomMissingMessageTimerValue: value=0.0, type=FLOAT, min-value=0.0, max-value=65535.0, uuid=99d4a2c1-460a-46ef-b4ea-7de254d3b650  # This parameter defines that the MCU shall wake if the message with the ID is not received for a specific time in s on the
                      CanIcomPayloadLengthError: value=false, type=BOOLEAN, uuid=5c85b599-0fa4-4e1b-83ca-4473f56c31bc  # This parameter defines that the MCU shall wake if a payload error occurs
                    CanIcomRxMessageSignalConfig (): uuid=4c4376d2-3eb0-4be9-9588-8cbee22580a6  # This container contains the configuration parameters for the wakeup causes for matching signals.
                      parameter CanIcomSignalMask: value=0, type=INTEGER, min-value=0, max-value=9223372036854775807, uuid=fcbe90b2-19e5-413a-8284-21acde59d3b7  # This parameter shall be used to mask a signal in the payload of a CAN message.
                      parameter CanIcomSignalOperation: value=AND, type=ENUM, uuid=44ae7b3b-a079-4e47-9b22-c12266e34b24  # This parameter defines the operation, which shall be used to verify the signal value creates a wakeup condition.
                      parameter CanIcomSignalValue: value=0, type=INTEGER, min-value=0, max-value=9223372036854775807, uuid=324f4ad7-45b7-422a-815a-ccab5776258e  # This parameter shall be used to define a signal value which shall be compared (CanIcomSignalOperation) with the masked CanIcomSignalMask value of the received signal (CanIcomSignalRef).
                  CanIcomRxMessageSignalConfig: uuid=babeaf0d-e6dd-4221-bc8b-bcbf047c7327  # This container contains the configuration parameters for the wakeup causes for matching signals.
                    parameter CanIcomSignalMask: value=0, type=INTEGER, min-value=0, max-value=9223372036854775807, uuid=bfda13d7-f208-4e42-bea2-a3858b21d8b9  # This parameter shall be used to mask a signal in the payload of a CAN message.
                    parameter CanIcomSignalOperation: value=AND, type=ENUM, uuid=581478d6-a10f-4530-8437-582a4300ee73  # This parameter defines the operation, which shall be used to verify the signal value creates a wakeup condition.
                    parameter CanIcomSignalValue: value=0, type=INTEGER, min-value=0, max-value=9223372036854775807, uuid=8fae54f5-e9de-4ce5-801f-5b12a89c268e  # This parameter shall be used to define a signal value which shall be compared (CanIcomSignalOperation) with the masked CanIcomSignalMask value of the received signal (CanIcomSignalRef).
              CanIcomWakeupCauses: uuid=2a8e4e55-78f9-448e-8ac0-feaa939d290d  # This container contains the configuration parameters of the wakeup causes to leave the power saving mode.
                5 x parameter:
                  CanIcomCounterValue: value=1, type=INTEGER, min-value=1, max-value=65536, uuid=6415c716-4867-47e7-bca5-0d94ee553f3e  # This parameter defines that the MCU shall wake if the message with the ID is received n times on the communication channel.
                  CanIcomMessageId: value=0, type=INTEGER, min-value=0, max-value=536870912, uuid=cef2295c-8e17-4efa-ba90-203ae5b5e855  # This parameter defines the message ID the wakeup causes of this CanIcomRxMessage are configured for. In addition a mask (CanIcomMessageIdMask) can be defined, in that case it is possible to define a range of rx messages, which can create a wakeup condition.
                  CanIcomMessageIdMask: value=0, type=INTEGER, min-value=0, max-value=536870912, uuid=c5960a18-b91c-4f0a-8649-69da3bbbde50  # Describes a mask for filtering of CAN identifiers. The CAN identifiers of incoming messages are masked with this CanIcomMessageIdMask. If the masked identifier matches the masked value of CanIcomMessageId, it can create a wakeup condition for this CanIcomRxMessage. Bits holding a 0 mean don't care, i.e. do not compare the message's identifier in the respective bit position. The mask shall be build by filling with leading 0.
                  CanIcomMissingMessageTimerValue: value=0.0, type=FLOAT, min-value=0.0, max-value=65535.0, uuid=5b1ae89d-5529-49f5-9777-5cdbb7e8e7e8  # This parameter defines that the MCU shall wake if the message with the ID is not received for a specific time in s on the
                  CanIcomPayloadLengthError: value=false, type=BOOLEAN, uuid=7ba2111b-bfcc-422f-a74d-85a9635c49db  # This parameter defines that the MCU shall wake if a payload error occurs
                CanIcomRxMessage (): uuid=370984ac-dc72-4889-9664-42cd7b97b439  # This container contains the configuration parameters for the wakeup causes for matching received messages. It has to be configured as often as received messages are defined as wakeup cause.
                  5 x parameter:
                    CanIcomCounterValue: value=1, type=INTEGER, min-value=1, max-value=65536, uuid=07407960-6a92-4036-a29a-8b1ae2bc8031  # This parameter defines that the MCU shall wake if the message with the ID is received n times on the communication channel.
                    CanIcomMessageId: value=0, type=INTEGER, min-value=0, max-value=536870912, uuid=0c06d8c1-fa50-4ff8-a6f6-3e42a30447ba  # This parameter defines the message ID the wakeup causes of this CanIcomRxMessage are configured for. In addition a mask (CanIcomMessageIdMask) can be defined, in that case it is possible to define a range of rx messages, which can create a wakeup condition.
                    CanIcomMessageIdMask: value=0, type=INTEGER, min-value=0, max-value=536870912, uuid=21c3758b-1159-4347-8f42-f878c7b8715f  # Describes a mask for filtering of CAN identifiers. The CAN identifiers of incoming messages are masked with this CanIcomMessageIdMask. If the masked identifier matches the masked value of CanIcomMessageId, it can create a wakeup condition for this CanIcomRxMessage. Bits holding a 0 mean don't care, i.e. do not compare the message's identifier in the respective bit position. The mask shall be build by filling with leading 0.
                    CanIcomMissingMessageTimerValue: value=0.0, type=FLOAT, min-value=0.0, max-value=65535.0, uuid=dbbd5862-054e-4002-b9df-a01917bab694  # This parameter defines that the MCU shall wake if the message with the ID is not received for a specific time in s on the
                    CanIcomPayloadLengthError: value=false, type=BOOLEAN, uuid=0593dbc1-558f-44f5-9847-01938973ccc5  # This parameter defines that the MCU shall wake if a payload error occurs
                  CanIcomRxMessageSignalConfig (): uuid=d7bb65ca-bfa4-4e65-b8f5-6d573eecb25a  # This container contains the configuration parameters for the wakeup causes for matching signals.
                    parameter CanIcomSignalMask: value=0, type=INTEGER, min-value=0, max-value=9223372036854775807, uuid=917c3b39-53b4-43a0-bbe6-ca73ccbd0933  # This parameter shall be used to mask a signal in the payload of a CAN message.
                    parameter CanIcomSignalOperation: value=AND, type=ENUM, uuid=b845eb9c-8b97-468f-87e1-ff2e6e44b9ff  # This parameter defines the operation, which shall be used to verify the signal value creates a wakeup condition.
                    parameter CanIcomSignalValue: value=0, type=INTEGER, min-value=0, max-value=9223372036854775807, uuid=a118cbd5-0c79-4b66-98da-55596403be8e  # This parameter shall be used to define a signal value which shall be compared (CanIcomSignalOperation) with the masked CanIcomSignalMask value of the received signal (CanIcomSignalRef).
                CanIcomRxMessageSignalConfig (): uuid=6bb2e04d-b788-4c20-af4e-3068d009bd59  # This container contains the configuration parameters for the wakeup causes for matching signals.
                  parameter CanIcomSignalMask: value=0, type=INTEGER, min-value=0, max-value=9223372036854775807, uuid=f5179424-8712-41fa-b0b5-fa26ce15b436  # This parameter shall be used to mask a signal in the payload of a CAN message.
                  parameter CanIcomSignalOperation: value=AND, type=ENUM, uuid=c67ee50e-e687-442b-a433-02a58ce93348  # This parameter defines the operation, which shall be used to verify the signal value creates a wakeup condition.
                  parameter CanIcomSignalValue: value=0, type=INTEGER, min-value=0, max-value=9223372036854775807, uuid=6e50ddbe-cbec-4a1f-a407-33c5cc77812d  # This parameter shall be used to define a signal value which shall be compared (CanIcomSignalOperation) with the masked CanIcomSignalMask value of the received signal (CanIcomSignalRef).
              CanIcomRxMessage: uuid=85582333-05d0-46b8-a859-121e56cf7340  # This container contains the configuration parameters for the wakeup causes for matching received messages. It has to be configured as often as received messages are defined as wakeup cause.
                5 x parameter:
                  CanIcomCounterValue: value=1, type=INTEGER, min-value=1, max-value=65536, uuid=538207af-7fd3-42fa-8b57-867dfafdc9fa  # This parameter defines that the MCU shall wake if the message with the ID is received n times on the communication channel.
                  CanIcomMessageId: value=0, type=INTEGER, min-value=0, max-value=536870912, uuid=7b1868bc-4bcf-493c-859a-504d93632f03  # This parameter defines the message ID the wakeup causes of this CanIcomRxMessage are configured for. In addition a mask (CanIcomMessageIdMask) can be defined, in that case it is possible to define a range of rx messages, which can create a wakeup condition.
                  CanIcomMessageIdMask: value=0, type=INTEGER, min-value=0, max-value=536870912, uuid=c5f094f7-d1ca-4bd3-bc4d-0dcc10ca5bed  # Describes a mask for filtering of CAN identifiers. The CAN identifiers of incoming messages are masked with this CanIcomMessageIdMask. If the masked identifier matches the masked value of CanIcomMessageId, it can create a wakeup condition for this CanIcomRxMessage. Bits holding a 0 mean don't care, i.e. do not compare the message's identifier in the respective bit position. The mask shall be build by filling with leading 0.
                  CanIcomMissingMessageTimerValue: value=0.0, type=FLOAT, min-value=0.0, max-value=65535.0, uuid=2bc7ac83-5790-4d20-a9a4-9d1bc15ee157  # This parameter defines that the MCU shall wake if the message with the ID is not received for a specific time in s on the
                  CanIcomPayloadLengthError: value=false, type=BOOLEAN, uuid=756dd08a-0713-478d-a350-ddc9374e54f0  # This parameter defines that the MCU shall wake if a payload error occurs
                CanIcomRxMessageSignalConfig (): uuid=404c628d-1fd2-4860-8d31-ac1fbe9ae292  # This container contains the configuration parameters for the wakeup causes for matching signals.
                  parameter CanIcomSignalMask: value=0, type=INTEGER, min-value=0, max-value=9223372036854775807, uuid=9a1408e7-1d9a-419e-a649-347bef09f78f  # This parameter shall be used to mask a signal in the payload of a CAN message.
                  parameter CanIcomSignalOperation: value=AND, type=ENUM, uuid=90c8b8a4-5af6-452c-9477-e5994ab85f10  # This parameter defines the operation, which shall be used to verify the signal value creates a wakeup condition.
                  parameter CanIcomSignalValue: value=0, type=INTEGER, min-value=0, max-value=9223372036854775807, uuid=c04456b8-f81f-474e-bfc8-4092125882ac  # This parameter shall be used to define a signal value which shall be compared (CanIcomSignalOperation) with the masked CanIcomSignalMask value of the received signal (CanIcomSignalRef).
              CanIcomRxMessageSignalConfig: uuid=6b1b6416-8484-493f-99eb-2d29e8145ac2  # This container contains the configuration parameters for the wakeup causes for matching signals.
                parameter CanIcomSignalMask: value=0, type=INTEGER, min-value=0, max-value=9223372036854775807, uuid=da49b9de-5fc7-4fed-8724-aea7b2016aa4  # This parameter shall be used to mask a signal in the payload of a CAN message.
                parameter CanIcomSignalOperation: value=AND, type=ENUM, uuid=7b760a30-c755-45c3-882b-33549844bd93  # This parameter defines the operation, which shall be used to verify the signal value creates a wakeup condition.
                parameter CanIcomSignalValue: value=0, type=INTEGER, min-value=0, max-value=9223372036854775807, uuid=46b35916-0e3e-4811-97b1-701df49a88b9  # This parameter shall be used to define a signal value which shall be compared (CanIcomSignalOperation) with the masked CanIcomSignalMask value of the received signal (CanIcomSignalRef).
          CanIcomConfig: uuid=d5796581-633e-4897-a481-60d8589c222b  # This container contains the configuration parameters of the ICOM Configuration.
            parameter CanIcomConfigId: value=1, type=INTEGER, min-value=1, max-value=255, uuid=de113b26-12cb-4771-ba99-12d1beb2be85  # This parameter identifies the ID of the ICOM configuration.
            parameter CanIcomWakeOnBusOff: value=true, type=BOOLEAN, uuid=8d0b2251-1177-4364-b6e2-a137bdb34db5  # This parameter defines that the MCU shall wake if the bus off is detected or not.
            3 x :
              CanIcomWakeupCauses: uuid=4fc71474-4d68-47ff-8700-f57687ed2801  # This container contains the configuration parameters of the wakeup causes to leave the power saving mode.
                5 x parameter:
                  CanIcomCounterValue: value=1, type=INTEGER, min-value=1, max-value=65536, uuid=4315a745-5c16-43c4-b7a9-9187140c5b35  # This parameter defines that the MCU shall wake if the message with the ID is received n times on the communication channel.
                  CanIcomMessageId: value=0, type=INTEGER, min-value=0, max-value=536870912, uuid=38939c56-4d63-416b-9ea0-0e24eec7e8ee  # This parameter defines the message ID the wakeup causes of this CanIcomRxMessage are configured for. In addition a mask (CanIcomMessageIdMask) can be defined, in that case it is possible to define a range of rx messages, which can create a wakeup condition.
                  CanIcomMessageIdMask: value=0, type=INTEGER, min-value=0, max-value=536870912, uuid=9810b661-75fb-487b-96d6-b2ae975933d5  # Describes a mask for filtering of CAN identifiers. The CAN identifiers of incoming messages are masked with this CanIcomMessageIdMask. If the masked identifier matches the masked value of CanIcomMessageId, it can create a wakeup condition for this CanIcomRxMessage. Bits holding a 0 mean don't care, i.e. do not compare the message's identifier in the respective bit position. The mask shall be build by filling with leading 0.
                  CanIcomMissingMessageTimerValue: value=0.0, type=FLOAT, min-value=0.0, max-value=65535.0, uuid=7a136bb6-5b12-4489-b2b0-76fe11a33b2c  # This parameter defines that the MCU shall wake if the message with the ID is not received for a specific time in s on the
                  CanIcomPayloadLengthError: value=false, type=BOOLEAN, uuid=3f9bdf01-ac8d-4756-b8b6-04d627c22137  # This parameter defines that the MCU shall wake if a payload error occurs
                CanIcomRxMessage (): uuid=859a008d-89a2-4b57-b04b-224f0c2f9de9  # This container contains the configuration parameters for the wakeup causes for matching received messages. It has to be configured as often as received messages are defined as wakeup cause.
                  5 x parameter:
                    CanIcomCounterValue: value=1, type=INTEGER, min-value=1, max-value=65536, uuid=32b8db4d-04c9-475e-80aa-d9e40e90bde5  # This parameter defines that the MCU shall wake if the message with the ID is received n times on the communication channel.
                    CanIcomMessageId: value=0, type=INTEGER, min-value=0, max-value=536870912, uuid=da74cf82-01b5-4828-801a-0d59cabe18f2  # This parameter defines the message ID the wakeup causes of this CanIcomRxMessage are configured for. In addition a mask (CanIcomMessageIdMask) can be defined, in that case it is possible to define a range of rx messages, which can create a wakeup condition.
                    CanIcomMessageIdMask: value=0, type=INTEGER, min-value=0, max-value=536870912, uuid=d81eefee-376f-4ce2-84f7-b0d18d14d8d2  # Describes a mask for filtering of CAN identifiers. The CAN identifiers of incoming messages are masked with this CanIcomMessageIdMask. If the masked identifier matches the masked value of CanIcomMessageId, it can create a wakeup condition for this CanIcomRxMessage. Bits holding a 0 mean don't care, i.e. do not compare the message's identifier in the respective bit position. The mask shall be build by filling with leading 0.
                    CanIcomMissingMessageTimerValue: value=0.0, type=FLOAT, min-value=0.0, max-value=65535.0, uuid=73bdfb6c-a120-4b41-8fa1-3dd70f229355  # This parameter defines that the MCU shall wake if the message with the ID is not received for a specific time in s on the
                    CanIcomPayloadLengthError: value=false, type=BOOLEAN, uuid=3a2aa3f3-4be3-4783-b18b-76317e7cc3d8  # This parameter defines that the MCU shall wake if a payload error occurs
                  CanIcomRxMessageSignalConfig (): uuid=95bc1ae0-3ec8-4366-b055-d579302b8388  # This container contains the configuration parameters for the wakeup causes for matching signals.
                    parameter CanIcomSignalMask: value=0, type=INTEGER, min-value=0, max-value=9223372036854775807, uuid=0ed046a8-865d-4c3f-9ec4-def34493f500  # This parameter shall be used to mask a signal in the payload of a CAN message.
                    parameter CanIcomSignalOperation: value=AND, type=ENUM, uuid=f883c0f7-dfd6-4a2a-80bb-1be6a1bc4bfa  # This parameter defines the operation, which shall be used to verify the signal value creates a wakeup condition.
                    parameter CanIcomSignalValue: value=0, type=INTEGER, min-value=0, max-value=9223372036854775807, uuid=f0161380-08f0-4a18-bb4a-bb1a0975c1e0  # This parameter shall be used to define a signal value which shall be compared (CanIcomSignalOperation) with the masked CanIcomSignalMask value of the received signal (CanIcomSignalRef).
                CanIcomRxMessageSignalConfig (): uuid=de7e7a33-904e-471a-a65a-73ae67b0f3ce  # This container contains the configuration parameters for the wakeup causes for matching signals.
                  parameter CanIcomSignalMask: value=0, type=INTEGER, min-value=0, max-value=9223372036854775807, uuid=2858d23c-b65c-4f82-93ac-b9a1c599b6ec  # This parameter shall be used to mask a signal in the payload of a CAN message.
                  parameter CanIcomSignalOperation: value=AND, type=ENUM, uuid=91fe8890-11e0-49b0-b9cb-44f1bf46e1d6  # This parameter defines the operation, which shall be used to verify the signal value creates a wakeup condition.
                  parameter CanIcomSignalValue: value=0, type=INTEGER, min-value=0, max-value=9223372036854775807, uuid=cecb300f-bf31-40c1-a002-0ddb0df16a5d  # This parameter shall be used to define a signal value which shall be compared (CanIcomSignalOperation) with the masked CanIcomSignalMask value of the received signal (CanIcomSignalRef).
              CanIcomRxMessage: uuid=0a6e9db0-3604-4eea-8da3-041e0730e933  # This container contains the configuration parameters for the wakeup causes for matching received messages. It has to be configured as often as received messages are defined as wakeup cause.
                5 x parameter:
                  CanIcomCounterValue: value=1, type=INTEGER, min-value=1, max-value=65536, uuid=bb671c34-e1c3-472f-b4ef-0696f279f659  # This parameter defines that the MCU shall wake if the message with the ID is received n times on the communication channel.
                  CanIcomMessageId: value=0, type=INTEGER, min-value=0, max-value=536870912, uuid=0b698363-8765-4e8d-ba4e-d1e22f61f880  # This parameter defines the message ID the wakeup causes of this CanIcomRxMessage are configured for. In addition a mask (CanIcomMessageIdMask) can be defined, in that case it is possible to define a range of rx messages, which can create a wakeup condition.
                  CanIcomMessageIdMask: value=0, type=INTEGER, min-value=0, max-value=536870912, uuid=d7d93646-ddb8-4b4a-a18d-a1b8f519da8e  # Describes a mask for filtering of CAN identifiers. The CAN identifiers of incoming messages are masked with this CanIcomMessageIdMask. If the masked identifier matches the masked value of CanIcomMessageId, it can create a wakeup condition for this CanIcomRxMessage. Bits holding a 0 mean don't care, i.e. do not compare the message's identifier in the respective bit position. The mask shall be build by filling with leading 0.
                  CanIcomMissingMessageTimerValue: value=0.0, type=FLOAT, min-value=0.0, max-value=65535.0, uuid=ecf909f5-00a3-4f3b-8c25-b98b6642dd59  # This parameter defines that the MCU shall wake if the message with the ID is not received for a specific time in s on the
                  CanIcomPayloadLengthError: value=false, type=BOOLEAN, uuid=e30d9691-bb0b-4303-b0f8-53a75390f325  # This parameter defines that the MCU shall wake if a payload error occurs
                CanIcomRxMessageSignalConfig (): uuid=e0df76b5-0c06-400d-a9b0-ef6189a9abcb  # This container contains the configuration parameters for the wakeup causes for matching signals.
                  parameter CanIcomSignalMask: value=0, type=INTEGER, min-value=0, max-value=9223372036854775807, uuid=5867a8e3-76f0-4729-a90d-dfebf84b5a02  # This parameter shall be used to mask a signal in the payload of a CAN message.
                  parameter CanIcomSignalOperation: value=AND, type=ENUM, uuid=fb51dec7-5acb-44e2-b867-8f91c7ed420c  # This parameter defines the operation, which shall be used to verify the signal value creates a wakeup condition.
                  parameter CanIcomSignalValue: value=0, type=INTEGER, min-value=0, max-value=9223372036854775807, uuid=a353b625-d8f3-41d2-8f85-916a50f4b7a0  # This parameter shall be used to define a signal value which shall be compared (CanIcomSignalOperation) with the masked CanIcomSignalMask value of the received signal (CanIcomSignalRef).
              CanIcomRxMessageSignalConfig: uuid=ab64236f-8986-4780-a754-c4bbbf00ff01  # This container contains the configuration parameters for the wakeup causes for matching signals.
                parameter CanIcomSignalMask: value=0, type=INTEGER, min-value=0, max-value=9223372036854775807, uuid=7ee9a398-d890-4ec7-91fc-b400a78d9eef  # This parameter shall be used to mask a signal in the payload of a CAN message.
                parameter CanIcomSignalOperation: value=AND, type=ENUM, uuid=78a62dc3-7b8d-4465-b346-ac6a819f245d  # This parameter defines the operation, which shall be used to verify the signal value creates a wakeup condition.
                parameter CanIcomSignalValue: value=0, type=INTEGER, min-value=0, max-value=9223372036854775807, uuid=28f411e0-4aec-45cc-a241-efbb2a76fd82  # This parameter shall be used to define a signal value which shall be compared (CanIcomSignalOperation) with the masked CanIcomSignalMask value of the received signal (CanIcomSignalRef).
          CanIcomWakeupCauses: uuid=9bff23e5-1a5b-4fe2-bcf5-929b9c499dba  # This container contains the configuration parameters of the wakeup causes to leave the power saving mode.
            5 x parameter:
              CanIcomCounterValue: value=1, type=INTEGER, min-value=1, max-value=65536, uuid=1a1c1361-9358-45c3-a48d-ada80f1271d6  # This parameter defines that the MCU shall wake if the message with the ID is received n times on the communication channel.
              CanIcomMessageId: value=0, type=INTEGER, min-value=0, max-value=536870912, uuid=02a0cc75-4623-4251-9628-16fb6f9b372e  # This parameter defines the message ID the wakeup causes of this CanIcomRxMessage are configured for. In addition a mask (CanIcomMessageIdMask) can be defined, in that case it is possible to define a range of rx messages, which can create a wakeup condition.
              CanIcomMessageIdMask: value=0, type=INTEGER, min-value=0, max-value=536870912, uuid=0d5366b3-1297-4168-8ba5-3e524e143012  # Describes a mask for filtering of CAN identifiers. The CAN identifiers of incoming messages are masked with this CanIcomMessageIdMask. If the masked identifier matches the masked value of CanIcomMessageId, it can create a wakeup condition for this CanIcomRxMessage. Bits holding a 0 mean don't care, i.e. do not compare the message's identifier in the respective bit position. The mask shall be build by filling with leading 0.
              CanIcomMissingMessageTimerValue: value=0.0, type=FLOAT, min-value=0.0, max-value=65535.0, uuid=407f34a4-b14e-4bf2-a039-5325b130e82f  # This parameter defines that the MCU shall wake if the message with the ID is not received for a specific time in s on the
              CanIcomPayloadLengthError: value=false, type=BOOLEAN, uuid=19bbad82-2e69-4552-8f00-893006c09a97  # This parameter defines that the MCU shall wake if a payload error occurs
            CanIcomRxMessage (): uuid=15ee46cf-55c1-4aac-95f1-03d7a47aecc0  # This container contains the configuration parameters for the wakeup causes for matching received messages. It has to be configured as often as received messages are defined as wakeup cause.
              5 x parameter:
                CanIcomCounterValue: value=1, type=INTEGER, min-value=1, max-value=65536, uuid=4026422e-c4c6-4f74-ada0-8ccb6ad04839  # This parameter defines that the MCU shall wake if the message with the ID is received n times on the communication channel.
                CanIcomMessageId: value=0, type=INTEGER, min-value=0, max-value=536870912, uuid=b53944c8-d591-4763-95ce-348fea1da375  # This parameter defines the message ID the wakeup causes of this CanIcomRxMessage are configured for. In addition a mask (CanIcomMessageIdMask) can be defined, in that case it is possible to define a range of rx messages, which can create a wakeup condition.
                CanIcomMessageIdMask: value=0, type=INTEGER, min-value=0, max-value=536870912, uuid=b72f11a7-ec8a-44f3-8749-7bef3a417d57  # Describes a mask for filtering of CAN identifiers. The CAN identifiers of incoming messages are masked with this CanIcomMessageIdMask. If the masked identifier matches the masked value of CanIcomMessageId, it can create a wakeup condition for this CanIcomRxMessage. Bits holding a 0 mean don't care, i.e. do not compare the message's identifier in the respective bit position. The mask shall be build by filling with leading 0.
                CanIcomMissingMessageTimerValue: value=0.0, type=FLOAT, min-value=0.0, max-value=65535.0, uuid=3cd420cb-39fe-422a-9db4-2562953b6791  # This parameter defines that the MCU shall wake if the message with the ID is not received for a specific time in s on the
                CanIcomPayloadLengthError: value=false, type=BOOLEAN, uuid=d29a4b10-9eff-4ba3-92fa-e40173e1a6bd  # This parameter defines that the MCU shall wake if a payload error occurs
              CanIcomRxMessageSignalConfig (): uuid=acc1e71b-eac7-4bba-ac2c-fe780abc0049  # This container contains the configuration parameters for the wakeup causes for matching signals.
                parameter CanIcomSignalMask: value=0, type=INTEGER, min-value=0, max-value=9223372036854775807, uuid=35ee3eac-3109-44dc-aff3-2f2e3c5a99f2  # This parameter shall be used to mask a signal in the payload of a CAN message.
                parameter CanIcomSignalOperation: value=AND, type=ENUM, uuid=f687b0fb-4cec-4e86-927d-1d2ce33a1723  # This parameter defines the operation, which shall be used to verify the signal value creates a wakeup condition.
                parameter CanIcomSignalValue: value=0, type=INTEGER, min-value=0, max-value=9223372036854775807, uuid=76c264ea-afd1-435e-819f-fae6d34c8093  # This parameter shall be used to define a signal value which shall be compared (CanIcomSignalOperation) with the masked CanIcomSignalMask value of the received signal (CanIcomSignalRef).
            CanIcomRxMessageSignalConfig (): uuid=dd5217f0-062f-4878-a07c-43bd28715b54  # This container contains the configuration parameters for the wakeup causes for matching signals.
              parameter CanIcomSignalMask: value=0, type=INTEGER, min-value=0, max-value=9223372036854775807, uuid=a5fffd24-7974-4227-a8e9-36480ba0dc30  # This parameter shall be used to mask a signal in the payload of a CAN message.
              parameter CanIcomSignalOperation: value=AND, type=ENUM, uuid=d46bf3d3-1a4e-4620-ac5b-83efcfc8601e  # This parameter defines the operation, which shall be used to verify the signal value creates a wakeup condition.
              parameter CanIcomSignalValue: value=0, type=INTEGER, min-value=0, max-value=9223372036854775807, uuid=4e78f088-4576-4438-a35c-56f7d1db9aca  # This parameter shall be used to define a signal value which shall be compared (CanIcomSignalOperation) with the masked CanIcomSignalMask value of the received signal (CanIcomSignalRef).
          CanIcomRxMessage: uuid=42a4bf82-4277-40f7-b016-dd3ddef8a8d9  # This container contains the configuration parameters for the wakeup causes for matching received messages. It has to be configured as often as received messages are defined as wakeup cause.
            5 x parameter:
              CanIcomCounterValue: value=1, type=INTEGER, min-value=1, max-value=65536, uuid=91b40546-f034-46e0-a173-291ef90c15d5  # This parameter defines that the MCU shall wake if the message with the ID is received n times on the communication channel.
              CanIcomMessageId: value=0, type=INTEGER, min-value=0, max-value=536870912, uuid=c75f70a3-c6a5-4081-b4de-c2236f5998d2  # This parameter defines the message ID the wakeup causes of this CanIcomRxMessage are configured for. In addition a mask (CanIcomMessageIdMask) can be defined, in that case it is possible to define a range of rx messages, which can create a wakeup condition.
              CanIcomMessageIdMask: value=0, type=INTEGER, min-value=0, max-value=536870912, uuid=3392acae-4b64-43df-a27f-fe803aab8166  # Describes a mask for filtering of CAN identifiers. The CAN identifiers of incoming messages are masked with this CanIcomMessageIdMask. If the masked identifier matches the masked value of CanIcomMessageId, it can create a wakeup condition for this CanIcomRxMessage. Bits holding a 0 mean don't care, i.e. do not compare the message's identifier in the respective bit position. The mask shall be build by filling with leading 0.
              CanIcomMissingMessageTimerValue: value=0.0, type=FLOAT, min-value=0.0, max-value=65535.0, uuid=1c5a2135-00a8-4ba2-a4b2-c6954fdc2d86  # This parameter defines that the MCU shall wake if the message with the ID is not received for a specific time in s on the
              CanIcomPayloadLengthError: value=false, type=BOOLEAN, uuid=c58223d0-2e04-4d44-972a-3b95d460736a  # This parameter defines that the MCU shall wake if a payload error occurs
            CanIcomRxMessageSignalConfig (): uuid=943970ee-4b51-436e-a1be-6e7dda854bf4  # This container contains the configuration parameters for the wakeup causes for matching signals.
              parameter CanIcomSignalMask: value=0, type=INTEGER, min-value=0, max-value=9223372036854775807, uuid=dd3bcd1f-e8d5-4bd0-b7d2-d57d9754b0c9  # This parameter shall be used to mask a signal in the payload of a CAN message.
              parameter CanIcomSignalOperation: value=AND, type=ENUM, uuid=98646b89-23fd-4ed1-b6f5-841340589c91  # This parameter defines the operation, which shall be used to verify the signal value creates a wakeup condition.
              parameter CanIcomSignalValue: value=0, type=INTEGER, min-value=0, max-value=9223372036854775807, uuid=268f6529-00e7-4b7d-8ac5-f26cd030e1cf  # This parameter shall be used to define a signal value which shall be compared (CanIcomSignalOperation) with the masked CanIcomSignalMask value of the received signal (CanIcomSignalRef).
          CanIcomRxMessageSignalConfig: uuid=61dae3b8-24f1-4bd8-b5d2-4d9ffb4ff0a8  # This container contains the configuration parameters for the wakeup causes for matching signals.
            parameter CanIcomSignalMask: value=0, type=INTEGER, min-value=0, max-value=9223372036854775807, uuid=26db0d0e-47d5-4dda-997b-ea33f3d3630d  # This parameter shall be used to mask a signal in the payload of a CAN message.
            parameter CanIcomSignalOperation: value=AND, type=ENUM, uuid=8b0dc411-8f8f-4fbc-87e8-08b770422e51  # This parameter defines the operation, which shall be used to verify the signal value creates a wakeup condition.
            parameter CanIcomSignalValue: value=0, type=INTEGER, min-value=0, max-value=9223372036854775807, uuid=1bb5233e-ef7e-491a-a93e-1fd4b7fc0868  # This parameter shall be used to define a signal value which shall be compared (CanIcomSignalOperation) with the masked CanIcomSignalMask value of the received signal (CanIcomSignalRef).
          CanGeneral: uuid=1a4d3c82-c4d2-4fdc-af04-adfa93e3b1ba  # This container contains the parameters related each CAN Driver Unit.
            17 x parameter:
              CanDevErrorDetect: value=false, type=BOOLEAN, uuid=4b8f1e57-8217-49c5-a132-aee562dfd59e  # Switches the Default Error Tracer (Det) detection and notification ON or OFF.
              CanSafetyErrorDetect: value=true, type=BOOLEAN, uuid=48cc4111-9359-44b4-a8f7-7ed2ce7a8c6e  # Switches the Safety Default Error Tracer (Det) detection and notification ON or OFF.
              CanSupportMultipartition: value=true, type=BOOLEAN, uuid=add5ad19-d00f-48d9-986e-355eeced6e5b  # Only used for compatibility adaptation of some BSW modules, CanDriver ability multipartition depend on Resources module.
              CanIndex: value=0, type=INTEGER, min-value=0, max-value=255, uuid=815c23be-4fc0-495d-a369-e27fa26152f1  # Specifies the InstanceId of this module instance. If only one instance is present it shall have the Id 0.
              CanLPduReceiveCalloutFunction: type=STRING, uuid=ace9d591-be28-4068-8256-51cfa924be5a  # This parameter defines the existence and the name of a callout function that is called after a successful
              CanLPduTransmitCalloutFunction: type=STRING, uuid=32a947d3-852f-41f1-b78e-88e6c3858020  # This parameter defines the existence and the name of a callout function that is called before sending data
              CanMainFunctionBusoffPeriod: value=0.001, type=FLOAT, min-value=0.001, max-value=65.535, uuid=3cc2bb60-4c9e-40d6-a9c0-da0a28ef205a  # This parameter describes the period for cyclic call to Can_MainFunction_Busoff. Unit is seconds.
              CanMainFunctionModePeriod: value=0.001, type=FLOAT, min-value=0.001, max-value=65.535, uuid=79d97c75-d135-4b8f-aa4d-36566adf12a4  # This parameter describes the period for cyclic call to Can_MainFunction_Mode. Unit is seconds.
              CanMainFunctionWakeupPeriod: value=0.001, type=FLOAT, min-value=0.001, max-value=65.535, uuid=0cc37a6b-dd60-4623-a674-b92188206c55  # This parameter describes the period for cyclic call to Can_MainFunction_Wakeup. Unit is seconds.
              CanMultiplexedTransmission: value=false, type=BOOLEAN, uuid=b9133a83-1fac-4115-bf0f-304df6912f9b  # Specifies if multiplexed transmission shall be supported.ON or OFF
              CanNoAckErrSupport: value=false, type=BOOLEAN, uuid=7cd913ff-7b30-43b8-807e-4e4a693523e5  # Selects support of Get ACK ERR Status features in Can driver.Only for Faw.
              CanSetBaudrateApi: value=false, type=BOOLEAN, uuid=4eaacaea-14a1-4d29-a4ba-6a6155f50a54  # The support of the Can_SetBaudrate API is optional.
              CanPublicIcomSupport: value=false, type=BOOLEAN, uuid=63ab1d67-2614-478b-937a-58b1bd0fbdf7  # Selects support of Pretended Network features in Can driver.
              CanVersionInfoApi: value=false, type=BOOLEAN, uuid=bb7d2720-3d06-4494-a29e-a0dcaf1b9b05  # Switches the Can_GetVersionInfo() API ON or OFF.
              CanOSCounterSupport: value=false, type=BOOLEAN, uuid=ef7e7592-ab46-489a-8bfd-28707e1077cf  # Selects support of OSCounter features in Can driver.
              CanTimeoutLoopTime: value=0.001, type=FLOAT, min-value=1e-06, max-value=65.535, uuid=fa7fcea1-043b-4c1d-a654-b0131df2f9ac  # Specifies the maximum loop time for blocking function until a timeout is detected. Unit is seconds.
              CanTimeoutDuration: value=1.0E-6, type=FLOAT, min-value=1e-06, max-value=65.535, uuid=3c2f7522-92ae-4289-8782-d2a9e716e08f  # Specifies the maximum time for blocking function until a timeout is detected. Unit is seconds.
            CanIcomGeneral (): uuid=5541ccbf-d331-4c2b-8a7c-7132d1d9e1c5  # This container contains the general configuration parameters of the ICOM Configuration.
              parameter CanIcomLevel: value=CAN_ICOM_LEVEL_ONE, type=ENUM, uuid=b90a975e-f046-4393-8c5e-9cfa65371212  # Defines the level of Pretended Networking.
              parameter CanIcomVariant: value=CAN_ICOM_VARIANT_NONE, type=ENUM, uuid=b8198c6f-13a1-45e1-83e7-89f02082951f  # Defines the variant, which is supported by this CanController
            CanMainFunctionRWPeriods (): uuid=f3f8c76c-21c4-4001-9707-f4e9a6e3ae94  # This container contains the parameter for configuring the period for cyclic call to Can_MainFunction_Read or Can_MainFunction_Write depending on the referring item.
              parameter CanMainFunctionPeriod: value=0.001, type=FLOAT, min-value=0.001, max-value=65.535, uuid=636d9af3-044a-411a-9bde-7f48a167e863  # This parameter describes the period for cyclic call to Can_MainFunction_Read or Can_MainFunction_Write depending on the referring item. Unit is seconds. Different poll-cycles will be configurable if more than one CanMainFunctionPeriod is configured. In this case multiple Can_MainFunction_Read() or Can_MainFunction_Write() will be provided by the CAN Driver module.
          CanIcomGeneral: uuid=e6808148-58a0-4bef-916a-9e6488136f6b  # This container contains the general configuration parameters of the ICOM Configuration.
            parameter CanIcomLevel: value=CAN_ICOM_LEVEL_ONE, type=ENUM, uuid=50789eaf-69bd-455c-ae34-3a8115bca929  # Defines the level of Pretended Networking.
            parameter CanIcomVariant: value=CAN_ICOM_VARIANT_NONE, type=ENUM, uuid=b9b757bc-96e9-468c-a4fd-3434c9d279fb  # Defines the variant, which is supported by this CanController
          CanMainFunctionRWPeriods: uuid=1db70ced-f8dc-4409-8940-59b19db92686  # This container contains the parameter for configuring the period for cyclic call to Can_MainFunction_Read or Can_MainFunction_Write depending on the referring item.
            parameter CanMainFunctionPeriod: value=0.001, type=FLOAT, min-value=0.001, max-value=65.535, uuid=bf06cda4-ab18-4a07-acac-d68c95ba11ff  # This parameter describes the period for cyclic call to Can_MainFunction_Read or Can_MainFunction_Write depending on the referring item. Unit is seconds. Different poll-cycles will be configurable if more than one CanMainFunctionPeriod is configured. In this case multiple Can_MainFunction_Read() or Can_MainFunction_Write() will be provided by the CAN Driver module.
          CommonPublishedInformation: uuid=80003297-9ff6-4706-bc55-658029c19238  # <html> Common container, aggregated by all modules. It contains published information about vendor and versions. </html>
            8 x parameter, all with type=INTEGER:
              ArReleaseMajorVersion: value=4, min-value=4, max-value=4, uuid=c8fc70c2-e055-4a9d-86e1-c8ed428f9540  # <html> Major version number of AUTOSAR specification on which the appropriate implementation is based on. <p/> </html>
              ArReleaseMinorVersion: value=4, min-value=0, max-value=255, uuid=f9c54e0d-ea09-4b4e-ab11-3a4987648013  # <html> Minor version number of AUTOSAR specification on which the appropriate implementation is based on. <p/> </html>
              ArReleaseRevisionVersion: value=0, min-value=0, max-value=255, uuid=9ed553f5-4d1b-4c75-afab-0a639bfec2a2  # <html> Revision version number of AUTOSAR specification on which the appropriate implementation is based on. <p/> </html>
              ModuleId: value=80, min-value=80, max-value=80, uuid=2e56b86a-6e38-454a-8ff1-7587deb9373f  # <html> Module ID of this module from Module List. Note: Implementation Specific Parameter </html>
              SwMajorVersion: value=1, min-value=0, max-value=255, uuid=51981ab0-820b-4fa5-b5ce-17624689c43d  # <html> Major version number of the vendor specific implementation of the module. The numbering is vendor specific. Note: Implementation Specific Parameter </html>
              SwMinorVersion: value=0, min-value=0, max-value=255, uuid=d8266730-04b0-4e3d-8a60-6dbe551347fd  # <html> Minor version number of the vendor specific implementation of the module. The numbering is vendor specific. Note: Implementation Specific Parameter </html>
              SwPatchVersion: value=0, min-value=0, max-value=255, uuid=49a7738f-bd7d-40a8-a10f-5ea490fb5611  # <html> Patch level version number of the vendor specific implementation of the module. The numbering is vendor specific. Note: Implementation Specific Parameter </html>
              VendorId: value=175, min-value=175, max-value=175, uuid=207cc26b-8c12-4f68-9dfb-00336d430ec9  # <html> Vendor ID of the dedicated implementation of this module according to the AUTOSAR vendor list. Note: Implementation Specific Parameter </html>
