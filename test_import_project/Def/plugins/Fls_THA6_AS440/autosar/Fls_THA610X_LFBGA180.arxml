AUTOSAR XML (schema 00046)
package /THA6_AS440_FuSa
  ecuc definition collection Fls_EcuParameterDefinition: module=Fls
  module definition Fls [0..*]: post-build-variant-support=true, refined-module-def=Fls, variants post-build  # Configuration of the Fls (internal or external flash driver) module.
    container FlsGeneral  # Container for general parameters of the flash driver. These parameters are always pre-compile.
      integer FlsDriverIndex: 0..254, scope=ECU, set at pre-compile, symbolic-name-value=true, default-value=0  # Index of the driver, used by FEE.
      boolean FlsAcLoadOnJobStart: set at pre-compile, default-value=false  # The flash driver shall load the flash access code to RAM whenever an erase or write job is started and unload (overwrite) it after that job has been finished or canceled. Note: This parameter is NOT supported.
      boolean FlsBlankCheckApi: set at pre-compile, default-value=false  # Compile switch to enable/disable the Fls_BlankCheck function.
      boolean FlsCancelApi: set at pre-compile, default-value=false  # Compile switch to enable and disable the Fls_Cancel function.
      boolean FlsCompareApi: set at pre-compile, default-value=false  # Compile switch to enable and disable the Fls_Compare function.
      boolean FlsGetJobResultApi: set at pre-compile, default-value=false  # Compile switch to enable and disable the Fls_GetJobResult function.
      boolean FlsGetStatusApi: set at pre-compile, default-value=false  # Compile switch to enable and disable the Fls_GetStatus function.
      boolean FlsSetModeApi: set at pre-compile, default-value=false  # Compile switch to enable and disable the Fls_SetMode function.
      boolean FlsUseInterrupts: set at pre-compile, default-value=false  # true: Job processing triggered by hardware interrupt. false: Job processing triggered by Fls_Mainfunction. Note: Only erase and write operation could triggered by interrupt. Read and compare operation always triggered by Fls_Mainfunction.
      integer FlsBaseAddress: 2483027968..2483027968, set at pre-compile, default-value=2483027968  # The flash memory start address (see also SWS_Fls_00208 and SWS_Fls_00209). This is address of DFlash.
      integer FlsTotalSize: 262144..262144, set at pre-compile, default-value=262144  # The total amount of flash memory in bytes (see also SWS_Fls_00208 and SWS_Fls_00209). This is size of DFlash.
      boolean FlsDevErrorDetect: set at pre-compile, default-value=false  # Switches the Default Error Tracer (Det) detection and notification ON or OFF.
      boolean FlsDflashECCTriggerBusErrorMaskEnable: origin=ChipowerTech, set at pre-compile, default-value=false  # Pre-processor switch to enable / disable the trigger of bus error when ECC error occurs. ON: Mask bus error when reading DFlash with ECC error. OFF: Unmask bus error when reading DFlash with ECC error.
      boolean FlsSafetyErrorDetect: origin=ChipowerTech, set at pre-compile, default-value=true  # Switches the Safety Error detection ON or OFF.
      boolean FlsVersionInfoApi: set at pre-compile, default-value=false  # Pre-processor switch to enable / disable the API to read out the modules version information.
      boolean FlsWriteVerificationEnabled: set at pre-compile, default-value=false  # Compile switch to enable write verification. true: written data is compared directly after write. false: written date is not compared directly after write.
      boolean FlsEraseVerificationEnabled: set at pre-compile, default-value=false  # Compile switch to enable erase verification. true: memory region is checked to be erased. false: memory region is not checked to be erased.
      boolean FlsTimeoutSupervisionEnabled: set at pre-compile, default-value=false  # Compile switch to enable timeout supervision. true: timeout supervision for read/erase/write/compare jobs enabled. false: timeout supervision for read/erase/write/compare jobs disabled.
      reference FlsEcucPartitionRef [0..1]: scope=ECU, multiplicity set at pre-compile, post-build-variant-multiplicity=true, post-build-variant-value=true, set at pre-compile, destination=EcucPartition  # Maps the Flash driver to zero or one ECUC partition to make the driver API available in this partition. Tags: atp.Status=draft.
    container FlsConfigSet  # Container for runtime configuration parameters of the flash driver.
      integer FlsAcErase: 0..4294967295, post-build-variant-value=true, set at post-build, default-value=0  # Address offset in RAM to which the erase flash access code shall be loaded.
      integer FlsAcWrite: 0..4294967295, post-build-variant-value=true, set at post-build, default-value=0  # Address offset in RAM to which the write flash access code shall be loaded.
      float FlsCallCycle: 0.0..1.0, post-build-variant-value=true, set at post-build, default-value=0.01  # Cycle time of calls of the flash driver's main function (in seconds).
      enumeration FlsDefaultMode: {MEMIF_MODE_FAST, MEMIF_MODE_SLOW}, post-build-variant-value=true, set at post-build, default-value=MEMIF_MODE_FAST  # This parameter is the default FLS device mode after initialization.
      function name FlsJobEndNotification [0..1]: multiplicity set at post-build, post-build-variant-multiplicity=true, post-build-variant-value=true, set at post-build, default-value=Fee_JobEndNotification  # Mapped to the job end notification routine provided by some upper layer module, typically the Fee module. When using Fee, the end notification function is fixed to Fee_JobEndNotification. Set to NULL_PTR indicates that FLS does not have end notification function.
      function name FlsJobErrorNotification [0..1]: multiplicity set at post-build, post-build-variant-multiplicity=true, post-build-variant-value=true, set at post-build, default-value=Fee_JobErrorNotification  # Mapped to the job error notification routine provided by some upper layer module, typically the Fee module. When using Fee, the error notification function is fixed to Fee_JobEndNotification. Set to NULL_PTR indicates that FLS does not have error notification function.
      integer FlsMaxReadFastMode: 0..1024, post-build-variant-value=true, set at post-build, default-value=256  # The maximum number of bytes to read or compare in one cycle of the flash driver's job processing function in fast mode. Note: The set value must be aligned with the page.
      integer FlsMaxReadNormalMode: 0..1024, post-build-variant-value=true, set at post-build, default-value=128  # The maximum number of bytes to read or compare in one cycle of the flash driver's job processing function in normal mode. Note: The set value must be aligned with the page.
      integer FlsMaxWriteFastMode: 16..1024, post-build-variant-value=true, set at post-build, default-value=128  # The maximum number of bytes to write in one cycle of the flash driver's job processing function in fast mode. Note: The set value must be aligned with the page.
      integer FlsMaxWriteNormalMode: 16..1024, post-build-variant-value=true, set at post-build, default-value=128  # The maximum number of bytes to write in one cycle of the flash driver's job processing function in normal mode. Note: The set value must be aligned with the page.
      integer FlsProtection: 0..4294967295, post-build-variant-value=true, set at post-build, default-value=0  # Erase/write protection settings. Only relevant if supported by hardware.
      container FlsExternalDriver [0..1]: multiplicity set at post-build  # This container is present for external Flash drivers only. Internal Flash drivers do not use the parameter listed in this container, hence its multiplicity is 0 for internal drivers. Note: Not support in current software implement.
        reference FlsSpiReference [1..*]: multiplicity set at pre-compile, set at pre-compile, requires-symbolic-name-value=true, destination=SpiSequence  # Reference to SPI sequence (required for external Flash drivers).
      container FlsSectorList: requires-index=true  # List of flashable sectors and pages.
        container FlsSector [1..*]: multiplicity set at pre-compile, requires-index=true  # Configuration description of a flashable sector
          integer FlsNumberOfSectors: 0..65535, set at pre-compile, default-value=1  # Number of continuous sectors with identical values for FlsSectorSize and FlsPageSize. The parameter FlsSectorStartAddress denotes the start address of the first sector. NOTE For THA6 series, the maximum number of 'FlsNumberOfSectors' is shown as follows: DFLASH PFLASH THA6206 64 384 THA6412 64 768 THA610X 256 512
          integer FlsPageSize: 0..65535, set at pre-compile, default-value=0  # Size of one page of this sector. NOTE For THA6 series, 'FlsPageSize' is shown as follows: DFLASH PFLASH THA6206 16 32 THA6412 16 32 THA610X 16 64
          integer FlsSectorSize: 0..65535, set at pre-compile, default-value=8192  # Size of this sector. NOTE For THA6 series, 'FlsSectorSize' is shown as follows: DFLASH PFLASH THA6206 8192 16384 THA6412 8192 16384 THA610X 1024 8192
          integer FlsSectorStartaddress: 0..4294967295, set at pre-compile, default-value=0  # Start address of this sector. NOTE For THA6 series, the range of 'FlsSectorStartaddress' is shown as follows: DFLASH PFLASH THA6206 0x0000_0000 ~ 0x0008_0000 0x1000_0000 ~ 0x1060_0000 THA6412 0x0000_0000 ~ 0x0008_0000 0x1000_0000 ~ 0x10c0_0000 THA610X 0x0000_0000 ~ 0x0004_0000 0x1000_0000 ~ 0x0040_0000
    container FlsPublishedInformation  # Additional published parameters not covered by CommonPublishedInformation container.
      integer FlsAcLocationErase: 0..4294967295, set at published-information, default-value=0  # Position in RAM, to which the erase flash access code has to be loaded. This parameter is unused and instead FlsAcErase is used
      integer FlsAcLocationWrite: 0..4294967295, set at published-information, default-value=0  # Position in RAM, to which the write flash access code has to be loaded. This parameter is unused and instead FlsAcWrite is used
      integer FlsAcSizeErase: 0..4294967295, set at published-information, default-value=0  # Number of bytes in RAM needed for the erase flash access code.
      integer FlsAcSizeWrite: 0..4294967295, set at published-information, default-value=0  # Number of bytes in RAM needed for the write flash access code.
      float FlsEraseTime: 0.0..4.29496E8, set at published-information, default-value=16000.0  # Maximum time to erase one complete flash sector(in Microseconds).
      integer FlsErasedValue: 255..255, set at published-information, default-value=255  # The contents of an erased flash memory cell.
      string FlsExpectedHwId: set at published-information, default-value=0  # Unique identifier of the hardware device that is expected by this driver (the device for which this driver has been implemented).Only relevant for external flash drivers.
      integer FlsSpecifiedEraseCycles: 0..4294967295, set at published-information, default-value=100000  # Number of erase cycles specified for the flash device (usually given in the device data sheet).
      float FlsWriteTime: 0.0..4.29496E7, set at published-information, default-value=1500.0  # Maximum time to program one complete flash page in Microseconds.
    container CommonPublishedInformation  # Common container, aggregated by all modules. It contains published information about vendor and versions.
      integer ArReleaseMajorVersion: 0..255, origin=ChipowerTech, set at published-information, default-value=4  # Major version number of AUTOSAR specification on which the appropriate implementation is based on.
      integer ArReleaseMinorVersion: 0..255, origin=ChipowerTech, set at published-information, default-value=4  # Minor version number of AUTOSAR specification on which the appropriate implementation is based on.
      integer ArReleaseRevisionVersion: 0..255, origin=ChipowerTech, set at published-information, default-value=0  # Patch level version number of AUTOSAR specification on which the appropriate implementation is based on.
      integer ModuleId: 0..255, origin=ChipowerTech, set at published-information, default-value=92  # Module ID of this module from Module List
      integer SwMajorVersion: 0..255, origin=ChipowerTech, set at published-information, default-value=1  # Major version number of the vendor specific implementation of the module. The numbering is vendor specific.
      integer SwMinorVersion: 0..255, origin=ChipowerTech, set at published-information, default-value=0  # Minor version number of the vendor specific implementation of the module. The numbering is vendor specific.
      integer SwPatchVersion: 0..255, origin=ChipowerTech, set at published-information, default-value=0  # Patch level version number of the vendor specific implementation of the module. The numbering is vendor specific.
      integer VendorId: 0..255, origin=ChipowerTech, set at published-information, default-value=175  # Vendor ID of the dedicated implementation of this module according to the AUTOSAR vendor list
