AUTOSAR XML (schema 00046)
package /THA6_AS440_FuSa
  ecuc definition collection Intc_EcuParameterDefinition: module=Intc
  module definition Intc [0..*]: post-build-variant-support=true, variants post-build  # Configuration of the Intc (Interrupt controller) module.
    container IntcGeneral  # Module wide configuration parameters of the PORT driver.
      boolean IntcDevErrorDetect: origin=ChipowerTech, set at pre-compile, default-value=false  # Switches the Default Error Tracer (Det) detection and notification ON or OFF. true: enabled (ON). false: disabled (OFF).
      boolean IntcVersionInfoApi: origin=ChipowerTech, set at pre-compile, default-value=false  # Pre-processor switch to enable / disable the API to read out the modules version information. true: Version info API enabled. false: Version info API disabled.
      integer IntcFIQPriorityBinaryPoint: 2..7, origin=ChipowerTech, set at pre-compile, default-value=2  # Defines the point of FIQ at which the priority value fields split into two parts, the group priority field and the subpriority field. The group priority field determines FIQ interrupt preemption. - 2: [group priority range is 0~31], [subpriority is None] - 3: [group priority range is 0~15], [subpriority range is 0~1] - 4: [group priority range is 0~7], [subpriority range is 0~3] - 5: [group priority range is 0~3], [subpriority range is 0~7] - 6: [group priority range is 0~1], [subpriority range is 0~15] - 7: [group priority range is None], [subpriority range is 0~31]: In this case, Interrupt preemption is not supported Note Detail refer to GIC register 'ICC_BPR0' in Arm Cortex-R52 Processor Technical Reference Manual
      integer IntcIRQPriorityBinaryPoint: 3..7, origin=ChipowerTech, set at pre-compile, default-value=3  # Defines the point of IRQ at which the priority value fields split into two parts, the group priority field and the subpriority field. The group priority field determines IRQ interrupt preemption. - 3: [group priority range is 0~31], [subpriority is None] - 4: [group priority range is 0~15], [subpriority range is 0~1] - 5: [group priority range is 0~7], [subpriority range is 0~3] - 6: [group priority range is 0~3], [subpriority range is 0~7] - 7: [group priority range is 0~1], [subpriority range is 0~15] Note Detail refer to GIC register 'ICC_BPR1' in Arm Cortex-R52 Processor Technical Reference Manual
    container IntcConfigSet  # This container contains the configuration parameters and sub containers of the Intc module.
      container IntcContainer [32..32]: requires-index=true  # Container collecting the interrupt srouces. <h1>Note</h1> Interrupt details refer to chip UM "TMC_THA6206_UserManua" -> Appendix A Interrupt Vector Table.
        enumeration IntcIntSrcClass: {GIC_SGI, GIC_PPI, CPUWDT, SAFEWDT, PMC, CLUSTER, RCC, PWRC, INTC_SOFTINT, SAC, OVC, ETH, DMA, NVM, HSM, BASETIM, CAN, SARADC, FC, SARADC_FC, DSADC, TSENSOR, PSI5, ECRC, ESPI, MSC, SENT, I2C, QSPI, ASI, EXTI, GTM}, origin=ChipowerTech, set at pre-compile, default-value=GIC_SGI  # Interrupt source classification. Note Prohibit manual modification of this value.
        container IntcIntSrcSubClassContainer [1..1023]: multiplicity set at pre-compile, requires-index=true  # Container collecting the interrupt srouces sub-classification.
          integer IntcIntSrcSubClassId: 0..1023, origin=ChipowerTech, set at pre-compile, default-value=0  # Interrupt source sub-classification Id. Note Prohibit manual modification of this value.
          string IntcIntSrcSubClassName: origin=ChipowerTech, set at pre-compile, default-value=NoName  # Interrupt source sub-classification name. Note Prohibit manual modification of this value.
          container IntcIntSrcContainer [1..1023]: multiplicity set at pre-compile, requires-index=true  # Container collecting the specified interrupt srouces.
            integer IntcIntSrcLogicalIndex: 0..1023, origin=ChipowerTech, set at pre-compile, default-value=0  # The logical index of this list marks the order of the items within the list. Note Prohibit manual modification of this value.
            string IntcIntSrcName: origin=ChipowerTech, set at pre-compile, default-value=NoName  # Interrupt source name. Note Prohibit manual modification of this value.
            integer IntcIntSrcId: 0..1023, origin=ChipowerTech, set at pre-compile, default-value=0  # Unique interrupt source identification(INTID). Note Prohibit manual modification of this value.
            boolean IntcIntSrcEnable: origin=ChipowerTech, set at pre-compile, default-value=false  # To enable/disable this interrupt source in project. true: Enable this interrupt source. false: Disable this interrupt source.
            boolean IntcIntSrcEnableInstalling: origin=ChipowerTech, post-build-variant-value=true, set at post-build, default-value=false  # This interrupt source will be enabled automatically upon invoking API Intc_InstallInterrupt(). true: Enable this interrupt source when installing. false: Disable this interrupt source when installing.
            enumeration IntcIntSrcCoreMapping: {CORE0, CORE1, CORE2, CORE3}, origin=ChipowerTech, set at pre-compile, default-value=CORE0  # Select the core which this interrupt source mapped to. Note For SGIs(Software generated interrupts) and PPIs(private peripheral interrupts), this parameter is constant and non-configurable. For SPIs(shared peripheral interrupts), this parameter is configurable.
            integer IntcIntSrcGroupPriority [0..1]: 0..31, multiplicity set at post-build, origin=ChipowerTech, post-build-variant-multiplicity=true, post-build-variant-value=true, set at post-build, default-value=0  # Set the interrupt source group priority. For FIQ, when IntcGeneral/IntcFIQPriorityBinaryPoint is: - 2: [group priority range is 0~31] - 3: [group priority range is 0~15] - 4: [group priority range is 0~7] - 5: [group priority range is 0~3] - 6: [group priority range is 0~1] - 7: [group priority is None]: In this case, Interrupt preemption is not supported For IRQ, when IntcGeneral/IntcIRQPriorityBinaryPoint is: - 3: [group priority range is 0~31] - 4: [group priority range is 0~15] - 5: [group priority range is 0~7] - 6: [group priority range is 0~3] - 7: [group priority range is 0~1] Note 1. Group priority is invalid when IntcGeneral/IntcFIQPriorityBinaryPoint = 7 and IntcIntSrcAssignedTo = 'FIQ'. 2. 0 is highest priority. 3. When both the group priority and subpriority are set to the lowest, indicates that is IDLE interrupt which will not be triggered.
            integer IntcIntSrcSubPriority [0..1]: 0..31, multiplicity set at post-build, origin=ChipowerTech, post-build-variant-multiplicity=true, post-build-variant-value=true, set at post-build, default-value=0  # Set the interrupt source subpriority. For FIQ, when IntcGeneral/IntcFIQPriorityBinaryPoint is: - 2: [subpriority is None] - 3: [subpriority range is 0~1] - 4: [subpriority range is 0~3] - 5: [subpriority range is 0~7] - 6: [subpriority range is 0~15] - 7: [subpriority range is 0~31]: In this case, Interrupt preemption is not supported For IRQ, when IntcGeneral/IntcIRQPriorityBinaryPoint is: - 3: [subpriority is None] - 4: [subpriority range is 0~1] - 5: [subpriority range is 0~3] - 6: [subpriority range is 0~7] - 7: [subpriority range is 0~15] Note 1. Subpriority is invalid when (IntcGeneral/IntcFIQPriorityBinaryPoint = 2 and IntcIntSrcAssignedTo = 'FIQ') or (IntcGeneral/IntcFIQPriorityBinaryPoint = 3 and IntcIntSrcAssignedTo = 'IRQ'). 2. 0 is highest priority. 3. When both the group priority and subpriority are set to the lowest, indicates that is IDLE interrupt which will not be triggered.
            enumeration IntcIntSrcTriggerMethod: {EDGE, LEVEL}, origin=ChipowerTech, post-build-variant-value=true, set at post-build, default-value=EDGE  # Select the interrupt source trigger method. LEVEL: level-sensitive EDGE: edge-triggered If this parameter is grayed out indicates that is non-configurable. Note Detail refer to GIC registers 'GICD_ICFGR' and 'GICR_ICFGR' in Arm Cortex-R52 Processor Technical Reference Manual
            enumeration IntcIntSrcAssignedTo: {FIQ, IRQ}, origin=ChipowerTech, post-build-variant-value=true, set at post-build, default-value=IRQ  # Select whether to assign the interrupt to FIQ(Fast Interrupt Request) or IRQ(Interrupt Request). Note FIQ: Assigned this interrupt source to FIQ(Group0 in GIC). IRQ: Assigned this interrupt source to IRQ(Group1 in GIC).
            enumeration IntcIntSrcCategory: {CAT1, CAT2}, origin=ChipowerTech, set at pre-compile, default-value=CAT1  # Select the interrupt category setting. Depending upon the category the interrupt Frame is different. If CAT2 is selected, the interrupt needs to be installed in the interrupt vector table when calling the API Intc_InstallInterrupt, the interrupt needs to be installed by the user or integrator. Note CAT1: Category 1. CAT2: Category 2.
            function name IntcIntSrcNotification [0..1]: multiplicity set at pre-compile, origin=ChipowerTech, set at pre-compile, default-value=NULL_PTR  # This parameter defines the existence and the name of a notification function that interrupt source triggered. Note If you have used modules developed by MCAL, it is best not to setting this parameter, because interrupt mechanisms are implemented internally within MCAL modules.
    container CommonPublishedInformation  # Common container, aggregated by all modules. It contains published information about vendor and versions.
      integer ArReleaseMajorVersion: 0..255, origin=ChipowerTech, set at published-information, default-value=4  # Major version number of AUTOSAR specification on which the appropriate implementation is based on.
      integer ArReleaseMinorVersion: 0..255, origin=ChipowerTech, set at published-information, default-value=4  # Minor version number of AUTOSAR specification on which the appropriate implementation is based on.
      integer ArReleaseRevisionVersion: 0..255, origin=ChipowerTech, set at published-information, default-value=0  # Revision version number of AUTOSAR specification on which the appropriate implementation is based on.
      integer ModuleId: 0..255, origin=ChipowerTech, set at published-information, default-value=255  # Module ID of this module from Module List.
      integer SwMajorVersion: 0..255, origin=ChipowerTech, set at published-information, default-value=1  # Major version number of the vendor specific implementation of the module. The numbering is vendor specific.
      integer SwMinorVersion: 0..255, origin=ChipowerTech, set at published-information, default-value=0  # Minor version number of the vendor specific implementation of the module. The numbering is vendor specific.
      integer SwPatchVersion: 0..255, origin=ChipowerTech, set at published-information, default-value=0  # Patch level version number of the vendor specific implementation of the module. The numbering is vendor specific.
      integer VendorId: 175..175, origin=ChipowerTech, set at published-information, default-value=175  # Vendor ID of the dedicated implementation of this module according to the AUTOSAR vendor list.
