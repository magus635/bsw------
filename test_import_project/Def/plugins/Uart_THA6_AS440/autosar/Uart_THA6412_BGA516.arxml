AUTOSAR XML (schema 00046)
package /THA6_AS440_FuSa
  ecuc definition collection Uart_EcuParameterDefinition: module=Uart
  module definition Uart [1..*]: post-build-variant-support=true, variants post-build  # Configuration of the Uart (UART driver) module.
    container UartClockSet  # This container contains All UART hardware unit baudrate clock setting.
      reference UartSysClockRef: origin=ChipowerTech, post-build-variant-value=true, set at post-build, destination=McuClockReferencePoint  # Reference to the UART clock source configuration, which is set in the MCU driver configuration. Note This is used to replace 'UartClockRef'
    container UartGeneral  # This container contains the parameters related to each Uart Driver Unit.
      boolean UartDevErrorDetect: origin=ChipowerTech, set at pre-compile, default-value=false  # Switches the Default Error Tracer (Det) detection and notification ON or OFF. true: enabled (ON). false: disabled (OFF).
      boolean UartVersionInfoApi: origin=ChipowerTech, set at pre-compile, default-value=false  # Switches the Uart_GetVersionInfo function ON or OFF. true: enabled (ON). false: disabled (OFF).
      integer UartTimeoutDuration: 500..65535, origin=ChipowerTech, set at pre-compile, default-value=500  # Specifies the maximum number of loops for blocking function until a timeout is raised in short term wait loops
    container UartGlobalConfig  # This container contains the global configuration parameter of the Uart driver.
      container UartChannel [1..*]: multiplicity set at pre-compile, requires-index=true  # This container contains the configuration (parameters) of the UART Controller(s).
        integer UartChannelId: 0..255, origin=ChipowerTech, set at pre-compile, symbolic-name-value=true, default-value=0  # Identifies the UART channel. Replaces UART_CHANNEL_INDEX_NAME from the UART SWS.
        enumeration UartHwUnit: {ASI0, ASI1, ASI2, ASI3, ASI4, ASI5, ASI6, ASI7, ASI8, ASI9, ASI10, ASI11, ASI12, ASI13, ASI14, ASI15, ASI16, ASI17, ASI18, ASI19, ASI20, ASI21, ASI22, ASI23}, origin=ChipowerTech, set at pre-compile, default-value=ASI0  # This parameter selects the hardware unit used to tranfer uart data.
        integer UartChannelBaudRate: 1000..375000, origin=ChipowerTech, post-build-variant-value=true, set at post-build, default-value=115200  # Specifies the baud rate of the uart channel
        enumeration UartDataBitWidth: {UART_DATATBITS_7, UART_DATATBITS_8, UART_DATATBITS_15, UART_DATATBITS_16}, origin=ChipowerTech, post-build-variant-value=true, set at post-build, default-value=UART_DATATBITS_8  # configuration uart data bits length.
        enumeration UartStopBitWidth: {UART_STOPBITS_1, UART_STOPBITS_2, UART_STOPBITS_3}, origin=ChipowerTech, post-build-variant-value=true, set at post-build, default-value=UART_STOPBITS_1  # configuration Uart stop bits length.
        enumeration UartDataParityMode: {UART_PARITY_EVEN, UART_PARITY_ODD, UART_PARITY_LOGIC0, UART_PARITY_LOGIC1, UART_PARITY_NONE}, origin=ChipowerTech, post-build-variant-value=true, set at post-build, default-value=UART_PARITY_NONE  # configuration Uart data parity mode.
        boolean UartRxInterruptEnable: origin=ChipowerTech, set at pre-compile, default-value=false  # Switches the receiving Interrupt function ON or OFF.
        boolean UartTxInterruptEnable: origin=ChipowerTech, set at pre-compile, default-value=false  # Switches the transmit Interrupt function ON or OFF.
        boolean UartErrorInterruptEnable: origin=ChipowerTech, set at pre-compile, default-value=false  # Switches the error Interrupt function ON or OFF.
        boolean UartBufferLockModeEnable: origin=ChipowerTech, post-build-variant-value=true, set at post-build, default-value=false  # Switches the RX buffer Lock mode ON or OFF, The receiver buffer is locked against overflow. Once the buffer is full, how the next message is handled. True: The next incoming message will be discarded. False: The next incoming message overwrites the previous one.
        function name UartRxNotification [0..1]: multiplicity set at post-build, origin=ChipowerTech, post-build-variant-multiplicity=true, post-build-variant-value=true, set at post-build, default-value=NULL_PTR  # The parameter is a reference to receiving notification function.
        function name UartTxNotification [0..1]: multiplicity set at post-build, origin=ChipowerTech, post-build-variant-multiplicity=true, post-build-variant-value=true, set at post-build, default-value=NULL_PTR  # The parameter is a reference to transmit notification function.
        function name UartErrorNotification [0..1]: multiplicity set at post-build, origin=ChipowerTech, post-build-variant-multiplicity=true, post-build-variant-value=true, set at post-build, default-value=NULL_PTR  # The parameter is a reference to error notification function.
    container CommonPublishedInformation  # Common container, aggregated by all modules. It contains published information about vendor and versions.
      integer ArReleaseMajorVersion: 0..255, origin=ChipowerTech, set at published-information, default-value=4  # Major version number of AUTOSAR specification on which the appropriate implementation is based on.
      integer ArReleaseMinorVersion: 0..255, origin=ChipowerTech, set at published-information, default-value=4  # Minor version number of AUTOSAR specification on which the appropriate implementation is based on.
      integer ArReleaseRevisionVersion: 0..255, origin=ChipowerTech, set at published-information, default-value=0  # Revision version number of AUTOSAR specification on which the appropriate implementation is based on.
      integer SwMajorVersion: 0..255, origin=ChipowerTech, set at published-information, default-value=1  # Major version number of the vendor specific implementation of the module. The numbering is vendor specific.
      integer SwMinorVersion: 0..255, origin=ChipowerTech, set at published-information, default-value=0  # Minor version number of the vendor specific implementation of the module. The numbering is vendor specific.
      integer SwPatchVersion: 0..255, origin=ChipowerTech, set at published-information, default-value=0  # Patch level version number of the vendor specific implementation of the module. The numbering is vendor specific.
      integer VendorId: 0..255, origin=ChipowerTech, set at published-information, default-value=175  # Vendor ID of the dedicated implementation of this module according to the AUTOSAR vendor list.
      integer ModuleId: 0..255, origin=ChipowerTech, set at published-information, default-value=255  # Module ID of this module from Module List.
