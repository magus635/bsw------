AUTOSAR XML (schema 4-2-1)
package /EB/PostBuildLoadable
  predefined variant Ecu1: post-build-variant-criterion-value-set=PostBuildLoadable/PostBuildCriterionValueSet_0
  predefined variant Ecu2: post-build-variant-criterion-value-set=PostBuildLoadable/PostBuildCriterionValueSet_1
  post build variant criterion value set PostBuildCriterionValueSet_0: post-build-variant-criterion-value{variant-criterion=PostBuildLoadableCriterion, value=0}
  post build variant criterion value set PostBuildCriterionValueSet_1: post-build-variant-criterion-value{variant-criterion=PostBuildLoadableCriterion, value=1}
  post build variant criterion PostBuildLoadableCriterion: compu {0=, 1=}
package /EB/PostBuildSelectable
  predefined variant Luxury: post-build-variant-criterion-value-set=PostBuildSelectable/PostBuildCriterionValueSet_0
  predefined variant Sportive: post-build-variant-criterion-value-set=PostBuildSelectable/PostBuildCriterionValueSet_1
  post build variant criterion value set PostBuildCriterionValueSet_0: post-build-variant-criterion-value{variant-criterion=PostBuildSelectableCriterion, value=0}
  post build variant criterion value set PostBuildCriterionValueSet_1: post-build-variant-criterion-value{variant-criterion=PostBuildSelectableCriterion, value=1}
  post build variant criterion PostBuildSelectableCriterion: compu {0=, 1=}
