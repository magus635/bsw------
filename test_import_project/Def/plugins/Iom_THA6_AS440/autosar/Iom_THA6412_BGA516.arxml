AUTOSAR XML (schema 00046)
package /THA6_AS440_FuSa
  ecuc definition collection Iom_EcuParameterDefinition: module=Iom
  module definition Iom [0..*]: post-build-variant-support=true, variants post-build  # Configuration of the Iom .
    container IomGeneralConfiguration  # This container contains configuration switches for PPU register.
      boolean IomVersionInfoApi: origin=ChipowerTech, set at pre-compile, default-value=false  # Pre-processor switch to enable / disable the API to read out the modules version information.
      boolean IomPpuPrecalerApi: origin=ChipowerTech, set at pre-compile, default-value=true  # Switches the Ppu prescaler Api(Iom_SetPpuPrecalerThreshold, Iom_GetPpuPrecalerThreshold) ON or OFF.
      boolean IomPpuFilterApi: origin=ChipowerTech, set at pre-compile, default-value=true  # Switches the Ppu filter Api(Iom_SetPpuFilterTimeThreshold, Iom_GetPpuFilterTimeThreshold) ON or OFF.
      boolean IomGetPpuGlitchApi: origin=ChipowerTech, set at pre-compile, default-value=true  # Switches the Iom_GetPpuGlitch Api ON or OFF.
      boolean IomDevErrorDetect: origin=ChipowerTech, set at pre-compile, default-value=true  # Switches the Default Error Tracer (Det) detection and notification ON or OFF.
      boolean IomSafetyErrorDetect: origin=ChipowerTech, set at pre-compile, default-value=true  # Switches the Safety Error detection ON or OFF.
      boolean IomGtmExor: origin=ChipowerTech, set at pre-compile, default-value=false  # Switches the GTM input Exor ON or OFF.
    container IomModuleConfiguration  # This container contains the configuration (parameters) of the IOM driver
      container IomPPUConfiguration [1..16]: multiplicity set at pre-compile, requires-index=true  # This container contains the configuration for the Filter and Prescaler Channels.
        integer IomPPUUnitNo: 0..15, origin=ChipowerTech, post-build-variant-value=true, set at post-build, symbolic-name-value=true, default-value=0  # PPU register unit or PPU number
        integer IomPPUFilterTime: 0..65535, origin=ChipowerTech, post-build-variant-value=true, set at post-build, default-value=0  # Filter time threshold.
        integer IomPPUPrescalerCompareVal: 0..65535, origin=ChipowerTech, post-build-variant-value=true, set at post-build, default-value=0  # 16 bit prescaler compare value used to compare with 16 bit timer value
        enumeration IomPPUFilterMode: {BOTHEDGES_DD, BOTHEDGES_ID, RISINGEDGE_ID, FALLINGEDGE_ID, RISING_DD_FALLING_ID, RISING_ID_FALLING_DD, RISINGEDGE_PRESCALER, FALLINGEDGE_PRESCALER, NO_FILTER}, origin=ChipowerTech, post-build-variant-value=true, set at post-build, default-value=BOTHEDGES_DD  # Determines operation mode selection for PPU Note: DD means Delay Debounce ID means Immediated Debounce
        enumeration IomPPUMonInputSel: {Input_IOM_MONINPUT_P33_0, CHANNEL0_IOM_MONINPUT_GTMTOUT22, CHANNEL1_IOM_MONINPUT_GTMTIO4PWM03, CHANNEL2_IOM_MONINPUT_ESPI0MRST, Input_IOM_MONINPUT_P33_1, CHANNEL0_IOM_MONINPUT_GTMTOUT23, CHANNEL1_IOM_MONINPUT_GTMTIO3PWM02, CHANNEL2_IOM_MONINPUT_ESPI1MRST, Input_IOM_MONINPUT_P33_2, CHANNEL0_IOM_MONINPUT_GTMTOUT24, CHANNEL1_IOM_MONINPUT_GTMTIO2PWM01, CHANNEL2_IOM_MONINPUT_ESPI2MRST, Input_IOM_MONINPUT_P33_3, CHANNEL0_IOM_MONINPUT_GTMTOUT25, CHANNEL1_IOM_MONINPUT_GTMTIO1PWM00, CHANNEL2_IOM_MONINPUT_ESPI3MRST, Input_IOM_MONINPUT_P33_4, CHANNEL0_IOM_MONINPUT_GTMTOUT26, CHANNEL1_IOM_MONINPUT_GTMTIO3PWM06, CHANNEL2_IOM_MONINPUT_ESPI4MRST, Input_IOM_MONINPUT_P33_5, CHANNEL0_IOM_MONINPUT_GTMTOUT27, CHANNEL1_IOM_MONINPUT_GTMTIO2PWM05, CHANNEL2_IOM_MONINPUT_CAN00TXD, Input_IOM_MONINPUT_P33_6, CHANNEL0_IOM_MONINPUT_GTMTOUT28, CHANNEL1_IOM_MONINPUT_GTMTIO1PWM04, CHANNEL2_IOM_MONINPUT_CAN01TXD, Input_IOM_MONINPUT_P33_7, CHANNEL0_IOM_MONINPUT_GTMTOUT29, CHANNEL1_IOM_MONINPUT_GTMTIO4PWM13, CHANNEL2_IOM_MONINPUT_CAN02TXD, Input_IOM_MONINPUT_P33_8, CHANNEL0_IOM_MONINPUT_GTMTOUT30, CHANNEL1_IOM_MONINPUT_GTMTIO3PWM12, CHANNEL2_IOM_MONINPUT_CAN30TXD, Input_IOM_MONINPUT_P33_9, CHANNEL0_IOM_MONINPUT_GTMTOUT31, CHANNEL1_IOM_MONINPUT_GTMTIO2PWM11, CHANNEL2_IOM_MONINPUT_GTMTOUT104, Input_IOM_MONINPUT_P33_10, CHANNEL0_IOM_MONINPUT_GTMTOUT32, CHANNEL1_IOM_MONINPUT_GTMTIO1PWM10, CHANNEL2_IOM_MONINPUT_GTMTOUT105, Input_IOM_MONINPUT_P33_11, CHANNEL0_IOM_MONINPUT_GTMTOUT33, CHANNEL1_IOM_MONINPUT_GTMTIO3PWM16, CHANNEL2_IOM_MONINPUT_GTMTOUT106, Input_IOM_MONINPUT_P33_12, CHANNEL0_IOM_MONINPUT_GTMTOUT34, CHANNEL1_IOM_MONINPUT_GTMTIO2PWM15, CHANNEL2_IOM_MONINPUT_ASI0ATX, Input_IOM_MONINPUT_P20_12, CHANNEL0_IOM_MONINPUT_GTMTOUT68, CHANNEL1_IOM_MONINPUT_GTMTIO1PWM14, CHANNEL2_IOM_MONINPUT_ASI1ATX, Input_IOM_MONINPUT_P20_13, CHANNEL0_IOM_MONINPUT_GTMTOUT69, CHANNEL1_IOM_MONINPUT_PSI5TX0, CHANNEL2_IOM_MONINPUT_ASI2ATX, Input_IOM_MONINPUT_P20_14, CHANNEL0_IOM_MONINPUT_GTMTOUT70, CHANNEL1_IOM_MONINPUT_PSI5TX2, CHANNEL2_IOM_MONINPUT_ASI3ATX}, origin=ChipowerTech, post-build-variant-value=true, set at post-build, default-value=Input_IOM_MONINPUT_P33_0  # To select monitor input signal for PPU channel.
        enumeration IomPPUReferInputSel: {Input_IOM_REFINPUT_P33_0, CHANNEL0_IOM_REFINPUT_GTMTOUT0, CHANNEL1_IOM_REFINPUT_GTMTIO4PWM03, CHANNEL2_IOM_REFINPUT_ESPI0MRST, IOM_REFINPUT_GTMEXORCOMBINER0, Input_IOM_REFINPUT_P33_1, CHANNEL0_IOM_REFINPUT_GTMTOUT1, CHANNEL1_IOM_REFINPUT_GTMTIO3PWM02, CHANNEL2_IOM_REFINPUT_ESPI1MRST, IOM_REFINPUT_GTMEXORCOMBINER1, Input_IOM_REFINPUT_P33_2, CHANNEL0_IOM_REFINPUT_GTMTOUT2, CHANNEL1_IOM_REFINPUT_GTMTIO2PWM01, CHANNEL2_IOM_REFINPUT_ESPI2MRST, IOM_REFINPUT_GTMEXORCOMBINER2, Input_IOM_REFINPUT_P33_3, CHANNEL0_IOM_REFINPUT_GTMTOUT3, CHANNEL1_IOM_REFINPUT_GTMTIO1PWM00, CHANNEL2_IOM_REFINPUT_ESPI3MRST, IOM_REFINPUT_GTMEXORCOMBINER3, Input_IOM_REFINPUT_P33_4, CHANNEL0_IOM_REFINPUT_GTMTOUT4, CHANNEL1_IOM_REFINPUT_GTMTIO3PWM06, CHANNEL2_IOM_REFINPUT_ESPI4MRST, IOM_REFINPUT_GTMEXORCOMBINER4, Input_IOM_REFINPUT_P33_5, CHANNEL0_IOM_REFINPUT_GTMTOUT5, CHANNEL1_IOM_REFINPUT_GTMTIO2PWM05, CHANNEL2_IOM_REFINPUT_CAN00TXD, IOM_REFINPUT_GTMEXORCOMBINER5, Input_IOM_REFINPUT_P33_6, CHANNEL0_IOM_REFINPUT_GTMTOUT6, CHANNEL1_IOM_REFINPUT_GTMTIO1PWM04, CHANNEL2_IOM_REFINPUT_CAN01TXD, IOM_REFINPUT_GTMEXORCOMBINER6, Input_IOM_REFINPUT_P33_7, CHANNEL0_IOM_REFINPUT_GTMTOUT7, CHANNEL1_IOM_REFINPUT_GTMTIO4PWM13, CHANNEL2_IOM_REFINPUT_CAN02TXD, IOM_REFINPUT_GTMEXORCOMBINER7, Input_IOM_REFINPUT_P33_8, CHANNEL0_IOM_REFINPUT_GTMTOUT8, CHANNEL1_IOM_REFINPUT_GTMTIO3PWM12, CHANNEL2_IOM_REFINPUT_CAN30TXD, IOM_REFINPUT_GTMEXORCOMBINER8, Input_IOM_REFINPUT_P33_9, CHANNEL0_IOM_REFINPUT_GTMTOUT9, CHANNEL1_IOM_REFINPUT_GTMTIO2PWM11, CHANNEL2_IOM_REFINPUT_GTMTOUT107, IOM_REFINPUT_GTMEXORCOMBINER9, Input_IOM_REFINPUT_P33_10, CHANNEL0_IOM_REFINPUT_GTMTOUT10, CHANNEL1_IOM_REFINPUT_GTMTIO1PWM10, CHANNEL2_IOM_REFINPUT_GTMTOUT108, IOM_REFINPUT_GTMEXORCOMBINER10, Input_IOM_REFINPUT_P33_11, CHANNEL0_IOM_REFINPUT_GTMTOUT11, CHANNEL1_IOM_REFINPUT_GTMTIO3PWM16, CHANNEL2_IOM_REFINPUT_GTMTOUT109, IOM_REFINPUT_GTMEXORCOMBINER11, Input_IOM_REFINPUT_P33_12, CHANNEL0_IOM_REFINPUT_GTMTOUT12, CHANNEL1_IOM_REFINPUT_GTMTIO2PWM15, CHANNEL2_IOM_REFINPUT_ASI0ATX, IOM_REFINPUT_GTMEXORCOMBINER12, Input_IOM_REFINPUT_P20_12, CHANNEL0_IOM_REFINPUT_GTMTOUT13, CHANNEL1_IOM_REFINPUT_GTMTIO1PWM14, CHANNEL2_IOM_REFINPUT_ASI1ATX, IOM_REFINPUT_GTMEXORCOMBINER13, Input_IOM_REFINPUT_P20_13, CHANNEL0_IOM_REFINPUT_GTMTOUT14, CHANNEL1_IOM_REFINPUT_PSI5TX0, CHANNEL2_IOM_REFINPUT_ASI2ATX, IOM_REFINPUT_GTMEXORCOMBINER14, Input_IOM_REFINPUT_P20_14, CHANNEL0_IOM_REFINPUT_GTMTOUT15, CHANNEL1_IOM_REFINPUT_PSI5TX2, CHANNEL2_IOM_REFINPUT_ASI3ATX, IOM_REFINPUT_GTMEXORCOMBINER15}, origin=ChipowerTech, post-build-variant-value=true, set at post-build, default-value=Input_IOM_REFINPUT_P33_0  # To select reference input signal
      container IomLPUConfiguration [1..16]: multiplicity set at pre-compile, requires-index=true  # This container contains configuration for LPU register.
        integer IomLPUUnitNo: 0..15, origin=ChipowerTech, post-build-variant-value=true, set at post-build, symbolic-name-value=true, default-value=0  # LPU register unit or LPU number
        integer IomLPUEventWinTime: 0..16777215, origin=ChipowerTech, post-build-variant-value=true, set at post-build, default-value=0  # The duration of the event window.
        boolean IomLPUInvReferSignal: origin=ChipowerTech, post-build-variant-value=true, set at post-build, default-value=false  # Determines whether reference signal from PPU channel is inverted or not
        boolean IomLPUInvMonSignal: origin=ChipowerTech, post-build-variant-value=true, set at post-build, default-value=false  # Determines whether monitor signal from PPU channel is inverted or not
        boolean IomLPUInvEventWin: origin=ChipowerTech, post-build-variant-value=true, set at post-build, default-value=false  # Determines whether event window polarity is inverted or not
        enumeration IomLPUEventSrcSelect: {IOM_LPUEVENTSOURCE_MON, IOM_LPUEVENTSOURCE_MONXORREF}, origin=ChipowerTech, post-build-variant-value=true, set at post-build, default-value=IOM_LPUEVENTSOURCE_MON  # Determines whether monitor signal sourced directly or EXORed with reference signal
        enumeration IomLPURunMode: {IOM_LPUEVENTWINDOWRUNCONTROL_FREERUNNING, IOM_LPUEVENTWINDOWRUNCONTROL_GATED}, origin=ChipowerTech, post-build-variant-value=true, set at post-build, default-value=IOM_LPUEVENTWINDOWRUNCONTROL_FREERUNNING  # Determines whether event window generation is free running or gated with monitor or reference signal
        enumeration IomLPUEventWinSelect: {IOM_LPUEVENTWINDOWCONTROLSOURCE_REF, IOM_LPUEVENTWINDOWCONTROLSOURCE_MON}, origin=ChipowerTech, post-build-variant-value=true, set at post-build, default-value=IOM_LPUEVENTWINDOWCONTROLSOURCE_REF  # Determines whether event window generation is from monitor signal or reference signal
        enumeration IomLPUEveActiveEdgeSelect: {IOM_LPUEVENTTRIGGER_NONE, IOM_LPUEVENTTRIGGER_RISINGEDGE, IOM_LPUEVENTTRIGGER_FALLINGEDGE, IOM_LPUEVENTTRIGGER_ANYEDGE}, origin=ChipowerTech, post-build-variant-value=true, set at post-build, default-value=IOM_LPUEVENTTRIGGER_NONE  # Determines which active edges of reference and monitor signals are used for event generation
        enumeration IomLPUEveWinActiveEdgeSelect: {IOM_LPUEVENTWINDOWCLEAREVENT_NONE, IOM_LPUEVENTWINDOWCLEAREVENT_RISINGEDGE, IOM_LPUEVENTWINDOWCLEAREVENT_FALLINGEDGE, IOM_LPUEVENTWINDOWCLEAREVENT_ANYEDGE}, origin=ChipowerTech, post-build-variant-value=true, set at post-build, default-value=IOM_LPUEVENTWINDOWCLEAREVENT_NONE  # Determines which active edges of reference and monitor signals are used for event window generation
        enumeration IomLPUMonInputSel: {CH0, CH1, CH2, CH3, CH4, CH5, CH6, CH7, CH8, CH9, CH10, CH11, CH12, CH13, CH14, CH15}, origin=ChipowerTech, post-build-variant-value=true, set at post-build, default-value=CH0  # To select monitor output signal from PPU to be used by LPU.
        enumeration IomLPURefInputSel: {CH0, CH1, CH2, CH3, CH4, CH5, CH6, CH7, CH8, CH9, CH10, CH11, CH12, CH13, CH14, CH15}, origin=ChipowerTech, post-build-variant-value=true, set at post-build, default-value=CH0  # To select reference output signal from PPU to be used by LPU.
        enumeration IomLPUchannelInputEMUSel: {IOM_EVENTCOUNTERCHANNEL_0, IOM_EVENTCOUNTERCHANNEL_1, IOM_EVENTCOUNTERCHANNEL_2, IOM_EVENTCOUNTERCHANNEL_3, IOM_EVENTCOUNTERCHANNEL_NOCOUNTER}, origin=ChipowerTech, post-build-variant-value=true, set at post-build, default-value=IOM_EVENTCOUNTERCHANNEL_NOCOUNTER  # Select which EMU counter is enabled for events output from the LPU.
      container IomGtmConfiguration  # This container contains configuration for GTM input reference signal. IOM_GTM_0-IOM_GTM_7 corresponds to GTM_TOUT22-GTM_TOUT29
        enumeration IomGtmInput0: {IOM_DISABLE_GTM_INPUT, IOM_ENABLE_GTM_INPUT}, origin=ChipowerTech, post-build-variant-value=true, set at post-build, default-value=IOM_DISABLE_GTM_INPUT  # Disables/Enables the GTM input signal 0 to be included in EXOR combiner. P33.0 = GTM_TOUT22 editable.
        enumeration IomGtmInput1: {IOM_DISABLE_GTM_INPUT, IOM_ENABLE_GTM_INPUT}, origin=ChipowerTech, post-build-variant-value=true, set at post-build, default-value=IOM_DISABLE_GTM_INPUT  # Disables/Enables the GTM input signal 1 to be included in EXOR combiner. P33.1 = GTM_TOUT23 editable.
        enumeration IomGtmInput2: {IOM_DISABLE_GTM_INPUT, IOM_ENABLE_GTM_INPUT}, origin=ChipowerTech, post-build-variant-value=true, set at post-build, default-value=IOM_DISABLE_GTM_INPUT  # Disables/Enables the GTM input signal 2 to be included in EXOR combiner. P33.2 = GTM_TOUT24 editable.
        enumeration IomGtmInput3: {IOM_DISABLE_GTM_INPUT, IOM_ENABLE_GTM_INPUT}, origin=ChipowerTech, post-build-variant-value=true, set at post-build, default-value=IOM_DISABLE_GTM_INPUT  # Disables/Enables the GTM input signal 3 to be included in EXOR combiner. P33.3 = GTM_TOUT25 editable.
        enumeration IomGtmInput4: {IOM_DISABLE_GTM_INPUT, IOM_ENABLE_GTM_INPUT}, origin=ChipowerTech, post-build-variant-value=true, set at post-build, default-value=IOM_DISABLE_GTM_INPUT  # Disables/Enables the GTM input signal 4 to be included in EXOR combiner. P33.4 = GTM_TOUT26 editable.
        enumeration IomGtmInput5: {IOM_DISABLE_GTM_INPUT, IOM_ENABLE_GTM_INPUT}, origin=ChipowerTech, post-build-variant-value=true, set at post-build, default-value=IOM_DISABLE_GTM_INPUT  # Disables/Enables the GTM input signal 5 to be included in EXOR combiner. P33.5 = GTM_TOUT27 editable.
        enumeration IomGtmInput6: {IOM_DISABLE_GTM_INPUT, IOM_ENABLE_GTM_INPUT}, origin=ChipowerTech, post-build-variant-value=true, set at post-build, default-value=IOM_DISABLE_GTM_INPUT  # Disables/Enables the GTM input signal 6 to be included in EXOR combiner. P33.6 = GTM_TOUT28 editable.
        enumeration IomGtmInput7: {IOM_DISABLE_GTM_INPUT, IOM_ENABLE_GTM_INPUT}, origin=ChipowerTech, post-build-variant-value=true, set at post-build, default-value=IOM_DISABLE_GTM_INPUT  # Disables/Enables the GTM input signal 7 to be included in EXOR combiner. P33.7 = GTM_TOUT29 editable.
      container IomEMUConfiguration  # This container contains configuration for Event Combiner Module configuration
        container IomEventCombModCount  # Contains Event Combiner Modules count
          enumeration IomEMUThreshold0: {IOM_EVENTCOUNTERTHRESHOLD_DISABLE, IOM_EVENTCOUNTERTHRESHOLD_1, IOM_EVENTCOUNTERTHRESHOLD_2, IOM_EVENTCOUNTERTHRESHOLD_3, IOM_EVENTCOUNTERTHRESHOLD_4, IOM_EVENTCOUNTERTHRESHOLD_5, IOM_EVENTCOUNTERTHRESHOLD_6, IOM_EVENTCOUNTERTHRESHOLD_7, IOM_EVENTCOUNTERTHRESHOLD_8, IOM_EVENTCOUNTERTHRESHOLD_9, IOM_EVENTCOUNTERTHRESHOLD_10, IOM_EVENTCOUNTERTHRESHOLD_11, IOM_EVENTCOUNTERTHRESHOLD_12, IOM_EVENTCOUNTERTHRESHOLD_13, IOM_EVENTCOUNTERTHRESHOLD_14, IOM_EVENTCOUNTERTHRESHOLD_15}, origin=ChipowerTech, post-build-variant-value=true, set at post-build, default-value=IOM_EVENTCOUNTERTHRESHOLD_DISABLE  # Indicates threshold count value for the counter 0 of the EMU module.Upon counter meeting this value, the counter event output becomes high for one clock cycle. If select IOM_EMU_C0_COUNTER_OFF counter is disabled
          enumeration IomEMUThreshold1: {IOM_EVENTCOUNTERTHRESHOLD_DISABLE, IOM_EVENTCOUNTERTHRESHOLD_1, IOM_EVENTCOUNTERTHRESHOLD_2, IOM_EVENTCOUNTERTHRESHOLD_3, IOM_EVENTCOUNTERTHRESHOLD_4, IOM_EVENTCOUNTERTHRESHOLD_5, IOM_EVENTCOUNTERTHRESHOLD_6, IOM_EVENTCOUNTERTHRESHOLD_7, IOM_EVENTCOUNTERTHRESHOLD_8, IOM_EVENTCOUNTERTHRESHOLD_9, IOM_EVENTCOUNTERTHRESHOLD_10, IOM_EVENTCOUNTERTHRESHOLD_11, IOM_EVENTCOUNTERTHRESHOLD_12, IOM_EVENTCOUNTERTHRESHOLD_13, IOM_EVENTCOUNTERTHRESHOLD_14, IOM_EVENTCOUNTERTHRESHOLD_15}, origin=ChipowerTech, post-build-variant-value=true, set at post-build, default-value=IOM_EVENTCOUNTERTHRESHOLD_DISABLE  # Indicates threshold count value for the counter 1 of the EMU module.Upon counter meeting this value, the counter event output becomes high for one clock cycle. If select IOM_EMU_C1_COUNTER_OFF counter is disabled
          enumeration IomEMUThreshold2: {IOM_EVENTCOUNTERTHRESHOLD_DISABLE, IOM_EVENTCOUNTERTHRESHOLD_1, IOM_EVENTCOUNTERTHRESHOLD_2, IOM_EVENTCOUNTERTHRESHOLD_3, IOM_EVENTCOUNTERTHRESHOLD_4, IOM_EVENTCOUNTERTHRESHOLD_5, IOM_EVENTCOUNTERTHRESHOLD_6, IOM_EVENTCOUNTERTHRESHOLD_7, IOM_EVENTCOUNTERTHRESHOLD_8, IOM_EVENTCOUNTERTHRESHOLD_9, IOM_EVENTCOUNTERTHRESHOLD_10, IOM_EVENTCOUNTERTHRESHOLD_11, IOM_EVENTCOUNTERTHRESHOLD_12, IOM_EVENTCOUNTERTHRESHOLD_13, IOM_EVENTCOUNTERTHRESHOLD_14, IOM_EVENTCOUNTERTHRESHOLD_15}, origin=ChipowerTech, post-build-variant-value=true, set at post-build, default-value=IOM_EVENTCOUNTERTHRESHOLD_DISABLE  # Indicates threshold count value for the counter 2 of the EMU module.Upon counter meeting this value, the counter event output becomes high for one clock cycle. If count select IOM_EMU_C2_COUNTER_OFF counter is disabled
          enumeration IomEMUThreshold3: {IOM_EVENTCOUNTERTHRESHOLD_DISABLE, IOM_EVENTCOUNTERTHRESHOLD_1, IOM_EVENTCOUNTERTHRESHOLD_2, IOM_EVENTCOUNTERTHRESHOLD_3, IOM_EVENTCOUNTERTHRESHOLD_4, IOM_EVENTCOUNTERTHRESHOLD_5, IOM_EVENTCOUNTERTHRESHOLD_6, IOM_EVENTCOUNTERTHRESHOLD_7, IOM_EVENTCOUNTERTHRESHOLD_8, IOM_EVENTCOUNTERTHRESHOLD_9, IOM_EVENTCOUNTERTHRESHOLD_10, IOM_EVENTCOUNTERTHRESHOLD_11, IOM_EVENTCOUNTERTHRESHOLD_12, IOM_EVENTCOUNTERTHRESHOLD_13, IOM_EVENTCOUNTERTHRESHOLD_14, IOM_EVENTCOUNTERTHRESHOLD_15}, origin=ChipowerTech, post-build-variant-value=true, set at post-build, default-value=IOM_EVENTCOUNTERTHRESHOLD_DISABLE  # Indicates threshold count value for the counter 3 of the EMU module.Upon counter meeting this value, the counter event output becomes high for one clock cycle. If count select IOM_EMU_C3_COUNTER_OFF counter is disabled
          boolean BlockEventOutputRunTime: origin=ChipowerTech, post-build-variant-value=true, set at post-build, default-value=false  # Disable global event outoput during run time
      container IomClkConfiguration  # This container contains the configuration of the IOM Clock.
        integer IomClkConfiguration: 0..255, origin=ChipowerTech, post-build-variant-value=true, set at post-build, default-value=1  # Clock Divider Value.
    container CommonPublishedInformation  # Common container, aggregated by all modules. It contains published information about vendor and versions.
      integer ArReleaseMajorVersion: 0..255, origin=ChipowerTech, set at published-information, default-value=4  # Major version number of AUTOSAR specification on which the appropriate implementation is based on.
      integer ArReleaseMinorVersion: 0..255, origin=ChipowerTech, set at published-information, default-value=4  # Minor version number of AUTOSAR specification on which the appropriate implementation is based on.
      integer ArReleaseRevisionVersion: 0..255, origin=ChipowerTech, set at published-information, default-value=0  # Revision version number of AUTOSAR specification on which the appropriate implementation is based on.
      integer ModuleId: 0..255, origin=ChipowerTech, set at published-information, default-value=255  # Module ID of this module from Module List.
      integer SwMajorVersion: 0..255, origin=ChipowerTech, set at published-information, default-value=1  # Major version number of the vendor specific implementation of the module. The numbering is vendor specific.
      integer SwMinorVersion: 0..255, origin=ChipowerTech, set at published-information, default-value=0  # Minor version number of the vendor specific implementation of the module. The numbering is vendor specific.
      integer SwPatchVersion: 0..255, origin=ChipowerTech, set at published-information, default-value=0  # Patch level version number of the vendor specific implementation of the module. The numbering is vendor specific.
      integer VendorId: 0..255, origin=ChipowerTech, set at published-information, default-value=175  # Vendor ID of the dedicated implementation of this module according to the AUTOSAR vendor list.
