AUTOSAR XML (schema 00046)
package /THA6_AS440_FuSa
  ecuc definition collection Fee_EcuParameterDefinition: module=Fee
  module definition Fee [0..1]: refined-module-def=Fee, variants pre-compile  # Configuration of the Fee (Flash EEPROM Emulation) module.
    container FeeDemEventParameterRefs [0..1]: multiplicity set at pre-compile  # Container for the references to DemEventParameter elements which shall be invoked using the API Dem_ReportErrorStatus in case the corresponding error occurs. The EventId is taken from the referenced DemEventParameter's DemEventId value.
      reference FEE_E_GC_READ [0..1]: multiplicity set at pre-compile, origin=ChipowerTech, set at pre-compile, requires-symbolic-name-value=true, destination=DemEventParameter  # Reference to DemEventParameter for the production error FEE_E_GC_READ.
      reference FEE_E_GC_WRITE [0..1]: multiplicity set at pre-compile, origin=ChipowerTech, set at pre-compile, requires-symbolic-name-value=true, destination=DemEventParameter  # Reference to DemEventParameter for the production error FEE_E_GC_WRITE.
      reference FEE_E_GC_ERASE [0..1]: multiplicity set at pre-compile, origin=ChipowerTech, set at pre-compile, requires-symbolic-name-value=true, destination=DemEventParameter  # Reference to DemEventParameter for the production error FEE_E_GC_ERASE.
      reference FEE_E_GC_TRIG [0..1]: multiplicity set at pre-compile, origin=ChipowerTech, set at pre-compile, requires-symbolic-name-value=true, destination=DemEventParameter  # Reference to DemEventParameter for the production error FEE_E_GC_TRIG.
      reference FEE_E_WRITE_CYCLES_EXHAUSTED [0..1]: multiplicity set at pre-compile, origin=ChipowerTech, set at pre-compile, requires-symbolic-name-value=true, destination=DemEventParameter  # Reference to DemEventParameter for the production error FEE_E_WRITE_CYCLES_EXHAUSTED.
      reference FEE_E_UNCONFIG_BLK_EXCEEDED [0..1]: multiplicity set at pre-compile, origin=ChipowerTech, set at pre-compile, requires-symbolic-name-value=true, destination=DemEventParameter  # Reference to DemEventParameter for the production error FEE_E_UNCONFIG_BLK_EXCEEDED.
    container FeeBlockConfiguration [1..*]: multiplicity set at pre-compile, requires-index=true  # Configuration of block specific parameters for the Flash EEPROM Emulation module.
      integer FeeBlockNumber: 1..65534, scope=ECU, set at pre-compile, symbolic-name-value=true, default-value=1  # Block identifier (handle).
      integer FeeBlockSize: 1..65535, scope=ECU, set at pre-compile, default-value=1  # Size of a logical block in bytes.
      boolean FeeImmediateData: scope=ECU, set at pre-compile, default-value=false  # Marker for high priority data.
      integer FeeNumberOfWriteCycles: 0..4294967295, set at pre-compile, default-value=0  # Number of write cycles required for this block.The value 0 denotes that this block is not bound by any limit.
      reference FeeDeviceIndex: set at pre-compile, requires-symbolic-name-value=true, destination=FlsGeneral  # Reference to the device this block is stored in.This information is needed by the NVRAM manager.
    container FeeGeneral  # Container for general parameters. These parameters are not specific to a block.
      boolean FeeDevErrorDetect: set at pre-compile, default-value=false  # Switches the Default Error Tracer (Det) detection and report ON or OFF.
      boolean FeeSoftwareVerify: origin=ChipowerTech, set at pre-compile, default-value=false  # Switches the Software verification function after write erase completion ON or OFF.
      float FeeMainFunctionPeriod: 0.001..1.0, scope=ECU, set at pre-compile, default-value=0.01  # The period between successive calls to the main function in seconds.
      function name FeeNvmJobEndNotification [0..1]: multiplicity set at pre-compile, set at pre-compile, default-value=NvM_JobEndNotification  # Mapped to the job end notification routine provided by the upper layer module (NvM_JobEndNotification).
      function name FeeNvmJobErrorNotification [0..1]: multiplicity set at pre-compile, set at pre-compile, default-value=NvM_JobErrorNotification  # Mapped to the job error notification routine provided by the upper layer module (NvM_JobErrorNotification).
      function name FeeUnavailableFailureNotification [0..1]: multiplicity set at pre-compile, origin=ChipowerTech, set at pre-compile, default-value=NvM_UnavailableFailureNotification  # Mapped to the unavailable failure notification routine provided by the upper layer module. When there is an error during the initialization process or GC (garbage collection) error is called.
      function name FeeDiscoverNonErasableAreasNotification [0..1]: multiplicity set at pre-compile, origin=ChipowerTech, set at pre-compile, default-value=NvM_DiscoverNonErasableAreasNotification  # Mapped to the discover non erasable areas notification routine provided by the upper layer module. Call the notification function when an non erasable area is found.
      function name FeeNotFoundManagementInfoNotification [0..1]: multiplicity set at pre-compile, origin=ChipowerTech, set at pre-compile, default-value=NvM_NotFoundManagementInfoNotification  # Map to the undetected FEE module management information notification routine provided by the upper layer module. When the FEE module is initialized and it is checked that there is no FEE module management information in the flash memory (FEE module management information is damaged or the original flash memory), and the 'FeeNotFoundManagementInfo' node is true, the notification routine will be called.
      boolean FeePollingMode: set at pre-compile, default-value=false  # Pre-processor switch to enable and disable the polling mode for this module.As callback functions are always provided to the FLS module, this parameter is pre-configured (fixed) as FALSE.
      boolean FeeSetModeSupported: set at pre-compile, default-value=false  # Compiler switch to enable/disable the 'SetMode' functionality of the FEE module.
      boolean FeeVersionInfoApi: set at pre-compile, default-value=false  # Pre-processor switch to enable / disable the API to read out the modules version information.
      boolean FeeNotFoundManagementInfo: origin=ChipowerTech, set at pre-compile, default-value=false  # When the Fee module is initialized, it is detected that there is no Fee management information in the flash memory. (or it is virgin flash). TRUE: Stop the initialization operation and call the FeeNotFoundManagementInfo notification function. FALSE: Continue the initialization operation and write Fee module management information in Flash.
      enumeration FeeGcRestart: {FEE_GC_RESTART_INIT, FEE_GC_RESTART_WRITE}, origin=ChipowerTech, set at pre-compile, default-value=FEE_GC_RESTART_INIT  # This parameter is used to configure Garbage Collection restarting point. FEE_GC_RESTART_INIT: (if GC was interrupted in previous run) Restart GC after FEE Initialization. FEE_GC_RESTART_WRITE: (if GC was interrupted in previous run) Restart GC when the first write/invalidate request is issued.
      integer FeeThresholdValue: 0..260096, origin=ChipowerTech, set at pre-compile, default-value=256  # This parameter describes the threshold value (in bytes from the end of FEE sector) for triggering garbage collection/sector change.
      integer FeeMaxBlockCount: 1..8176, origin=ChipowerTech, set at pre-compile, default-value=1  # This configuration parameter specifies the total number of blocks throughout all configurations; Note that the blocks which are shared across configurations are counted only once. This parameter decides the cache table size at pre-compile time. The cache table holds the information of both configured and un-configured blocks. Configuration of this parameter shall be carefully done. Higher value implies higher RAM area consumption for cache table. Lower value would result in loss of un-configured block(s) during GC. Example 1: Configuration sets having mutually exclusive blocks: Configuration A: Number of blocks configured is 10. Configuration B: Number of blocks configured is 25. Then, FeeMaxBlockCount = 35. Example 2: 5 blocks are shared/used by both Configuration A and Configuration B: Configuration A: Number of blocks configured is 10. Configuration B: Number of blocks configured is 25. Then, FeeMaxBlockCount = 30 (i.e., shared blocks are counted only once).
      integer FeeMaxAllowedBadSector: 0..16, origin=ChipowerTech, set at pre-compile, default-value=0  # The max number of uneraseable sector allowed. When erase a sector fails, Fee automatically skip the sector and log the sector to erase state page.
      enumeration FeeMaxWriteBytesPerCycle: {FEE_MAX_BYTES_32_PERCYCLE, FEE_MAX_BYTES_64_PERCYCLE, FEE_MAX_BYTES_128_PERCYCLE}, origin=ChipowerTech, set at pre-compile, default-value=FEE_MAX_BYTES_128_PERCYCLE  # The maximum number of bytes that can be written in a FeeMainFunction cycle.
      integer FeeVirtualPageSize: 0..255, set at pre-compile, default-value=16  # The size in bytes to which logical blocks shall be aligned.
      reference FeeFlsSectorSelectionRef: origin=ChipowerTech, set at pre-compile, destination=FlsSector  # Reference to a Fls sector which fee use to store data, the number of sectors of that Fls sector must be divisible by 2.
    container FeePublishedInformation  # Additional published parameters not covered by CommonPublishedInformation container.
      integer FeeBlockOverhead: 24..24, set at published-information, default-value=24  # Management overhead per logical block in bytes.The actual overhead per block is calculated as: (1) If (FeeBlockSize <= 8): FeeBlockOverhead = 8 + 16 - FeeBlockSize. (2) If (((FeeBlockSize - 8) % 15) == 0): ((FeeBlockSize / 15) * 16) + 32 - FeeBlockSize. (3) If (((FeeBlockSize - 8) % 15) != 0): (((FeeBlockSize / 15) + 1) * 16) + 32 - FeeBlockSize.
      integer FeePageOverhead: 1..1, set at published-information, default-value=1  # Management overhead per page in bytes.
    container CommonPublishedInformation  # Common container, aggregated by all modules. It contains published information about vendor and versions.
      integer ArReleaseMajorVersion: 0..255, origin=ChipowerTech, set at published-information, default-value=4  # Major version number of AUTOSAR specification on which the appropriate implementation is based on.
      integer ArReleaseMinorVersion: 0..255, origin=ChipowerTech, set at published-information, default-value=4  # Minor version number of AUTOSAR specification on which the appropriate implementation is based on.
      integer ArReleaseRevisionVersion: 0..255, origin=ChipowerTech, set at published-information, default-value=0  # Patch level version number of AUTOSAR specification on which the appropriate implementation is based on.
      integer ModuleId: 0..255, origin=ChipowerTech, set at published-information, default-value=21  # Module ID of this module from Module List
      integer SwMajorVersion: 0..255, origin=ChipowerTech, set at published-information, default-value=1  # Major version number of the vendor specific implementation of the module. The numbering is vendor specific.
      integer SwMinorVersion: 0..255, origin=ChipowerTech, set at published-information, default-value=0  # Minor version number of the vendor specific implementation of the module. The numbering is vendor specific.
      integer SwPatchVersion: 0..255, origin=ChipowerTech, set at published-information, default-value=0  # Patch level version number of the vendor specific implementation of the module. The numbering is vendor specific.
      integer VendorId: 0..255, origin=ChipowerTech, set at published-information, default-value=175  # Vendor ID of the dedicated implementation of this module according to the AUTOSAR vendor list
