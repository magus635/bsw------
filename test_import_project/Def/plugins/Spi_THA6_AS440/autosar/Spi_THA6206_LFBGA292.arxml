AUTOSAR XML (schema 00046)
package /THA6_AS440_FuSa
  ecuc definition collection Spi_EcuParameterDefinition: module=Spi
  module definition Spi: post-build-variant-support=true, refined-module-def=Spi, variants post-build  # ECUC_Spi_00103: Configuration of the Spi (Serial Peripheral Interface) module.
    container SpiDemEventParameterRefs [0..1]: multiplicity set at pre-compile  # ECUC_Spi_00241: Container for the references to DemEventParameter elements which shall be invoked using the API Dem_ReportErrorStatus API in case the corresponding error occurs. The EventId is taken from the referenced DemEventParameter's DemEventId value. The standardized errors are provided in the container and can be extended by vendor specific error references.
      reference SPI_E_HARDWARE_ERROR [0..1]: multiplicity set at pre-compile, set at pre-compile, requires-symbolic-name-value=true, destination=DemEventParameter  # ECUC_Spi_00241: Reference to configured DEM event to report "Hardware failure". If the reference is not configured the error shall not be reported.
    container SpiGeneral  # ECUC_Spi_00225: General configuration settings for SPI-Handler
      integer SpiChannelBuffersAllowed: 0..2, set at pre-compile, default-value=0  # ECUC_Spi_00227: Selects the SPI Handler/Driver Channel Buffers usage allowed and delivered. Note 0 - USAGE0: Only Internal Buffers (IB) are allowed 1 - USAGE1: Only External buffers (EB) are allowed 2 - USAGE2: Both Internal (IB) and External (EB) buffers are allowed
      integer SpiLevelDelivered: 0..2, set at pre-compile, default-value=0  # ECUC_Spi_00231: Selects the SPI Handler/Driver level of scalable functionality that is available and delivered. Note 0 - Level0: Only Simple Synchronous Behavior 1 - Level1: Basic Asynchronous Behavior 2 - Level2: Enhanced Behavior(Both Synchronous and Asynchronous).
      float SpiMainFunctionPeriod [0..1]: 1.0E-7..1.0, multiplicity set at pre-compile, set at pre-compile, default-value=0.01  # ECUC_Spi_00242: This parameter defines the cycle time of the function Spi_MainFunction_Handling in seconds. The parameter is not used by the driver it self, but it is used by upper layer.
      integer SpiTransmitTimeout: 1..90000000, origin=ChipowerTech, set at pre-compile, default-value=1000  # Timeout value used to wait for the TX transfer to complete and the RX flag to be set. Unit: us Note This is an implementation parameter. If the chip cannot complete the data transfer within this timeout, the transfer will fail. This value must be greater than the time required to complete one data transfer.
      boolean SpiDevErrorDetect: set at pre-compile, default-value=false  # ECUC_Spi_00228: Switches the Default Error Tracer (Det) detection and notification ON or OFF.
      boolean SpiSafetyErrorDetect: origin=ChipowerTech, set at pre-compile, default-value=true  # Switches the functional safety detection and notification ON or OFF.
      boolean SpiCancelApi: set at pre-compile, default-value=false  # ECUC_Spi_00226: Switches the Spi_Cancel function ON or OFF.
      boolean SpiHwStatusApi: set at pre-compile, default-value=false  # ECUC_Spi_00229: Switches the Spi_GetHWUnitStatus function ON or OFF.
      boolean SpiVersionInfoApi: set at pre-compile, default-value=false  # ECUC_Spi_00232: Switches the Spi_GetVersionInfo function ON or OFF.
      boolean SpiInterruptibleSeqAllowed: set at pre-compile, default-value=false  # ECUC_Spi_00230: Switches the Interruptible Sequences handling functionality ON or OFF. Note This parameter available only when 'SpiLevelDelivered' = 1 or = 2
      boolean SpiSupportConcurrentSyncTransmit: set at pre-compile, default-value=false  # ECUC_Spi_00237: Specifies whether concurrent Spi_SyncTransmit() calls for different sequences shall be configurable.
      reference SpiEcucPartitionRef [0..*]: scope=ECU, multiplicity set at pre-compile, post-build-variant-multiplicity=true, post-build-variant-value=true, set at pre-compile, destination=EcucPartition  # ECUC_Spi_00244: Maps the SPI driver to zero or multiple ECUC partitions to make the driver API available in the according partition. Tags: atp.Status=draft.
      reference SpiKernelEcucPartitionRef [0..1]: scope=ECU, multiplicity set at pre-compile, post-build-variant-multiplicity=true, post-build-variant-value=true, set at pre-compile, destination=EcucPartition  # ECUC_Spi_00245: Maps the SPI kernel to zero or one ECUC partitions to assign the driver kernel to a certain core. The ECUC partition referenced is a subset of the ECUC partitions where the SPI driver is mapped to. Tags: atp.Status=draft.
    container SpiDriver  # ECUC_Spi_00091: This container contains the configuration parameters and sub containers of the AUTOSAR Spi module.
      integer SpiMaxChannel [0..1]: 0..255, multiplicity set at post-build, post-build-variant-multiplicity=true, post-build-variant-value=true, set at post-build, default-value=0  # ECUC_Spi_00197: This parameter contains the number of Channels configured. It will be gathered by tools during the configuration stage. Note This parameter is not used, the max number of channels will be auto calculated when 'SpiChannel' container configurated.
      integer SpiMaxJob [0..1]: 0..65535, multiplicity set at post-build, post-build-variant-multiplicity=true, post-build-variant-value=true, set at post-build, default-value=0  # ECUC_Spi_00198: Total number of Jobs configured. Note This parameter is not used, the max number of jobs will be auto calculated when 'SpiChannel' container configurated.
      integer SpiMaxSequence [0..1]: 0..255, multiplicity set at post-build, post-build-variant-multiplicity=true, post-build-variant-value=true, set at post-build, default-value=0  # ECUC_Spi_00199: Total number of Sequences configured. Note This parameter is not used, the max number of sequences will be auto calculated when 'SpiChannel' container configurated.
      container SpiChannel [1..255]: multiplicity set at pre-compile, requires-index=true  # ECUC_Spi_00104: All data needed to configure one SPI-channel.
        integer SpiChannelId: 0..255, set at pre-compile, symbolic-name-value=true, default-value=1  # ECUC_Spi_00200: SPI Channel ID, used as parameter in SPI API functions.
        enumeration SpiChannelType: {EB, IB}, post-build-variant-value=true, set at post-build, default-value=EB  # ECUC_Spi_00201: Buffer usage with EB/IB channel. Note This parameter is dependant on 'SpiChannelBuffersAllowed' parameter. When 'SpiChannelBuffersAllowed' = 0, SpiChannelType should be IB. When 'SpiChannelBuffersAllowed' = 1, SpiChannelType should be EB. When 'SpiChannelBuffersAllowed' = 2, SpiChannelType should be IB or EB.
        integer SpiDataWidth: 1..32, post-build-variant-value=true, set at post-build, default-value=8  # ECUC_Spi_00202: This parameter is the width of a transmitted data unit. Note The hardware supports data width is 8 to 32 bit. The unit is in bits. Must be a multiple of 8.
        integer SpiDefaultData [0..1]: 0..4294967295, multiplicity set at post-build, post-build-variant-multiplicity=true, post-build-variant-value=true, set at post-build, default-value=0  # ECUC_Spi_00203: The default data to be transmitted when (for internal buffer or external buffer). The pointer passed to Spi_WriteIB (for internal buffer) or to Spi_SetupEB (for external buffer) is NULL. Note: Value Ranges SpiDefaultData Value must be 0 ~ 2^SpiDataWidth.
        integer SpiEbMaxLength: 0..65535, post-build-variant-value=true, set at post-build, default-value=10  # ECUC_Spi_00204: This parameter contains the maximum size (number of data elements) of data buffers in case of EB Channels and only.
        integer SpiIbNBuffers: 0..65535, post-build-variant-value=true, set at post-build, default-value=5  # ECUC_Spi_00205: This parameter contains the maximum number of data buffers in case of IB Channels and only. Note This parameter only availible when ('SpiChannelBuffersAllowed' = '0' or = '2') and 'SpiChannelType' = 'IB'.
        enumeration SpiTransferStart: {LSB, MSB}, post-build-variant-value=true, set at post-build, default-value=MSB  # ECUC_Spi_00206: This parameter defines the first starting bit for transmission. Note LSB - Transmission starts with the Least Significant Bit first. MSB - Transmission starts with the Most Significant Bit first.
      container SpiExternalDevice [1..255]: multiplicity set at pre-compile, requires-index=true  # ECUC_Spi_00207: The communication settings of an external device. Closely linked to SpiJob.
        integer SpiExternalDeviceId: 0..255, origin=ChipowerTech, set at pre-compile, default-value=0  # SPI External Device ID, used for order.
        string SpiCsIdentifier: set at pre-compile, default-value=SLSO_0  # ECUC_Spi_00209: This parameter is the symbolic name to identify the Chip Select (CS) allocated to this Job.
        boolean SpiEnableCs: post-build-variant-value=true, set at post-build, default-value=false  # ECUC_Spi_00212: This parameter enables or not the Chip Select handling functions. If this parameter is enabled then parameter SpiCsSelection further details the type of chip selection. If this parameter is not disabled, selected SPI Peripheral 'SLSO' will be available.
        enumeration SpiCsSelection [0..1]: {CS_VIA_GPIO, CS_VIA_PERIPHERAL_ENGINE}, multiplicity set at post-build, post-build-variant-multiplicity=true, post-build-variant-value=true, set at post-build, default-value=CS_VIA_PERIPHERAL_ENGINE  # ECUC_Spi_00239: When the Chip select handling is enabled (see SpiEnableCs), then this parameter specifies if the chip select is handled automatically by Pe-ripheral HW engine or via general purpose IO by Spi driver. Note As for SPI, 'CS_VIA_PERIPHERAL_ENGINE' is recommended.
        float SpiBaudrate: 0.0..5.0E7, post-build-variant-value=true, set at post-build, default-value=8000000.0  # ECUC_Spi_00208: This parameter is the communication baudrate - This parameter allows using a range of values, from the point of view of configuration tools, from Hz up to MHz. Typical value When SpiGlobalClkDivRatioParamTq in SpiHwUnitConfig is configured as 1, the available baud Note It will be auto calculated by configured parameters. Baudrate = SpiModuleClock / (SpiBaudParamTq*SpiBaudParamQ*(SpiBaudParamA+SpiBaudParamB+SpiBaudParamC))
        boolean SpiAutoCalcBaudrateParams: origin=ChipowerTech, post-build-variant-value=true, set at post-build, default-value=false  # Switches automatic calculation of Baudrate parameters function ON or OFF.
        boolean SpiAutoCalcDelayParams: origin=ChipowerTech, post-build-variant-value=true, set at post-build, default-value=false  # Switches automatic calculation of delay parameters function ON or OFF.
        float SpiTimeClk2Cs: 1.0E-8..0.01, post-build-variant-value=true, set at post-build, default-value=4.0E-8  # Timing between clock and chip select(LEAD) (in seconds) - This parameter allows to use a range of values from 0 up to 0.1048576 seconds. The real configuration-value used in software BSW-SPI is calculated out of this by the generator-tools.
        float SpiIdleTime: 1.0E-8..0.01, origin=ChipowerTech, post-build-variant-value=true, set at post-build, default-value=4.0E-8  # Timing between Bus IDLE (in seconds) - This parameter allows to use a range of values from 0 up to 0.0001 seconds. The real configuration-value used in software BSW-SPI is calculated out of this by the generator-tools.
        float SpiTrailingTime: 1.0E-8..0.01, origin=ChipowerTech, post-build-variant-value=true, set at post-build, default-value=4.0E-8  # Timing between Bus Trail (in seconds) - This parameter allows to use a range of values from 0 up to 0.0001 seconds. The real configuration-value used in software BSW-SPI is calculated out of this by the generator-tools.
        enumeration SpiCsPolarity: {HIGH, LOW}, post-build-variant-value=true, set at post-build, default-value=HIGH  # ECUC_Spi_00210: This parameter defines the active polarity of Chip Select.
        enumeration SpiDataShiftEdge: {LEADING, TRAILING}, post-build-variant-value=true, set at post-build, default-value=LEADING  # ECUC_Spi_00211: This parameter defines the SPI data shift edge.
        enumeration SpiShiftClockIdleLevel: {HIGH, LOW}, post-build-variant-value=true, set at post-build, default-value=HIGH  # ECUC_Spi_00213: This parameter defines the SPI shift clock idle level.
        enumeration SpiParitySupport: {Unused, Even, Odd}, origin=ChipowerTech, set at post-build, default-value=Unused  # When the SpiParitySupport is selected SPI data Transmission/Reception incorporates an additional bit making the parity EVEN or ODD based on selection.
        enumeration SpiHwUnit: {Spi_0, Spi_1, Spi_2, Spi_3, Spi_4, Spi_5, Spi_6, Spi_7, Spi_8}, post-build-variant-value=true, set at post-build, default-value=Spi_0  # ECUC_Spi_00217: This parameter is the symbolic name to identify the HW SPI Hardware.
        reference SpiHwUnitRef: origin=ChipowerTech, post-build-variant-value=true, set at post-build, destination=SpiHwUnitConfig  # Select the Spi hardware unit used for this external device.
        reference SpiCustomCsPinRef [0..1]: multiplicity set at post-build, origin=ChipowerTech, post-build-variant-multiplicity=true, post-build-variant-value=true, set at post-build, destination=DioChannel  # Select the custom chip selection pin. This parameter only availabled when 'SpiEnableCs' = 'true' and 'SpiCsSelection' = 'CS_VIA_GPIO', Instead of 'SpiCsIdentifier'
        reference SpiModuleClock: origin=ChipowerTech, post-build-variant-value=true, set at post-build, destination=McuClockReferencePoint  # This parameter defines SPI module clk(hz) to calculate Baudrate. This parameter is reference from MCU Spi clock, configure SPI clock first in MCU Container
        reference SpiDeviceEcucPartitionRef [0..*]: scope=ECU, multiplicity set at pre-compile, post-build-variant-multiplicity=true, post-build-variant-value=true, set at pre-compile, destination=EcucPartition  # ECUC_Spi_00246: Maps an SPI external device to zero or multiple ECUC partitions to limit the access to this external device. The ECUC partitions referenced are a subset of the ECUC partitions where the SPI driver is mapped to. Tags: atp.Status=draft.
        container SpiBaudrateParams  # This container has the parameters which are responsible for the Baudrate.
          integer SpiBaudParamA: 1..4, origin=ChipowerTech, post-build-variant-value=true, set at post-build, default-value=1  # This parameter defines Spi A Hw parameter. This corresponds to the length expressed in time quantums of Q. 1 2 3 4 Refer to the register 'ECON' bit6-7 in User Manual .
          integer SpiBaudParamB: 0..3, origin=ChipowerTech, post-build-variant-value=true, set at post-build, default-value=1  # This parameter defines Spi B Hw parameter. This corresponds to the length expressed in time quantums of Q. 0 1 2 3 Refer to the register 'ECON' bit8-9 in User Manual .
          integer SpiBaudParamC: 0..3, origin=ChipowerTech, post-build-variant-value=true, set at post-build, default-value=1  # This parameter defines Spi C Hw parameter. This corresponds to the length expressed in time quantums of Q. 0 1 2 3 Refer to the register 'ECON' bit10-11 in User Manual .
          integer SpiBaudParamQ: 1..64, origin=ChipowerTech, post-build-variant-value=true, set at post-build, default-value=10  # This parameter defines Spi Q Hw parameter. This defines the time quantum length used by A, B, and C to define the baud rate and duty cycle. 1 2 3 ... 64 Refer to the register 'ECON' bit0-5 in User Manual .
        container SpiDelayParams  # Responsible for configuration of delay parameters during transfer.
          integer SpiParamTrail: 0..7, origin=ChipowerTech, post-build-variant-value=true, set at post-build, default-value=1  # This parameter defines the prescaler for trailing delay. 4^0: 1 4^1: 4 4^2: 16 4^3: 64 4^4: 256 4^5: 1024 4^6: 4096 4^7: 16384 Refer to the register 'EMCON' bit15-13 in User Manual .
          integer SpiParamTrailUnit: 0..7, origin=ChipowerTech, post-build-variant-value=true, set at post-build, default-value=1  # This parameter defines the Spi trailing delay length. 0: 1 units 1: 2 units ... 7: 8 units Refer to the register 'EMCON' bit18-16 in User Manual .
          integer SpiParamLead: 0..7, origin=ChipowerTech, post-build-variant-value=true, set at post-build, default-value=1  # This parameter defines the prescaler for leading delay. 4^0: 1 4^1: 4 4^2: 16 4^3: 64 4^4: 256 4^5: 1024 4^6: 4096 4^7: 16384 Refer to the register 'EMCON' bit9-7 in User Manual .
          integer SpiParamLeadUnit: 0..7, origin=ChipowerTech, post-build-variant-value=true, set at post-build, default-value=1  # This parameter defines the Spi leading delay length. 0: 1 units 1: 2 units ... 7: 8 units Refer to the register 'EMCON' bit12-10 in User Manual .
          integer SpiParamIdle: 0..7, origin=ChipowerTech, post-build-variant-value=true, set at post-build, default-value=1  # This parameter defines the prescaler for idle delay. 4^0: 1 4^1: 4 4^2: 16 4^3: 64 4^4: 256 4^5: 1024 4^6: 4096 4^7: 16384 Refer to the register 'EMCON' bit3-1 in User Manual .
          integer SpiParamIdleUnit: 0..7, origin=ChipowerTech, post-build-variant-value=true, set at post-build, default-value=1  # This parameter defines the Spi idle delay length. 0: 1 units 1: 2 units ... 7: 8 units Refer to the register 'EMCON' bit6-4 in User Manual .
      container SpiHwUnitConfig [1..9]: multiplicity set at pre-compile, requires-index=true  # The communication settings of an external device. Closely linked to SpiJob.
        integer SpiHwUnitId: 0..65535, origin=ChipowerTech, set at pre-compile, symbolic-name-value=true, default-value=1  # SPI hardware unit ID.
        enumeration SpiHWUnitMapping: {Spi_0, Spi_1, Spi_2, Spi_3, Spi_4, Spi_5, Spi_6, Spi_7, Spi_8}, origin=ChipowerTech, set at pre-compile, default-value=Spi_0  # This parameter is the symbolic name to identify the HW SPI Hardware microcontroller peripheral.
        integer SpiGlobalClkDivRatioParamTq: 1..256, origin=ChipowerTech, post-build-variant-value=true, set at post-build, default-value=2  # This parameter defines Spi TQ Hw parameter. It corresponds to the Global Time Quantum Length for Global Configuration register. 1 1/2 1/3 ... 1/256 Refer to the register 'GLOBALCON1' bit0-7 in User Manual .
        boolean SpiEnableDMA: origin=ChipowerTech, set at pre-compile, default-value=false  # Switches the SPI DMA function ON or OFF.
        reference SpiTxDmaChannelRef [0..1]: multiplicity set at pre-compile, origin=ChipowerTech, set at pre-compile, destination=DmaChannel  # Reference to the DMA Channel used by this Spi HwUnit
        reference SpiRxDmaChannelRef [0..1]: multiplicity set at pre-compile, origin=ChipowerTech, set at pre-compile, destination=DmaChannel  # Reference to the DMA Channel used by this Spi HwUnit
      container SpiJob [1..65535]: multiplicity set at pre-compile, requires-index=true  # ECUC_Spi_00105: All data needed to configure one SPI-Job, amongst others the connection between the internal SPI unit and the special settings for an external device is done.
        integer SpiJobId: 0..65535, set at pre-compile, symbolic-name-value=true, default-value=1  # ECUC_Spi_00219: SPI Job ID, used as parameter in SPI API functions.
        function name SpiJobEndNotification [0..1]: multiplicity set at post-build, post-build-variant-multiplicity=true, post-build-variant-value=true, set at post-build, default-value=NULL_PTR  # ECUC_Spi_00218: This parameter is a reference to a notification function. Note This parameter available only when 'SpiLevelDelivered' = 1 or = 2. Must be a valid C function name or NULL_PTR.
        integer SpiJobPriority: 0..3, post-build-variant-value=true, set at post-build, default-value=0  # ECUC_Spi_00220: Priority set accordingly to SPI: '0' is lowest; '3' is highest priority.
        boolean SpiReleaseCSEachData: origin=ChipowerTech, post-build-variant-value=true, set at post-build, default-value=false  # if true, then SPI Driver releases CS signal after sending each data.
        reference SpiDeviceAssignment: set at pre-compile, destination=SpiExternalDevice  # ECUC_Spi_00216: Reference to the external device used by this job.
        container SpiChannelList [1..255]: multiplicity set at pre-compile, requires-index=true  # ECUC_Spi_00233: References to SPI channels and their order within the Job.
          integer SpiChannelIndex: 0..255, post-build-variant-value=true, set at post-build, default-value=1  # ECUC_Spi_00234: This parameter specifies the order of Channels within the Job.
          reference SpiChannelAssignment: post-build-variant-value=true, set at post-build, destination=SpiChannel  # ECUC_Spi_00215: A job reference to a SPI channel.
      container SpiSequence [1..255]: multiplicity set at pre-compile, requires-index=true  # ECUC_Spi_00106: All data needed to configure one SPI-sequence
        integer SpiSequenceId: 0..255, scope=ECU, set at pre-compile, default-value=1  # ECUC_Spi_00224: SPI Sequence ID, used as parameter in SPI API functions.
        boolean SpiInterruptibleSequence: post-build-variant-value=true, set at post-build, default-value=false  # ECUC_Spi_00222: This parameter allows or not this Sequence to be suspended by another one. Note This parameter only available when 'SpiInterruptibleSeqAllowed' = true.
        function name SpiSeqEndNotification [0..1]: multiplicity set at post-build, post-build-variant-multiplicity=true, post-build-variant-value=true, set at post-build, default-value=NULL_PTR  # ECUC_Spi_00223: This parameter is a reference to a notification function. Note This parameter available only when 'SpiLevelDelivered' = 1 or = 2. Must be a valid C function name or NULL_PTR.
        reference SpiJobAssignment [1..*]: multiplicity set at post-build, post-build-variant-multiplicity=true, post-build-variant-value=true, set at post-build, destination=SpiJob  # ECUC_Spi_00221: A sequence references several jobs, which are executed during a communication sequence.
    container SpiPublishedInformation  # ECUC_Spi_00235: Container holding all SPI specific published information parameters.
      integer SpiMaxHwUnit: 0..20, set at published-information, default-value=9  # ECUC_Spi_00236: Number of different SPI hardware microcontroller peripherals (units/busses) available and handled by this SPI Handler/Driver module.
    container CommonPublishedInformation  # Common container, aggregated by all modules. It contains published information about vendor and versions.
      integer ArReleaseMajorVersion: 0..255, origin=ChipowerTech, set at published-information, default-value=4  # Major version number of AUTOSAR specification on which the appropriate implementation is based on.
      integer ArReleaseMinorVersion: 0..255, origin=ChipowerTech, set at published-information, default-value=4  # Minor version number of AUTOSAR specification on which the appropriate implementation is based on.
      integer ArReleaseRevisionVersion: 0..255, origin=ChipowerTech, set at published-information, default-value=0  # Revision version number of AUTOSAR specification on which the appropriate implementation is based on.
      integer SwMajorVersion: 0..255, origin=ChipowerTech, set at published-information, default-value=1  # Major version number of the vendor specific implementation of the module. The numbering is vendor specific.
      integer SwMinorVersion: 0..255, origin=ChipowerTech, set at published-information, default-value=0  # Minor version number of the vendor specific implementation of the module. The numbering is vendor specific.
      integer SwPatchVersion: 0..255, origin=ChipowerTech, set at published-information, default-value=0  # Patch level version number of the vendor specific implementation of the module. The numbering is vendor specific.
      integer VendorId: 175..175, origin=ChipowerTech, set at published-information, default-value=175  # Vendor ID of the dedicated implementation of this module according to the AUTOSAR vendor list.
      integer ModuleId: 0..255, origin=ChipowerTech, set at published-information, default-value=83  # Module ID of this module from Module List.
