[part 2 of 2: package /THA6_AS440_FuSa]
AUTOSAR XML (schema 00046)
package /THA6_AS440_FuSa  (continued)
  module definition Mcu [0..1]: post-build-variant-support=true, refined-module-def=Mcu, variants post-build  (continued)
    container GtmConfiguration [1..*]: multiplicity set at post-build, post-build-variant-multiplicity=true  # This container contains the configuration parameters of the GTM driver.
      container GtmGeneral  # This container contains the General Configuration for GTM
        integer CMUGlobalClkDivNumerator: 0..16777215, origin=ChipowerTech, post-build-variant-value=true, set at post-build, default-value=1  # This parameter specifies the Numerator value for the CMU Global Clock Divider. This modifies GTM_CMU_GCLK_NUM [GCLK_NUM]. Global Clock = System Clock * ( CMUGlobalClkDivDenominator/ CMUGlobalClkDivNumerator).
        integer CMUGlobalClkDivDenominator: 0..16777215, origin=ChipowerTech, post-build-variant-value=true, set at post-build, default-value=1  # This parameter specifies the Denominator value for the CMU Global Clock Divider. Global Clock = System Clock * ( CMUGlobalClkDivDenominator/ CMUGlobalClkDivNumerator). This value should be configured lesser than Numerator value.
        integer CMUClusterClockCfg: 0..16777215, origin=ChipowerTech, post-build-variant-value=true, set at post-build, default-value=11162965  # This parameter (enable \ disable \ enabled with clock divider 2) the cluster clock..
        boolean GTM_TBU_Support: origin=ChipowerTech, post-build-variant-value=true, set at post-build, default-value=false  # This parameter specifies the TBU module used or not.
      container Cmu: multiplicity set at post-build  # This container contains the Clock Configuration for GTM
        container CmuConfigurableClock  # This container contains the Configurable Clock Configuration for GTM
          boolean CmuEnableConfigurableClk0: origin=ChipowerTech, post-build-variant-value=true, set at post-build, default-value=false  # Enables/Disables the Configurable Clock 0 of GTM. This modifies GTM_CMU_CLK_EN[EN_CLK0]
          integer CmuConfigurableClk0Div: 0..16777215, origin=ChipowerTech, post-build-variant-value=true, set at post-build, default-value=0  # This parameter specifies the Divider value for the configurable Clock 0. This modifies GTM_CMU_CLK_0_CTRL[CLK_CNT]. Hence the final clock frequency will be, Gtm frequency (after Global prescaler) /(Divider value configured here + 1)
          boolean CmuEnableConfigurableClk1: origin=ChipowerTech, post-build-variant-value=true, set at post-build, default-value=false  # Enables the Configurable Clock 1 of GTM. This modifies GTM_CMU_CLK_EN[EN_CLK1].
          integer CmuConfigurableClk1Div: 0..16777215, origin=ChipowerTech, post-build-variant-value=true, set at post-build, default-value=0  # This parameter specifies the Divider value for the configurable Clock 1. This modifies GTM_CMU_CLK_1_CTRL[CLK_CNT] Hence the final clock frequency will be, Gtm frequency (after Global prescaler) /(Divider value configured here + 1)
          boolean CmuEnableConfigurableClk2: origin=ChipowerTech, post-build-variant-value=true, set at post-build, default-value=false  # Enables the Configurable Clock 2 of GTM. This modifies GTM_CMU_CLK_EN[EN_CLK2].
          integer CmuConfigurableClk2Div: 0..16777215, origin=ChipowerTech, post-build-variant-value=true, set at post-build, default-value=0  # This parameter specifies the Divider value for the configurable Clock 2. This modifies GTM_CMU_CLK_2_CTRL[CLK_CNT] Hence the final clock frequency will be, Gtm frequency (after Global prescaler) /(Divider value configured here + 1)
          boolean CmuEnableConfigurableClk3: origin=ChipowerTech, post-build-variant-value=true, set at post-build, default-value=false  # Enables the Configurable Clock 3 of GTM. This modifies GTM_CMU_CLK_EN[EN_CLK3].
          integer CmuConfigurableClk3Div: 0..16777215, origin=ChipowerTech, post-build-variant-value=true, set at post-build, default-value=0  # This parameter specifies the Divider value for the configurable Clock 3. This modifies GTM_CMU_CLK_3_CTRL[CLK_CNT]. Hence the final clock frequency will be, Gtm frequency (after Global prescaler) /(Divider value configured here + 1)
          boolean CmuEnableConfigurableClk4: origin=ChipowerTech, post-build-variant-value=true, set at post-build, default-value=false  # Enables the Configurable Clock 4 of GTM. This modifies GTM_CMU_CLK_EN[EN_CLK4].
          integer CmuConfigurableClk4Div: 0..16777215, origin=ChipowerTech, post-build-variant-value=true, set at post-build, default-value=0  # This parameter specifies the Divider value for the configurable Clock 4. This modifies GTM_CMU_CLK_4_CTRL[CLK_CNT]. Hence the final clock frequency will be, Gtm frequency (after Global prescaler) /(Divider value configured here + 1)
          boolean CmuEnableConfigurableClk5: origin=ChipowerTech, post-build-variant-value=true, set at post-build, default-value=false  # Enables the Configurable Clock 5 of GTM. This modifies GTM_CMU_CLK_EN[EN_CLK5].
          integer CmuConfigurableClk5Div: 0..16777215, origin=ChipowerTech, post-build-variant-value=true, set at post-build, default-value=0  # This parameter specifies the Divider value for the configurable Clock 5. This modifies GTM_CMU_CLK_5_CTRL[CLK_CNT]. Hence the final clock frequency will be, Gtm frequency (after Global prescaler) /(Divider value configured here + 1)
          boolean CmuEnableConfigurableClk6: origin=ChipowerTech, post-build-variant-value=true, set at post-build, default-value=false  # Enables the Configurable Clock 6 of GTM. This modifies GTM_CMU_CLK_EN[EN_CLK6].
          enumeration CmuClk6SourceSelect: {CMU_CLK_6_DIVIDER, CMU_SUB_INC2_SIGNAL}, origin=ChipowerTech, post-build-variant-value=true, set at post-build, default-value=CMU_CLK_6_DIVIDER  # Clock Source select for CMU Clock6. This modifies GTM_CMU_CLK_6_CTRL[CLK6_SEL] CMU_CLK_6_DIVIDER: Use Global Clock prescaled using Clock 6 Divider as CMU Clock 6 CMU_SUB_INC2_SIGNAL: Use Sub_Inc2 as the CMU Clock 6
          integer CmuConfigurableClk6Div: 0..16777215, origin=ChipowerTech, post-build-variant-value=true, set at post-build, default-value=0  # This parameter specifies the Divider value for the configurable Clock 6. This modifies GTM_CMU_CLK_6_CTRL[CLK_CNT]. Hence the final clock frequency will be, Signal chosen by CmuClk6SourceSelect /(Divider value configured here + 1)
          boolean CmuEnableConfigurableClk7: origin=ChipowerTech, post-build-variant-value=true, set at post-build, default-value=false  # Enables the Configurable Clock 7 of GTM. This modifies GTM_CMU_CLK_EN[EN_CLK7].
          enumeration CmuClk7SourceSelect: {CMU_CLK_7_DIVIDER, CMU_SUB_INC1_SIGNAL}, origin=ChipowerTech, post-build-variant-value=true, set at post-build, default-value=CMU_CLK_7_DIVIDER  # Clock Source select for CMU Clock7. This modifies GTM_CMU_CLK_7_CTRL[CLK7_SEL] CMU_CLK_7_DIVIDER: Use Global Clock prescaled using Clock 7 Divider as CMU Clock 7 CMU_SUB_INC2_SIGNAL: Use Sub_Inc2 as the CMU Clock 7.
          integer CmuConfigurableClk7Div: 0..16777215, origin=ChipowerTech, post-build-variant-value=true, set at post-build, default-value=0  # This parameter specifies the Divider value for the configurable Clock 7. This modifies GTM_CMU_CLK_7_CTRL[CLK_CNT]. Hence the final clock frequency will be, Signal chosen by CmuClk6SourceSelect /(Divider value configured here + 1)
        container CmuFixedClock  # This container contains the Fixed Clock Configuration for GTM
          boolean CmuEnableAllFixedClocks: origin=ChipowerTech, post-build-variant-value=true, set at post-build, default-value=false  # Enables/Disables the Fixed Clocks of GTM. This modifies GTM_CMU_CLK_EN[EN_FXCLK]. CMU provides 5 Fixed Clocks with the following Prescale values respectively; 1, 16, 256, 4096, 65536. Hence the final clock frequency will be, Gtm frequency (after Global prescaler) /Fixed Clock Prescale value
          enumeration CmuFxdClkSourceSelect: {GTM_CMU_GCLK_EN, GTM_CMU_CLK0, GTM_CMU_CLK1, GTM_CMU_CLK2, GTM_CMU_CLK3, GTM_CMU_CLK4, GTM_CMU_CLK5, GTM_CMU_CLK6, GTM_CMU_CLK7}, origin=ChipowerTech, post-build-variant-value=true, set at post-build, default-value=GTM_CMU_GCLK_EN  # Clock Source select for Fixed Clock. This modifies CMU_CLK_EN [FXCLK_SEL] GTM_CMU_GCLK_EN: Use Global Clock as input for Fixed Clock. GTM_CMU_CLK0: Use Clock 0 as the clock source for Fixed Clock GTM_CMU_CLK1: Use Clock 1 as the clock source for Fixed Clock GTM_CMU_CLK2: Use Clock 2 as the clock source for Fixed Clock GTM_CMU_CLK3: Use Clock 3 as the clock source for Fixed Clock GTM_CMU_CLK4: Use Clock 4 as the clock source for Fixed Clock GTM_CMU_CLK5: Use Clock 5 as the clock source for Fixed Clock GTM_CMU_CLK6: Use Clock 6 as the clock source for Fixed Clock GTM_CMU_CLK7: Use Clock 7 as the clock source for Fixed Clock Default: GTM_CMU_GCLK_EN
          float CmuFxdClkFrequency: 0.0..2.0E8, origin=ChipowerTech, post-build-variant-value=true, set at post-build, default-value=0.0  # The Cmu Fixed clock frequency.
        container CmuExternalClock  # This container contains the External Clock Configuration for GTM
          boolean CmuEnableExternalClk0: origin=ChipowerTech, post-build-variant-value=true, set at post-build, default-value=false  # Enables/Disables the External Clock 0 of GTM. This sets GTM_CMU_CLK_EN[EN_ECLK0].
          integer CmuExternalClk0Numerator: 0..16777215, origin=ChipowerTech, post-build-variant-value=true, set at post-build, default-value=1  # This parameter specifies the Numerator value for the External Clock Divider0. This modifies GTM_CMU_ECLK_0_NUM [ECLK_NUM]. Final Clock value = System clock Frequency/(2 *( CmuExternalClk0Numerator/ CmuExternalClk0Denominator))
          integer CmuExternalClk0Denominator: 0..16777215, origin=ChipowerTech, post-build-variant-value=true, set at post-build, default-value=1  # This parameter specifies the Denominator value for the External Clock Divider0. This modifies GTM_CMU_ECLK_0_DEN[ECLK_DEN]. Final Clock value = System clock Frequency/(2 *( CmuExternalClk0Numerator/ CmuExternalClk0Denominator))
          boolean CmuEnableExternalClk1: origin=ChipowerTech, post-build-variant-value=true, set at post-build, default-value=false  # Enables/Disables the External Clock 1 of GTM. This sets GTM_CMU_CLK_EN[EN_ECLK1].
          integer CmuExternalClk1Numerator: 0..16777215, origin=ChipowerTech, post-build-variant-value=true, set at post-build, default-value=1  # This parameter specifies the Numerator value for the External Clock Divider1. This modifies GTM_CMU_ECLK_1_NUM[ECLK_NUM]. Final Clock value = System clock Frequency/(2 *( CmuExternalClk1Numerator/ CmuExternalClk1Denominator))
          integer CmuExternalClk1Denominator: 0..16777215, origin=ChipowerTech, post-build-variant-value=true, set at post-build, default-value=1  # This parameter specifies the Denominator value for the External Clock Divider1. This modifies GTM_CMU_ECLK_1_DEN[ECLK_DEN]. Final Clock value = System clock Frequency/(2 *( CmuExternalClk1Numerator/ CmuExternalClk1Denominator))
          boolean CmuEnableExternalClk2: origin=ChipowerTech, post-build-variant-value=true, set at post-build, default-value=false  # Enables/Disables the External Clock 2 of GTM. This sets GTM_CMU_CLK_EN.
          integer CmuExternalClk2Numerator: 0..16777215, origin=ChipowerTech, post-build-variant-value=true, set at post-build, default-value=1  # This parameter specifies the Numerator value for the External Clock Divider2. This modifies GTM_CMU_ECLK_2_NUM[ECLK_NUM]. Final Clock value = System clock Frequency/(2 *( CmuExternalClk2Numerator/ CmuExternalClk2Denominator))
          integer CmuExternalClk2Denominator: 0..16777215, origin=ChipowerTech, post-build-variant-value=true, set at post-build, default-value=1  # This parameter specifies the Denominator value for the External Clock Divider2. This modifies GTM_CMU_ECLK_2_DEN[ECLK_DEN]. Final Clock value = System clock Frequency/(2 *( CmuExternalClk2Numerator/ CmuExternalClk2Denominator))
        container CmuClockReferencePoint [0..*]: multiplicity set at post-build, post-build-variant-multiplicity=true  # This container defines a reference point in the Cmu Clock tree. It defines the frequency which then can be used by other modules as an input value. Lower multiplicity is 1, as even in the simplest case (only one frequency is used), there is one frequency to be defined.
          enumeration McuClockReferenceSelect: {CMU_CLK0, CMU_CLK1, CMU_CLK2, CMU_CLK3, CMU_CLK4, CMU_CLK5, CMU_CLK6, CMU_CLK7, CMU_ECLK0, CMU_ECLK1, CMU_ECLK2, CMU_FXCLK}, scope=ECU, origin=ChipowerTech, post-build-variant-value=true, set at post-build, default-value=CMU_CLK0  # This is the frequency for the specific instance of the McuClockReferencePoint container. It shall be given in Hz.
          float CmuClockReferencePointFrequency: 0.0..2.0E8, scope=ECU, origin=ChipowerTech, post-build-variant-value=true, set at post-build, default-value=0.0  # This is the frequency for the specific instance of the McuClockReferencePoint container. It shall be given in Hz.
      container Tbu: multiplicity set at post-build  # This container provides the TBU configuration.
        container TbuChannel [3..3]: requires-index=true  # This container provides the TBU Channel configuration.
          integer TbuChannelID: 0..255, scope=ECU, origin=ChipowerTech, set at pre-compile, symbolic-name-value=true, default-value=0  # This parameter provides the channel ID which is unique in a given TBU Driver. The value for this parameter starts with 0 and continue without any gaps.
          boolean TbuEnableChannel: origin=ChipowerTech, post-build-variant-value=true, set at post-build, default-value=false  # Enables the TBU Channel.
          enumeration TbuChannelModeSelect: {GTM_TBU_MODE_FREERUNNING, GTM_TBU_MODE_FORWARDBACKWARD}, origin=ChipowerTech, post-build-variant-value=true, set at post-build, default-value=GTM_TBU_MODE_FREERUNNING  # This decides the Mode for the TBU Channel. This is only applicable for TBU Channel 1 and 2 FOR-ALL: GTM_TBU_MODE_FREERUNNING: Free Running Mode chosen FOR-ALL: GTM_TBU_MODE_FORWARDBACKWARD: Forward Backward Counter mode chosen
          enumeration TbuChannelClockSource: {GTM_CMU_CLK_0, GTM_CMU_CLK_1, GTM_CMU_CLK_2, GTM_CMU_CLK_3, GTM_CMU_CLK_4, GTM_CMU_CLK_5, GTM_CMU_CLK_6, GTM_CMU_CLK_7}, origin=ChipowerTech, post-build-variant-value=true, set at post-build, default-value=GTM_CMU_CLK_0  # value="EN: This decides the Clock Source for the TBU Channel FOR-ALL: GTM_CMU_CLK_0: Configurable Clock0 is chosen FOR-ALL: GTM_CMU_CLK_1: Configurable Clock1 is chosen FOR-ALL: GTM_CMU_CLK_2: Configurable Clock2 is chosen FOR-ALL: GTM_CMU_CLK_3: Configurable Clock3 is chosen FOR-ALL: GTM_CMU_CLK_4: Configurable Clock4 is chosen FOR-ALL: GTM_CMU_CLK_5: Configurable Clock5 is chosen FOR-ALL: GTM_CMU_CLK_6: Configurable Clock6 is chosen FOR-ALL: GTM_CMU_CLK_7: Configurable Clock7 is chosen
          enumeration TbuChannelResolution: {GTM_TBU_TS0_BIT_LOWER, GTM_TBU_TS0_BIT_UPPER}, origin=ChipowerTech, post-build-variant-value=true, set at post-build, default-value=GTM_TBU_TS0_BIT_LOWER  # This decides the resolution for the TBU Channel. This is only applicable for TBU Channel 0 GTM_TBU_TS0_BIT_LOWER: Choose Lower 24 Bits of TBU GTM_TBU_TS0_BIT_UPPER: Choose Higher 24 Bits of TBU
          integer TbuTimebaseValue: 0..16777215, origin=ChipowerTech, post-build-variant-value=true, set at post-build, default-value=0  # This parameter specifies the Timebase value for the TBU Channel
      container Tom [5..5]: requires-index=true  # This container contains the TOM Configuration for GTM
        container TomChannel [16..16]: requires-index=true  # This container contains the TOM Channel configuration
          container TomChannelOutput  # This container contains the TOM Channel Output configuration
            boolean GTM_Tom_Negative_Support: origin=ChipowerTech, post-build-variant-value=true, set at post-build, default-value=false  # This parameter specifies the Tom negative module used or not.
            integer TomId: 0..4, scope=ECU, origin=ChipowerTech, set at pre-compile, default-value=0  # Id of the TOM Cluster.
            integer ChannelId: 0..15, scope=ECU, origin=ChipowerTech, set at pre-compile, default-value=0  # Id of the TOM channel.
            enumeration TomChannelNegativePortPinSelect: {TOMXXCHXX_NO_USED_TOM_CHANNEL, TOM0CH00N_TOUT072_SEL4_PORT15_PIN01, TOM0CH00N_TOUT106_SEL4_PORT10_PIN04, TOM0CH00N_TOUT051_SEL5_PORT21_PIN00, TOM0CH00N_TOUT034_SEL4_PORT33_PIN12, TOM0CH00N_TOUT025_SEL4_PORT33_PIN03, TOM0CH00N_TOUT017_SEL4_PORT00_PIN08, TOM0CH00N_TOUT007_SEL4_PORT02_PIN07, TOM0CH00N_TOUT091_SEL4_PORT13_PIN00, TOM0CH00N_TOUT009_SEL4_PORT00_PIN00, TOM0CH00N_TOUT061_SEL5_PORT20_PIN03, TOM0CH01N_TOUT030_SEL4_PORT33_PIN08, TOM0CH01N_TOUT014_SEL4_PORT00_PIN05, TOM0CH01N_TOUT010_SEL4_PORT00_PIN01, TOM0CH01N_TOUT057_SEL4_PORT21_PIN06, TOM0CH01N_TOUT022_SEL4_PORT33_PIN00, TOM0CH01N_TOUT092_SEL4_PORT13_PIN01, TOM0CH01N_TOUT107_SEL4_PORT10_PIN05, TOM0CH01N_TOUT035_SEL4_PORT33_PIN13, TOM0CH01N_TOUT090_SEL4_PORT14_PIN10, TOM0CH01N_TOUT052_SEL5_PORT21_PIN01, TOM0CH01N_TOUT073_SEL4_PORT15_PIN02, TOM0CH01N_TOUT039_SEL6_PORT32_PIN03, TOM0CH01N_TOUT004_SEL4_PORT02_PIN04, TOM0CH02N_TOUT074_SEL4_PORT15_PIN03, TOM0CH02N_TOUT143_SEL6_PORT33_PIN14, TOM0CH02N_TOUT093_SEL4_PORT13_PIN02, TOM0CH02N_TOUT015_SEL4_PORT00_PIN06, TOM0CH02N_TOUT011_SEL4_PORT00_PIN02, TOM0CH02N_TOUT058_SEL4_PORT21_PIN07, TOM0CH02N_TOUT005_SEL4_PORT02_PIN05, TOM0CH02N_TOUT040_SEL6_PORT32_PIN04, TOM0CH02N_TOUT108_SEL4_PORT10_PIN06, TOM0CH02N_TOUT023_SEL4_PORT33_PIN01, TOM0CH03N_TOUT094_SEL4_PORT13_PIN03, TOM0CH03N_TOUT016_SEL4_PORT00_PIN07, TOM0CH03N_TOUT012_SEL4_PORT00_PIN03, TOM0CH03N_TOUT109_SEL4_PORT10_PIN07, TOM0CH03N_TOUT059_SEL4_PORT20_PIN00, TOM0CH03N_TOUT144_SEL6_PORT33_PIN15, TOM0CH03N_TOUT024_SEL4_PORT33_PIN02, TOM0CH03N_TOUT060_SEL4_PORT20_PIN01, TOM0CH03N_TOUT075_SEL4_PORT15_PIN04, TOM0CH03N_TOUT042_SEL6_PORT23_PIN01, TOM0CH03N_TOUT006_SEL4_PORT02_PIN06, TOM0CH04N_TOUT001_SEL6_PORT02_PIN01, TOM0CH04N_TOUT036_SEL4_PORT32_PIN00, TOM0CH04N_TOUT065_SEL5_PORT20_PIN09, TOM0CH04N_TOUT056_SEL4_PORT21_PIN05, TOM0CH04N_TOUT010_SEL6_PORT00_PIN01, TOM0CH04N_TOUT008_SEL6_PORT02_PIN08, TOM0CH04N_TOUT096_SEL6_PORT11_PIN03, TOM0CH04N_TOUT054_SEL6_PORT21_PIN03, TOM0CH04N_TOUT089_SEL4_PORT14_PIN09, TOM0CH04N_TOUT073_SEL6_PORT15_PIN02, TOM0CH04N_TOUT029_SEL4_PORT33_PIN07, TOM0CH04N_TOUT095_SEL5_PORT11_PIN02, TOM0CH04N_TOUT143_SEL4_PORT33_PIN14, TOM0CH04N_TOUT147_SEL4_PORT34_PIN02, TOM0CH05N_TOUT056_SEL6_PORT21_PIN05, TOM0CH05N_TOUT148_SEL4_PORT34_PIN03, TOM0CH05N_TOUT087_SEL4_PORT14_PIN07, TOM0CH05N_TOUT076_SEL6_PORT15_PIN05, TOM0CH05N_TOUT003_SEL6_PORT02_PIN03, TOM0CH05N_TOUT037_SEL6_PORT32_PIN01, TOM0CH05N_TOUT097_SEL5_PORT11_PIN06, TOM0CH05N_TOUT028_SEL6_PORT33_PIN06, TOM0CH05N_TOUT067_SEL5_PORT20_PIN11, TOM0CH05N_TOUT026_SEL4_PORT33_PIN04, TOM0CH05N_TOUT121_SEL6_PORT11_PIN04, TOM0CH05N_TOUT077_SEL5_PORT15_PIN06, TOM0CH05N_TOUT053_SEL4_PORT21_PIN02, TOM0CH05N_TOUT144_SEL4_PORT33_PIN15, TOM0CH05N_TOUT012_SEL6_PORT00_PIN03, TOM0CH05N_TOUT032_SEL4_PORT33_PIN10, TOM0CH06N_TOUT030_SEL6_PORT33_PIN08, TOM0CH06N_TOUT054_SEL4_PORT21_PIN03, TOM0CH06N_TOUT099_SEL5_PORT11_PIN10, TOM0CH06N_TOUT027_SEL4_PORT33_PIN05, TOM0CH06N_TOUT086_SEL4_PORT14_PIN06, TOM0CH06N_TOUT040_SEL4_PORT32_PIN04, TOM0CH06N_TOUT038_SEL4_PORT32_PIN02, TOM0CH06N_TOUT082_SEL4_PORT14_PIN02, TOM0CH06N_TOUT014_SEL6_PORT00_PIN05, TOM0CH06N_TOUT031_SEL4_PORT33_PIN09, TOM0CH06N_TOUT097_SEL6_PORT11_PIN06, TOM0CH06N_TOUT078_SEL5_PORT15_PIN07, TOM0CH06N_TOUT049_SEL6_PORT22_PIN02, TOM0CH06N_TOUT091_SEL6_PORT13_PIN00, TOM0CH06N_TOUT005_SEL6_PORT02_PIN05, TOM0CH06N_TOUT149_SEL4_PORT34_PIN04, TOM0CH06N_TOUT069_SEL5_PORT20_PIN13, TOM0CH07N_TOUT071_SEL6_PORT15_PIN00, TOM0CH07N_TOUT042_SEL4_PORT23_PIN01, TOM0CH07N_TOUT032_SEL6_PORT33_PIN10, TOM0CH07N_TOUT033_SEL4_PORT33_PIN11, TOM0CH07N_TOUT088_SEL4_PORT14_PIN08, TOM0CH07N_TOUT130_SEL6_PORT22_PIN04, TOM0CH07N_TOUT123_SEL6_PORT11_PIN07, TOM0CH07N_TOUT055_SEL4_PORT21_PIN04, TOM0CH07N_TOUT039_SEL4_PORT32_PIN03, TOM0CH07N_TOUT150_SEL4_PORT34_PIN05, TOM0CH07N_TOUT028_SEL4_PORT33_PIN06, TOM0CH07N_TOUT093_SEL6_PORT13_PIN02, TOM0CH07N_TOUT079_SEL5_PORT15_PIN08, TOM0CH07N_TOUT084_SEL4_PORT14_PIN04, TOM0CH07N_TOUT016_SEL6_PORT00_PIN07, TOM0CH07N_TOUT007_SEL6_PORT02_PIN07, TOM0CH07N_TOUT100_SEL5_PORT11_PIN11, TOM1CH00N_TOUT017_SEL5_PORT00_PIN08, TOM1CH00N_TOUT075_SEL5_PORT15_PIN04, TOM1CH00N_TOUT007_SEL5_PORT02_PIN07, TOM1CH00N_TOUT034_SEL5_PORT33_PIN12, TOM1CH00N_TOUT025_SEL5_PORT33_PIN03, TOM1CH01N_TOUT004_SEL5_PORT02_PIN04, TOM1CH01N_TOUT039_SEL7_PORT32_PIN03, TOM1CH01N_TOUT014_SEL5_PORT00_PIN05, TOM1CH01N_TOUT072_SEL5_PORT15_PIN01, TOM1CH01N_TOUT030_SEL5_PORT33_PIN08, TOM1CH01N_TOUT022_SEL5_PORT33_PIN00, TOM1CH01N_TOUT035_SEL5_PORT33_PIN13, TOM1CH01N_TOUT245_SEL6_PORT15_PIN13, TOM1CH02N_TOUT005_SEL5_PORT02_PIN05, TOM1CH02N_TOUT073_SEL5_PORT15_PIN02, TOM1CH02N_TOUT041_SEL5_PORT23_PIN00, TOM1CH02N_TOUT023_SEL5_PORT33_PIN01, TOM1CH02N_TOUT143_SEL7_PORT33_PIN14, TOM1CH02N_TOUT015_SEL5_PORT00_PIN06, TOM1CH02N_TOUT040_SEL7_PORT32_PIN04, TOM1CH02N_TOUT246_SEL6_PORT15_PIN14, TOM1CH03N_TOUT006_SEL5_PORT02_PIN06, TOM1CH03N_TOUT016_SEL5_PORT00_PIN07, TOM1CH03N_TOUT074_SEL5_PORT15_PIN03, TOM1CH03N_TOUT043_SEL6_PORT23_PIN02, TOM1CH03N_TOUT144_SEL7_PORT33_PIN15, TOM1CH03N_TOUT247_SEL6_PORT15_PIN15, TOM1CH03N_TOUT024_SEL5_PORT33_PIN02, TOM1CH04N_TOUT054_SEL7_PORT21_PIN03, TOM1CH04N_TOUT008_SEL7_PORT02_PIN08, TOM1CH04N_TOUT013_SEL5_PORT00_PIN04, TOM1CH04N_TOUT029_SEL5_PORT33_PIN07, TOM1CH04N_TOUT010_SEL7_PORT00_PIN01, TOM1CH04N_TOUT021_SEL5_PORT00_PIN12, TOM1CH04N_TOUT143_SEL5_PORT33_PIN14, TOM1CH04N_TOUT147_SEL5_PORT34_PIN02, TOM1CH04N_TOUT095_SEL7_PORT11_PIN02, TOM1CH04N_TOUT001_SEL7_PORT02_PIN01, TOM1CH04N_TOUT036_SEL5_PORT32_PIN00, TOM1CH04N_TOUT073_SEL7_PORT15_PIN02, TOM1CH04N_TOUT065_SEL6_PORT20_PIN09, TOM1CH04N_TOUT244_SEL6_PORT15_PIN12, TOM1CH04N_TOUT071_SEL5_PORT15_PIN00, TOM1CH05N_TOUT056_SEL7_PORT21_PIN05, TOM1CH05N_TOUT012_SEL7_PORT00_PIN03, TOM1CH05N_TOUT037_SEL7_PORT32_PIN01, TOM1CH05N_TOUT018_SEL5_PORT00_PIN09, TOM1CH05N_TOUT097_SEL7_PORT11_PIN06, TOM1CH05N_TOUT077_SEL6_PORT15_PIN06, TOM1CH05N_TOUT009_SEL5_PORT00_PIN00, TOM1CH05N_TOUT032_SEL5_PORT33_PIN10, TOM1CH05N_TOUT026_SEL5_PORT33_PIN04, TOM1CH05N_TOUT144_SEL5_PORT33_PIN15, TOM1CH05N_TOUT003_SEL7_PORT02_PIN03, TOM1CH05N_TOUT028_SEL7_PORT33_PIN06, TOM1CH05N_TOUT148_SEL5_PORT34_PIN03, TOM1CH05N_TOUT076_SEL7_PORT15_PIN05, TOM1CH05N_TOUT067_SEL6_PORT20_PIN11, TOM1CH06N_TOUT019_SEL5_PORT00_PIN10, TOM1CH06N_TOUT040_SEL5_PORT32_PIN04, TOM1CH06N_TOUT049_SEL7_PORT22_PIN02, TOM1CH06N_TOUT030_SEL7_PORT33_PIN08, TOM1CH06N_TOUT069_SEL6_PORT20_PIN13, TOM1CH06N_TOUT082_SEL5_PORT14_PIN02, TOM1CH06N_TOUT011_SEL5_PORT00_PIN02, TOM1CH06N_TOUT038_SEL5_PORT32_PIN02, TOM1CH06N_TOUT014_SEL7_PORT00_PIN05, TOM1CH06N_TOUT027_SEL5_PORT33_PIN05, TOM1CH06N_TOUT091_SEL7_PORT13_PIN00, TOM1CH06N_TOUT031_SEL5_PORT33_PIN09, TOM1CH06N_TOUT010_SEL5_PORT00_PIN01, TOM1CH06N_TOUT242_SEL6_PORT15_PIN10, TOM1CH06N_TOUT078_SEL6_PORT15_PIN07, TOM1CH06N_TOUT149_SEL5_PORT34_PIN04, TOM1CH06N_TOUT005_SEL7_PORT02_PIN05, TOM1CH06N_TOUT099_SEL7_PORT11_PIN10, TOM1CH07N_TOUT071_SEL7_PORT15_PIN00, TOM1CH07N_TOUT093_SEL7_PORT13_PIN02, TOM1CH07N_TOUT243_SEL6_PORT15_PIN11, TOM1CH07N_TOUT042_SEL5_PORT23_PIN01, TOM1CH07N_TOUT150_SEL5_PORT34_PIN05, TOM1CH07N_TOUT020_SEL5_PORT00_PIN11, TOM1CH07N_TOUT039_SEL5_PORT32_PIN03, TOM1CH07N_TOUT012_SEL5_PORT00_PIN03, TOM1CH07N_TOUT028_SEL5_PORT33_PIN06, TOM1CH07N_TOUT100_SEL7_PORT11_PIN11, TOM1CH07N_TOUT033_SEL5_PORT33_PIN11, TOM1CH07N_TOUT079_SEL6_PORT15_PIN08, TOM1CH07N_TOUT130_SEL7_PORT22_PIN04, TOM1CH07N_TOUT084_SEL5_PORT14_PIN04, TOM1CH07N_TOUT016_SEL7_PORT00_PIN07, TOM1CH07N_TOUT007_SEL7_PORT02_PIN07, TOM1CH07N_TOUT032_SEL7_PORT33_PIN10, TOM2CH00N_TOUT101_SEL4_PORT11_PIN12, TOM2CH00N_TOUT061_SEL4_PORT20_PIN03, TOM2CH00N_TOUT076_SEL4_PORT15_PIN05, TOM2CH00N_TOUT051_SEL4_PORT21_PIN00, TOM2CH00N_TOUT264_SEL4_PORT13_PIN15, TOM2CH00N_TOUT043_SEL4_PORT23_PIN02, TOM2CH00N_TOUT091_SEL5_PORT13_PIN00, TOM2CH00N_TOUT126_SEL6_PORT11_PIN14, TOM2CH01N_TOUT124_SEL6_PORT11_PIN08, TOM2CH01N_TOUT061_SEL6_PORT20_PIN03, TOM2CH01N_TOUT079_SEL4_PORT15_PIN08, TOM2CH01N_TOUT098_SEL4_PORT11_PIN09, TOM2CH01N_TOUT052_SEL4_PORT21_PIN01, TOM2CH01N_TOUT050_SEL5_PORT22_PIN03, TOM2CH01N_TOUT044_SEL4_PORT23_PIN03, TOM2CH01N_TOUT123_SEL4_PORT11_PIN07, TOM2CH01N_TOUT057_SEL5_PORT21_PIN06, TOM2CH01N_TOUT092_SEL5_PORT13_PIN01, TOM2CH01N_TOUT090_SEL5_PORT14_PIN10, TOM2CH01N_TOUT254_SEL4_PORT13_PIN05, TOM2CH02N_TOUT093_SEL5_PORT13_PIN02, TOM2CH02N_TOUT046_SEL4_PORT23_PIN05, TOM2CH02N_TOUT124_SEL4_PORT11_PIN08, TOM2CH02N_TOUT058_SEL5_PORT21_PIN07, TOM2CH02N_TOUT099_SEL4_PORT11_PIN10, TOM2CH02N_TOUT078_SEL4_PORT15_PIN07, TOM2CH02N_TOUT255_SEL4_PORT13_PIN06, TOM2CH03N_TOUT256_SEL4_PORT13_PIN07, TOM2CH03N_TOUT045_SEL4_PORT23_PIN04, TOM2CH03N_TOUT077_SEL4_PORT15_PIN06, TOM2CH03N_TOUT100_SEL4_PORT11_PIN11, TOM2CH03N_TOUT122_SEL5_PORT11_PIN05, TOM2CH03N_TOUT059_SEL5_PORT20_PIN00, TOM2CH03N_TOUT106_SEL6_PORT10_PIN04, TOM2CH04N_TOUT126_SEL5_PORT11_PIN14, TOM2CH04N_TOUT097_SEL4_PORT11_PIN06, TOM2CH04N_TOUT089_SEL5_PORT14_PIN09, TOM2CH04N_TOUT060_SEL5_PORT20_PIN01, TOM2CH04N_TOUT120_SEL5_PORT11_PIN01, TOM2CH04N_TOUT122_SEL4_PORT11_PIN05, TOM2CH04N_TOUT106_SEL5_PORT10_PIN04, TOM2CH04N_TOUT056_SEL5_PORT21_PIN05, TOM2CH04N_TOUT137_SEL4_PORT22_PIN11, TOM2CH04N_TOUT253_SEL4_PORT13_PIN04, TOM2CH05N_TOUT119_SEL5_PORT11_PIN00, TOM2CH05N_TOUT119_SEL4_PORT11_PIN00, TOM2CH05N_TOUT107_SEL5_PORT10_PIN05, TOM2CH05N_TOUT250_SEL4_PORT13_PIN11, TOM2CH05N_TOUT094_SEL5_PORT13_PIN03, TOM2CH05N_TOUT136_SEL4_PORT22_PIN10, TOM2CH05N_TOUT087_SEL5_PORT14_PIN07, TOM2CH05N_TOUT053_SEL5_PORT21_PIN02, TOM2CH06N_TOUT135_SEL4_PORT22_PIN09, TOM2CH06N_TOUT095_SEL4_PORT11_PIN02, TOM2CH06N_TOUT251_SEL4_PORT13_PIN10, TOM2CH06N_TOUT108_SEL5_PORT10_PIN06, TOM2CH06N_TOUT054_SEL5_PORT21_PIN03, TOM2CH06N_TOUT086_SEL5_PORT14_PIN06, TOM2CH06N_TOUT122_SEL6_PORT11_PIN05, TOM2CH06N_TOUT120_SEL4_PORT11_PIN01, TOM2CH07N_TOUT252_SEL4_PORT13_PIN14, TOM2CH07N_TOUT109_SEL5_PORT10_PIN07, TOM2CH07N_TOUT096_SEL4_PORT11_PIN03, TOM2CH07N_TOUT121_SEL4_PORT11_PIN04, TOM2CH07N_TOUT055_SEL5_PORT21_PIN04, TOM2CH07N_TOUT088_SEL5_PORT14_PIN08, TOM2CH07N_TOUT098_SEL6_PORT11_PIN09, TOM2CH07N_TOUT134_SEL4_PORT22_PIN08, TOM3CH00N_TOUT134_SEL6_PORT22_PIN08, TOM3CH00N_TOUT181_SEL4_PORT31_PIN07, TOM3CH00N_TOUT161_SEL4_PORT01_PIN13, TOM3CH00N_TOUT213_SEL4_PORT25_PIN07, TOM3CH00N_TOUT008_SEL5_PORT02_PIN08, TOM3CH01N_TOUT158_SEL4_PORT01_PIN12, TOM3CH01N_TOUT245_SEL5_PORT15_PIN13, TOM3CH01N_TOUT116_SEL5_PORT02_PIN09, TOM3CH01N_TOUT178_SEL4_PORT31_PIN04, TOM3CH01N_TOUT210_SEL4_PORT25_PIN04, TOM3CH01N_TOUT268_SEL4_PORT10_PIN13, TOM3CH01N_TOUT135_SEL6_PORT22_PIN09, TOM3CH02N_TOUT159_SEL4_PORT01_PIN01, TOM3CH02N_TOUT136_SEL6_PORT22_PIN10, TOM3CH02N_TOUT117_SEL5_PORT02_PIN10, TOM3CH02N_TOUT211_SEL4_PORT25_PIN05, TOM3CH02N_TOUT246_SEL5_PORT15_PIN14, TOM3CH02N_TOUT267_SEL4_PORT10_PIN14, TOM3CH02N_TOUT179_SEL4_PORT31_PIN05, TOM3CH03N_TOUT180_SEL4_PORT31_PIN06, TOM3CH03N_TOUT118_SEL5_PORT02_PIN11, TOM3CH03N_TOUT270_SEL4_PORT10_PIN15, TOM3CH03N_TOUT212_SEL4_PORT25_PIN06, TOM3CH03N_TOUT212_SEL4_PORT26_PIN00, TOM3CH03N_TOUT137_SEL6_PORT22_PIN11, TOM3CH03N_TOUT247_SEL5_PORT15_PIN15, TOM3CH03N_TOUT160_SEL4_PORT01_PIN09, TOM3CH04N_TOUT244_SEL5_PORT15_PIN12, TOM3CH04N_TOUT151_SEL5_PORT02_PIN12, TOM3CH04N_TOUT209_SEL4_PORT25_PIN03, TOM3CH04N_TOUT177_SEL4_PORT31_PIN03, TOM3CH04N_TOUT165_SEL4_PORT01_PIN11, TOM3CH05N_TOUT174_SEL4_PORT31_PIN00, TOM3CH05N_TOUT166_SEL4_PORT00_PIN14, TOM3CH05N_TOUT155_SEL4_PORT01_PIN00, TOM3CH05N_TOUT153_SEL5_PORT02_PIN13, TOM3CH05N_TOUT206_SEL4_PORT25_PIN00, TOM3CH05N_TOUT268_SEL5_PORT10_PIN13, TOM3CH06N_TOUT207_SEL4_PORT25_PIN01, TOM3CH06N_TOUT175_SEL4_PORT31_PIN01, TOM3CH06N_TOUT242_SEL5_PORT15_PIN10, TOM3CH06N_TOUT154_SEL5_PORT02_PIN14, TOM3CH06N_TOUT156_SEL4_PORT01_PIN02, TOM3CH06N_TOUT267_SEL5_PORT10_PIN14, TOM3CH07N_TOUT243_SEL5_PORT15_PIN11, TOM3CH07N_TOUT157_SEL4_PORT01_PIN15, TOM3CH07N_TOUT270_SEL5_PORT10_PIN15, TOM3CH07N_TOUT176_SEL4_PORT31_PIN02, TOM3CH07N_TOUT152_SEL5_PORT02_PIN15, TOM3CH07N_TOUT208_SEL4_PORT25_PIN02}, origin=ChipowerTech, post-build-variant-value=true, set at post-build, default-value=TOMXXCHXX_NO_USED_TOM_CHANNEL  # This decides the output port and pin for the TOM Channel. This parameter is not applicable in case of configuration using bmd. While using Bmd, GtmToutConfiguration should be configured for Port assignment.
            enumeration TomChannelPortPinSelect: {TOMXXCHXX_NO_USED_TOM_CHANNEL, TOM00CH00_TOUT109_SEL0_PORT10_PIN07, TOM00CH00_TOUT053_SEL0_PORT21_PIN02, TOM00CH00_TOUT032_SEL0_PORT33_PIN10, TOM00CH00_TOUT087_SEL0_PORT14_PIN07, TOM00CH00_TOUT085_SEL0_PORT14_PIN05, TOM00CH00_TOUT077_SEL0_PORT15_PIN06, TOM00CH00_TOUT151_SEL6_PORT02_PIN12, TOM00CH00_TOUT000_SEL4_PORT02_PIN00, TOM00CH00_TOUT018_SEL0_PORT00_PIN09, TOM00CH00_TOUT076_SEL0_PORT15_PIN05, TOM00CH00_TOUT026_SEL0_PORT33_PIN04, TOM00CH01_TOUT103_SEL0_PORT10_PIN01, TOM00CH01_TOUT031_SEL0_PORT33_PIN09, TOM00CH01_TOUT027_SEL0_PORT33_PIN05, TOM00CH01_TOUT078_SEL0_PORT15_PIN07, TOM00CH01_TOUT086_SEL0_PORT14_PIN06, TOM00CH01_TOUT116_SEL6_PORT02_PIN09, TOM00CH01_TOUT054_SEL0_PORT21_PIN03, TOM00CH01_TOUT019_SEL0_PORT00_PIN10, TOM00CH01_TOUT001_SEL4_PORT02_PIN01, TOM00CH10_TOUT002_SEL0_PORT02_PIN02, TOM00CH10_TOUT096_SEL0_PORT11_PIN03, TOM00CH10_TOUT041_SEL0_PORT23_PIN00, TOM00CH10_TOUT046_SEL0_PORT23_PIN05, TOM00CH10_TOUT012_SEL0_PORT00_PIN03, TOM00CH11_TOUT003_SEL0_PORT02_PIN03, TOM00CH11_TOUT043_SEL0_PORT23_PIN02, TOM00CH11_TOUT097_SEL0_PORT11_PIN06, TOM00CH11_TOUT049_SEL0_PORT22_PIN02, TOM00CH11_TOUT013_SEL0_PORT00_PIN04, TOM00CH12_TOUT044_SEL0_PORT23_PIN03, TOM00CH12_TOUT004_SEL0_PORT02_PIN04, TOM00CH12_TOUT098_SEL0_PORT11_PIN09, TOM00CH12_TOUT050_SEL0_PORT22_PIN03, TOM00CH12_TOUT014_SEL0_PORT00_PIN05, TOM00CH13_TOUT099_SEL0_PORT11_PIN10, TOM00CH13_TOUT015_SEL0_PORT00_PIN06, TOM00CH13_TOUT005_SEL0_PORT02_PIN05, TOM00CH14_TOUT100_SEL0_PORT11_PIN11, TOM00CH14_TOUT006_SEL0_PORT02_PIN06, TOM00CH14_TOUT016_SEL0_PORT00_PIN07, TOM00CH15_TOUT101_SEL0_PORT11_PIN12, TOM00CH15_TOUT007_SEL0_PORT02_PIN07, TOM00CH15_TOUT042_SEL1_PORT23_PIN01, TOM00CH15_TOUT017_SEL0_PORT00_PIN08, TOM00CH02_TOUT104_SEL0_PORT10_PIN02, TOM00CH02_TOUT117_SEL6_PORT02_PIN10, TOM00CH02_TOUT020_SEL0_PORT00_PIN11, TOM00CH02_TOUT088_SEL0_PORT14_PIN08, TOM00CH02_TOUT107_SEL0_PORT10_PIN05, TOM00CH02_TOUT079_SEL0_PORT15_PIN08, TOM00CH02_TOUT033_SEL0_PORT33_PIN11, TOM00CH02_TOUT028_SEL0_PORT33_PIN06, TOM00CH02_TOUT055_SEL0_PORT21_PIN04, TOM00CH02_TOUT002_SEL4_PORT02_PIN02, TOM00CH03_TOUT105_SEL0_PORT10_PIN03, TOM00CH03_TOUT021_SEL0_PORT00_PIN12, TOM00CH03_TOUT108_SEL0_PORT10_PIN06, TOM00CH03_TOUT118_SEL6_PORT02_PIN11, TOM00CH03_TOUT071_SEL4_PORT15_PIN00, TOM00CH03_TOUT089_SEL0_PORT14_PIN09, TOM00CH03_TOUT056_SEL0_PORT21_PIN05, TOM00CH03_TOUT029_SEL0_PORT33_PIN07, TOM00CH03_TOUT038_SEL0_PORT32_PIN02, TOM00CH03_TOUT003_SEL4_PORT02_PIN03, TOM00CH03_TOUT080_SEL0_PORT14_PIN00, TOM00CH04_TOUT064_SEL5_PORT20_PIN08, TOM00CH04_TOUT081_SEL0_PORT14_PIN01, TOM00CH04_TOUT030_SEL0_PORT33_PIN08, TOM00CH04_TOUT053_SEL6_PORT21_PIN02, TOM00CH04_TOUT037_SEL4_PORT32_PIN01, TOM00CH04_TOUT090_SEL0_PORT14_PIN10, TOM00CH04_TOUT124_SEL5_PORT11_PIN08, TOM00CH04_TOUT072_SEL6_PORT15_PIN01, TOM00CH04_TOUT039_SEL0_PORT32_PIN03, TOM00CH04_TOUT094_SEL6_PORT13_PIN03, TOM00CH04_TOUT022_SEL0_PORT33_PIN00, TOM00CH04_TOUT000_SEL6_PORT02_PIN00, TOM00CH04_TOUT102_SEL0_PORT10_PIN00, TOM00CH04_TOUT009_SEL6_PORT00_PIN00, TOM00CH04_TOUT057_SEL0_PORT21_PIN06, TOM00CH05_TOUT091_SEL0_PORT13_PIN00, TOM00CH05_TOUT074_SEL6_PORT15_PIN03, TOM00CH05_TOUT002_SEL6_PORT02_PIN02, TOM00CH05_TOUT096_SEL5_PORT11_PIN03, TOM00CH05_TOUT066_SEL5_PORT20_PIN10, TOM00CH05_TOUT011_SEL6_PORT00_PIN02, TOM00CH05_TOUT058_SEL0_PORT21_PIN07, TOM00CH05_TOUT027_SEL6_PORT33_PIN05, TOM00CH05_TOUT055_SEL6_PORT21_PIN04, TOM00CH05_TOUT040_SEL0_PORT32_PIN04, TOM00CH05_TOUT023_SEL0_PORT33_PIN01, TOM00CH05_TOUT110_SEL0_PORT10_PIN08, TOM00CH05_TOUT128_SEL6_PORT12_PIN00, TOM00CH05_TOUT082_SEL0_PORT14_PIN02, TOM00CH06_TOUT024_SEL0_PORT33_PIN02, TOM00CH06_TOUT092_SEL0_PORT13_PIN01, TOM00CH06_TOUT129_SEL6_PORT12_PIN01, TOM00CH06_TOUT013_SEL6_PORT00_PIN04, TOM00CH06_TOUT059_SEL0_PORT20_PIN00, TOM00CH06_TOUT106_SEL0_PORT10_PIN04, TOM00CH06_TOUT004_SEL6_PORT02_PIN04, TOM00CH06_TOUT080_SEL4_PORT14_PIN00, TOM00CH06_TOUT029_SEL6_PORT33_PIN07, TOM00CH06_TOUT048_SEL6_PORT22_PIN01, TOM00CH06_TOUT042_SEL0_PORT23_PIN01, TOM00CH06_TOUT098_SEL5_PORT11_PIN09, TOM00CH06_TOUT083_SEL0_PORT14_PIN03, TOM00CH06_TOUT068_SEL5_PORT20_PIN12, TOM00CH07_TOUT050_SEL6_PORT22_PIN03, TOM00CH07_TOUT101_SEL5_PORT11_PIN12, TOM00CH07_TOUT092_SEL6_PORT13_PIN01, TOM00CH07_TOUT031_SEL6_PORT33_PIN09, TOM00CH07_TOUT084_SEL0_PORT14_PIN04, TOM00CH07_TOUT070_SEL5_PORT20_PIN14, TOM00CH07_TOUT045_SEL0_PORT23_PIN04, TOM00CH07_TOUT093_SEL0_PORT13_PIN02, TOM00CH07_TOUT006_SEL6_PORT02_PIN06, TOM00CH07_TOUT081_SEL4_PORT14_PIN01, TOM00CH07_TOUT025_SEL0_PORT33_PIN03, TOM00CH07_TOUT015_SEL6_PORT00_PIN06, TOM00CH07_TOUT119_SEL6_PORT11_PIN00, TOM00CH08_TOUT048_SEL0_PORT22_PIN01, TOM00CH08_TOUT009_SEL0_PORT00_PIN00, TOM00CH08_TOUT094_SEL0_PORT13_PIN03, TOM00CH08_TOUT051_SEL0_PORT21_PIN00, TOM00CH08_TOUT008_SEL0_PORT02_PIN08, TOM00CH08_TOUT095_SEL0_PORT11_PIN02, TOM00CH08_TOUT000_SEL0_PORT02_PIN00, TOM00CH09_TOUT052_SEL0_PORT21_PIN01, TOM00CH09_TOUT010_SEL0_PORT00_PIN01, TOM00CH09_TOUT011_SEL0_PORT00_PIN02, TOM00CH09_TOUT001_SEL0_PORT02_PIN01, TOM00CH09_TOUT047_SEL0_PORT22_PIN00, TOM01CH00_TOUT077_SEL1_PORT15_PIN06, TOM01CH00_TOUT032_SEL1_PORT33_PIN10, TOM01CH00_TOUT018_SEL1_PORT00_PIN09, TOM01CH00_TOUT076_SEL1_PORT15_PIN05, TOM01CH00_TOUT068_SEL0_PORT20_PIN12, TOM01CH00_TOUT026_SEL1_PORT33_PIN04, TOM01CH00_TOUT085_SEL1_PORT14_PIN05, TOM01CH00_TOUT000_SEL5_PORT02_PIN00, TOM01CH00_TOUT009_SEL1_PORT00_PIN00, TOM01CH00_TOUT008_SEL1_PORT02_PIN08, TOM01CH01_TOUT116_SEL4_PORT02_PIN09, TOM01CH01_TOUT027_SEL1_PORT33_PIN05, TOM01CH01_TOUT069_SEL0_PORT20_PIN13, TOM01CH01_TOUT078_SEL1_PORT15_PIN07, TOM01CH01_TOUT010_SEL1_PORT00_PIN01, TOM01CH01_TOUT086_SEL1_PORT14_PIN06, TOM01CH01_TOUT242_SEL0_PORT15_PIN10, TOM01CH01_TOUT019_SEL1_PORT00_PIN10, TOM01CH01_TOUT001_SEL5_PORT02_PIN01, TOM01CH01_TOUT031_SEL1_PORT33_PIN09, TOM01CH01_TOUT011_SEL1_PORT00_PIN02, TOM01CH10_TOUT002_SEL1_PORT02_PIN02, TOM01CH10_TOUT143_SEL0_PORT33_PIN14, TOM01CH10_TOUT062_SEL0_PORT20_PIN06, TOM01CH10_TOUT266_SEL0_PORT10_PIN10, TOM01CH11_TOUT003_SEL1_PORT02_PIN03, TOM01CH11_TOUT063_SEL0_PORT20_PIN07, TOM01CH11_TOUT267_SEL0_PORT10_PIN14, TOM01CH11_TOUT060_SEL0_PORT20_PIN01, TOM01CH11_TOUT144_SEL0_PORT33_PIN15, TOM01CH12_TOUT268_SEL0_PORT10_PIN13, TOM01CH12_TOUT004_SEL1_PORT02_PIN04, TOM01CH12_TOUT061_SEL0_PORT20_PIN03, TOM01CH12_TOUT034_SEL0_PORT33_PIN12, TOM01CH13_TOUT035_SEL0_PORT33_PIN13, TOM01CH13_TOUT065_SEL0_PORT20_PIN09, TOM01CH13_TOUT005_SEL1_PORT02_PIN05, TOM01CH13_TOUT269_SEL0_PORT10_PIN11, TOM01CH13_TOUT146_SEL0_PORT34_PIN01, TOM01CH14_TOUT006_SEL1_PORT02_PIN06, TOM01CH14_TOUT270_SEL0_PORT10_PIN15, TOM01CH14_TOUT066_SEL0_PORT20_PIN10, TOM01CH14_TOUT036_SEL0_PORT32_PIN00, TOM01CH14_TOUT147_SEL0_PORT34_PIN02, TOM01CH15_TOUT150_SEL0_PORT34_PIN05, TOM01CH15_TOUT148_SEL0_PORT34_PIN03, TOM01CH15_TOUT067_SEL0_PORT20_PIN11, TOM01CH15_TOUT037_SEL0_PORT32_PIN01, TOM01CH15_TOUT007_SEL1_PORT02_PIN07, TOM01CH02_TOUT028_SEL1_PORT33_PIN06, TOM01CH02_TOUT020_SEL1_PORT00_PIN11, TOM01CH02_TOUT002_SEL5_PORT02_PIN02, TOM01CH02_TOUT079_SEL1_PORT15_PIN08, TOM01CH02_TOUT070_SEL0_PORT20_PIN14, TOM01CH02_TOUT243_SEL0_PORT15_PIN11, TOM01CH02_TOUT117_SEL4_PORT02_PIN10, TOM01CH02_TOUT033_SEL1_PORT33_PIN11, TOM01CH02_TOUT012_SEL1_PORT00_PIN03, TOM01CH03_TOUT021_SEL1_PORT00_PIN12, TOM01CH03_TOUT029_SEL1_PORT33_PIN07, TOM01CH03_TOUT118_SEL4_PORT02_PIN11, TOM01CH03_TOUT003_SEL5_PORT02_PIN03, TOM01CH03_TOUT080_SEL1_PORT14_PIN00, TOM01CH03_TOUT244_SEL0_PORT15_PIN12, TOM01CH03_TOUT071_SEL0_PORT15_PIN00, TOM01CH03_TOUT038_SEL1_PORT32_PIN02, TOM01CH03_TOUT013_SEL1_PORT00_PIN04, TOM01CH04_TOUT037_SEL5_PORT32_PIN01, TOM01CH04_TOUT072_SEL0_PORT15_PIN01, TOM01CH04_TOUT014_SEL1_PORT00_PIN05, TOM01CH04_TOUT022_SEL1_PORT33_PIN00, TOM01CH04_TOUT039_SEL1_PORT32_PIN03, TOM01CH04_TOUT000_SEL7_PORT02_PIN00, TOM01CH04_TOUT094_SEL7_PORT13_PIN03, TOM01CH04_TOUT053_SEL7_PORT21_PIN02, TOM01CH04_TOUT124_SEL7_PORT11_PIN08, TOM01CH04_TOUT081_SEL1_PORT14_PIN01, TOM01CH04_TOUT245_SEL0_PORT15_PIN13, TOM01CH04_TOUT009_SEL7_PORT00_PIN00, TOM01CH04_TOUT064_SEL6_PORT20_PIN08, TOM01CH04_TOUT030_SEL1_PORT33_PIN08, TOM01CH04_TOUT072_SEL7_PORT15_PIN01, TOM01CH05_TOUT246_SEL0_PORT15_PIN14, TOM01CH05_TOUT027_SEL7_PORT33_PIN05, TOM01CH05_TOUT066_SEL6_PORT20_PIN10, TOM01CH05_TOUT002_SEL7_PORT02_PIN02, TOM01CH05_TOUT015_SEL1_PORT00_PIN06, TOM01CH05_TOUT073_SEL0_PORT15_PIN02, TOM01CH05_TOUT074_SEL7_PORT15_PIN03, TOM01CH05_TOUT096_SEL7_PORT11_PIN03, TOM01CH05_TOUT040_SEL1_PORT32_PIN04, TOM01CH05_TOUT055_SEL7_PORT21_PIN04, TOM01CH05_TOUT082_SEL1_PORT14_PIN02, TOM01CH05_TOUT041_SEL1_PORT23_PIN00, TOM01CH05_TOUT023_SEL1_PORT33_PIN01, TOM01CH05_TOUT011_SEL7_PORT00_PIN02, TOM01CH06_TOUT080_SEL5_PORT14_PIN00, TOM01CH06_TOUT098_SEL7_PORT11_PIN09, TOM01CH06_TOUT013_SEL7_PORT00_PIN04, TOM01CH06_TOUT029_SEL7_PORT33_PIN07, TOM01CH06_TOUT247_SEL0_PORT15_PIN15, TOM01CH06_TOUT016_SEL1_PORT00_PIN07, TOM01CH06_TOUT043_SEL1_PORT23_PIN02, TOM01CH06_TOUT024_SEL1_PORT33_PIN02, TOM01CH06_TOUT068_SEL6_PORT20_PIN12, TOM01CH06_TOUT004_SEL7_PORT02_PIN04, TOM01CH06_TOUT083_SEL1_PORT14_PIN03, TOM01CH06_TOUT074_SEL0_PORT15_PIN03, TOM01CH06_TOUT048_SEL7_PORT22_PIN01, TOM01CH07_TOUT044_SEL1_PORT23_PIN03, TOM01CH07_TOUT025_SEL1_PORT33_PIN03, TOM01CH07_TOUT064_SEL0_PORT20_PIN08, TOM01CH07_TOUT081_SEL5_PORT14_PIN01, TOM01CH07_TOUT017_SEL1_PORT00_PIN08, TOM01CH07_TOUT015_SEL7_PORT00_PIN06, TOM01CH07_TOUT092_SEL7_PORT13_PIN01, TOM01CH07_TOUT045_SEL1_PORT23_PIN04, TOM01CH07_TOUT248_SEL0_PORT13_PIN09, TOM01CH07_TOUT006_SEL7_PORT02_PIN06, TOM01CH07_TOUT050_SEL7_PORT22_PIN03, TOM01CH07_TOUT070_SEL6_PORT20_PIN14, TOM01CH07_TOUT084_SEL1_PORT14_PIN04, TOM01CH07_TOUT101_SEL7_PORT11_PIN12, TOM01CH07_TOUT075_SEL0_PORT15_PIN04, TOM01CH07_TOUT031_SEL7_PORT33_PIN09, TOM01CH08_TOUT249_SEL0_PORT13_PIN12, TOM01CH08_TOUT128_SEL0_PORT12_PIN00, TOM01CH08_TOUT141_SEL0_PORT32_PIN06, TOM01CH08_TOUT000_SEL1_PORT02_PIN00, TOM01CH09_TOUT265_SEL0_PORT10_PIN09, TOM01CH09_TOUT142_SEL0_PORT32_PIN07, TOM01CH09_TOUT001_SEL1_PORT02_PIN01, TOM01CH09_TOUT129_SEL0_PORT12_PIN01, TOM02CH00_TOUT048_SEL1_PORT22_PIN01, TOM02CH00_TOUT119_SEL0_PORT11_PIN00, TOM02CH00_TOUT250_SEL0_PORT13_PIN11, TOM02CH00_TOUT095_SEL6_PORT11_PIN02, TOM02CH00_TOUT087_SEL1_PORT14_PIN07, TOM02CH00_TOUT120_SEL6_PORT11_PIN01, TOM02CH00_TOUT053_SEL1_PORT21_PIN02, TOM02CH00_TOUT065_SEL4_PORT20_PIN09, TOM02CH00_TOUT094_SEL1_PORT13_PIN03, TOM02CH01_TOUT047_SEL1_PORT22_PIN00, TOM02CH01_TOUT120_SEL0_PORT11_PIN01, TOM02CH01_TOUT064_SEL4_PORT20_PIN08, TOM02CH01_TOUT251_SEL0_PORT13_PIN10, TOM02CH01_TOUT095_SEL1_PORT11_PIN02, TOM02CH01_TOUT054_SEL1_PORT21_PIN03, TOM02CH01_TOUT127_SEL4_PORT11_PIN15, TOM02CH10_TOUT133_SEL0_PORT22_PIN07, TOM02CH10_TOUT107_SEL1_PORT10_PIN05, TOM02CH10_TOUT104_SEL1_PORT10_PIN02, TOM02CH10_TOUT070_SEL1_PORT20_PIN14, TOM02CH10_TOUT062_SEL1_PORT20_PIN06, TOM02CH10_TOUT260_SEL0_PORT14_PIN13, TOM02CH11_TOUT105_SEL1_PORT10_PIN03, TOM02CH11_TOUT063_SEL1_PORT20_PIN07, TOM02CH11_TOUT071_SEL1_PORT15_PIN00, TOM02CH11_TOUT134_SEL0_PORT22_PIN08, TOM02CH11_TOUT108_SEL1_PORT10_PIN06, TOM02CH11_TOUT261_SEL0_PORT14_PIN12, TOM02CH12_TOUT072_SEL1_PORT15_PIN01, TOM02CH12_TOUT034_SEL1_PORT33_PIN12, TOM02CH12_TOUT135_SEL0_PORT22_PIN09, TOM02CH12_TOUT102_SEL1_PORT10_PIN00, TOM02CH12_TOUT262_SEL0_PORT13_PIN13, TOM02CH13_TOUT110_SEL1_PORT10_PIN08, TOM02CH13_TOUT035_SEL1_PORT33_PIN13, TOM02CH13_TOUT065_SEL1_PORT20_PIN09, TOM02CH13_TOUT263_SEL0_PORT14_PIN15, TOM02CH13_TOUT136_SEL0_PORT22_PIN10, TOM02CH13_TOUT073_SEL1_PORT15_PIN02, TOM02CH14_TOUT137_SEL0_PORT22_PIN11, TOM02CH14_TOUT066_SEL1_PORT20_PIN10, TOM02CH14_TOUT264_SEL0_PORT13_PIN15, TOM02CH14_TOUT036_SEL1_PORT32_PIN00, TOM02CH14_TOUT074_SEL1_PORT15_PIN03, TOM02CH15_TOUT067_SEL1_PORT20_PIN11, TOM02CH15_TOUT149_SEL0_PORT34_PIN04, TOM02CH15_TOUT037_SEL1_PORT32_PIN01, TOM02CH15_TOUT075_SEL1_PORT15_PIN04, TOM02CH02_TOUT252_SEL0_PORT13_PIN14, TOM02CH02_TOUT121_SEL0_PORT11_PIN04, TOM02CH02_TOUT055_SEL1_PORT21_PIN04, TOM02CH02_TOUT088_SEL1_PORT14_PIN08, TOM02CH02_TOUT046_SEL1_PORT23_PIN05, TOM02CH02_TOUT125_SEL4_PORT11_PIN13, TOM02CH02_TOUT096_SEL1_PORT11_PIN03, TOM02CH02_TOUT050_SEL4_PORT22_PIN03, TOM02CH02_TOUT063_SEL4_PORT20_PIN07, TOM02CH03_TOUT097_SEL1_PORT11_PIN06, TOM02CH03_TOUT089_SEL1_PORT14_PIN09, TOM02CH03_TOUT060_SEL1_PORT20_PIN01, TOM02CH03_TOUT126_SEL4_PORT11_PIN14, TOM02CH03_TOUT056_SEL1_PORT21_PIN05, TOM02CH03_TOUT049_SEL1_PORT22_PIN02, TOM02CH03_TOUT122_SEL0_PORT11_PIN05, TOM02CH03_TOUT253_SEL0_PORT13_PIN04, TOM02CH03_TOUT062_SEL4_PORT20_PIN06, TOM02CH04_TOUT050_SEL1_PORT22_PIN03, TOM02CH04_TOUT254_SEL0_PORT13_PIN05, TOM02CH04_TOUT061_SEL1_PORT20_PIN03, TOM02CH04_TOUT102_SEL5_PORT10_PIN00, TOM02CH04_TOUT133_SEL4_PORT22_PIN07, TOM02CH04_TOUT098_SEL1_PORT11_PIN09, TOM02CH04_TOUT057_SEL1_PORT21_PIN06, TOM02CH04_TOUT090_SEL1_PORT14_PIN10, TOM02CH04_TOUT123_SEL0_PORT11_PIN07, TOM02CH05_TOUT255_SEL0_PORT13_PIN06, TOM02CH05_TOUT124_SEL0_PORT11_PIN08, TOM02CH05_TOUT099_SEL1_PORT11_PIN10, TOM02CH05_TOUT103_SEL5_PORT10_PIN01, TOM02CH05_TOUT091_SEL1_PORT13_PIN00, TOM02CH05_TOUT058_SEL1_PORT21_PIN07, TOM02CH05_TOUT132_SEL4_PORT22_PIN06, TOM02CH06_TOUT256_SEL0_PORT13_PIN07, TOM02CH06_TOUT092_SEL1_PORT13_PIN01, TOM02CH06_TOUT106_SEL1_PORT10_PIN04, TOM02CH06_TOUT100_SEL1_PORT11_PIN11, TOM02CH06_TOUT125_SEL0_PORT11_PIN13, TOM02CH06_TOUT059_SEL1_PORT20_PIN00, TOM02CH06_TOUT104_SEL5_PORT10_PIN02, TOM02CH06_TOUT131_SEL4_PORT22_PIN05, TOM02CH07_TOUT130_SEL0_PORT22_PIN04, TOM02CH07_TOUT093_SEL1_PORT13_PIN02, TOM02CH07_TOUT126_SEL0_PORT11_PIN14, TOM02CH07_TOUT264_SEL6_PORT13_PIN15, TOM02CH07_TOUT101_SEL1_PORT11_PIN12, TOM02CH07_TOUT105_SEL5_PORT10_PIN03, TOM02CH07_TOUT064_SEL1_PORT20_PIN08, TOM02CH08_TOUT131_SEL0_PORT22_PIN05, TOM02CH08_TOUT068_SEL1_PORT20_PIN12, TOM02CH08_TOUT051_SEL1_PORT21_PIN00, TOM02CH08_TOUT127_SEL0_PORT11_PIN15, TOM02CH08_TOUT109_SEL1_PORT10_PIN07, TOM02CH08_TOUT258_SEL0_PORT14_PIN11, TOM02CH09_TOUT103_SEL1_PORT10_PIN01, TOM02CH09_TOUT132_SEL0_PORT22_PIN06, TOM02CH09_TOUT259_SEL0_PORT14_PIN14, TOM02CH09_TOUT052_SEL1_PORT21_PIN01, TOM02CH09_TOUT069_SEL1_PORT20_PIN13, TOM03CH00_TOUT174_SEL0_PORT31_PIN00, TOM03CH00_TOUT115_SEL5_PORT01_PIN07, TOM03CH00_TOUT162_SEL4_PORT01_PIN08, TOM03CH00_TOUT130_SEL5_PORT22_PIN04, TOM03CH00_TOUT155_SEL0_PORT01_PIN00, TOM03CH00_TOUT206_SEL0_PORT25_PIN00, TOM03CH00_TOUT110_SEL4_PORT10_PIN08, TOM03CH01_TOUT175_SEL0_PORT31_PIN01, TOM03CH01_TOUT163_SEL4_PORT01_PIN10, TOM03CH01_TOUT131_SEL5_PORT22_PIN05, TOM03CH01_TOUT207_SEL0_PORT25_PIN01, TOM03CH01_TOUT156_SEL0_PORT01_PIN02, TOM03CH01_TOUT265_SEL4_PORT10_PIN09, TOM03CH01_TOUT114_SEL5_PORT01_PIN06, TOM03CH01_TOUT111_SEL0_PORT01_PIN03, TOM03CH01_TOUT242_SEL1_PORT15_PIN10, TOM03CH10_TOUT266_SEL1_PORT10_PIN10, TOM03CH10_TOUT220_SEL4_PORT25_PIN14, TOM03CH10_TOUT216_SEL0_PORT25_PIN10, TOM03CH10_TOUT184_SEL0_PORT31_PIN10, TOM03CH10_TOUT188_SEL4_PORT31_PIN14, TOM03CH10_TOUT164_SEL0_PORT01_PIN14, TOM03CH11_TOUT189_SEL4_PORT31_PIN15, TOM03CH11_TOUT185_SEL0_PORT31_PIN11, TOM03CH11_TOUT166_SEL0_PORT00_PIN14, TOM03CH11_TOUT267_SEL1_PORT10_PIN14, TOM03CH11_TOUT221_SEL4_PORT25_PIN15, TOM03CH11_TOUT217_SEL0_PORT25_PIN11, TOM03CH12_TOUT268_SEL1_PORT10_PIN13, TOM03CH12_TOUT218_SEL0_PORT25_PIN12, TOM03CH12_TOUT186_SEL0_PORT31_PIN12, TOM03CH12_TOUT167_SEL0_PORT00_PIN13, TOM03CH13_TOUT269_SEL1_PORT10_PIN11, TOM03CH13_TOUT187_SEL0_PORT31_PIN13, TOM03CH13_TOUT168_SEL0_PORT00_PIN15, TOM03CH13_TOUT219_SEL0_PORT25_PIN13, TOM03CH13_TOUT138_SEL1_PORT23_PIN06, TOM03CH14_TOUT220_SEL0_PORT25_PIN14, TOM03CH14_TOUT151_SEL0_PORT02_PIN12, TOM03CH14_TOUT153_SEL0_PORT02_PIN13, TOM03CH14_TOUT270_SEL1_PORT10_PIN15, TOM03CH14_TOUT188_SEL0_PORT31_PIN14, TOM03CH14_TOUT139_SEL1_PORT23_PIN07, TOM03CH15_TOUT189_SEL0_PORT31_PIN15, TOM03CH15_TOUT140_SEL1_PORT32_PIN05, TOM03CH15_TOUT221_SEL0_PORT25_PIN15, TOM03CH15_TOUT154_SEL0_PORT02_PIN14, TOM03CH15_TOUT152_SEL0_PORT02_PIN15, TOM03CH02_TOUT112_SEL1_PORT01_PIN04, TOM03CH02_TOUT157_SEL0_PORT01_PIN15, TOM03CH02_TOUT176_SEL0_PORT31_PIN02, TOM03CH02_TOUT208_SEL0_PORT25_PIN02, TOM03CH02_TOUT266_SEL4_PORT10_PIN10, TOM03CH02_TOUT132_SEL5_PORT22_PIN06, TOM03CH02_TOUT164_SEL4_PORT01_PIN14, TOM03CH02_TOUT243_SEL1_PORT15_PIN11, TOM03CH03_TOUT269_SEL4_PORT10_PIN11, TOM03CH03_TOUT244_SEL1_PORT15_PIN12, TOM03CH03_TOUT133_SEL5_PORT22_PIN07, TOM03CH03_TOUT113_SEL1_PORT01_PIN05, TOM03CH03_TOUT177_SEL0_PORT31_PIN03, TOM03CH03_TOUT165_SEL0_PORT01_PIN11, TOM03CH03_TOUT209_SEL0_PORT25_PIN03, TOM03CH04_TOUT111_SEL5_PORT01_PIN03, TOM03CH04_TOUT114_SEL1_PORT01_PIN06, TOM03CH04_TOUT245_SEL1_PORT15_PIN13, TOM03CH04_TOUT158_SEL0_PORT01_PIN12, TOM03CH04_TOUT178_SEL0_PORT31_PIN04, TOM03CH04_TOUT134_SEL5_PORT22_PIN08, TOM03CH04_TOUT110_SEL5_PORT10_PIN08, TOM03CH04_TOUT210_SEL0_PORT25_PIN04, TOM03CH05_TOUT135_SEL5_PORT22_PIN09, TOM03CH05_TOUT211_SEL0_PORT25_PIN05, TOM03CH05_TOUT265_SEL5_PORT10_PIN09, TOM03CH05_TOUT179_SEL0_PORT31_PIN05, TOM03CH05_TOUT159_SEL0_PORT01_PIN01, TOM03CH05_TOUT246_SEL1_PORT15_PIN14, TOM03CH05_TOUT115_SEL1_PORT01_PIN07, TOM03CH06_TOUT266_SEL5_PORT10_PIN10, TOM03CH06_TOUT180_SEL0_PORT31_PIN06, TOM03CH06_TOUT212_SEL0_PORT25_PIN06, TOM03CH06_TOUT212_SEL0_PORT26_PIN00, TOM03CH06_TOUT247_SEL1_PORT15_PIN15, TOM03CH06_TOUT160_SEL0_PORT01_PIN09, TOM03CH06_TOUT136_SEL5_PORT22_PIN10, TOM03CH07_TOUT137_SEL5_PORT22_PIN11, TOM03CH07_TOUT161_SEL0_PORT01_PIN13, TOM03CH07_TOUT269_SEL5_PORT10_PIN11, TOM03CH07_TOUT248_SEL1_PORT13_PIN09, TOM03CH07_TOUT181_SEL0_PORT31_PIN07, TOM03CH07_TOUT213_SEL0_PORT25_PIN07, TOM03CH08_TOUT182_SEL0_PORT31_PIN08, TOM03CH08_TOUT186_SEL4_PORT31_PIN12, TOM03CH08_TOUT218_SEL4_PORT25_PIN12, TOM03CH08_TOUT249_SEL1_PORT13_PIN12, TOM03CH08_TOUT162_SEL0_PORT01_PIN08, TOM03CH08_TOUT214_SEL0_PORT25_PIN08, TOM03CH09_TOUT163_SEL0_PORT01_PIN10, TOM03CH09_TOUT265_SEL1_PORT10_PIN09, TOM03CH09_TOUT187_SEL4_PORT31_PIN13, TOM03CH09_TOUT219_SEL4_PORT25_PIN13, TOM03CH09_TOUT183_SEL0_PORT31_PIN09, TOM03CH09_TOUT215_SEL0_PORT25_PIN09, TOM04CH00_TOUT222_SEL0_PORT24_PIN00, TOM04CH00_TOUT250_SEL1_PORT13_PIN11, TOM04CH00_TOUT190_SEL0_PORT30_PIN00, TOM04CH00_TOUT155_SEL1_PORT01_PIN00, TOM04CH01_TOUT191_SEL0_PORT30_PIN01, TOM04CH01_TOUT223_SEL0_PORT24_PIN01, TOM04CH01_TOUT163_SEL5_PORT01_PIN10, TOM04CH01_TOUT251_SEL1_PORT13_PIN10, TOM04CH01_TOUT156_SEL1_PORT01_PIN02, TOM04CH10_TOUT204_SEL4_PORT30_PIN14, TOM04CH10_TOUT164_SEL1_PORT01_PIN14, TOM04CH10_TOUT260_SEL1_PORT14_PIN13, TOM04CH10_TOUT232_SEL0_PORT24_PIN10, TOM04CH10_TOUT200_SEL0_PORT30_PIN10, TOM04CH11_TOUT233_SEL0_PORT24_PIN11, TOM04CH11_TOUT261_SEL1_PORT14_PIN12, TOM04CH11_TOUT166_SEL1_PORT00_PIN14, TOM04CH11_TOUT201_SEL0_PORT30_PIN11, TOM04CH11_TOUT205_SEL4_PORT30_PIN15, TOM04CH12_TOUT262_SEL1_PORT13_PIN13, TOM04CH12_TOUT167_SEL1_PORT00_PIN13, TOM04CH12_TOUT234_SEL0_PORT24_PIN12, TOM04CH12_TOUT230_SEL4_PORT24_PIN08, TOM04CH12_TOUT202_SEL0_PORT30_PIN12, TOM04CH13_TOUT203_SEL0_PORT30_PIN13, TOM04CH13_TOUT168_SEL1_PORT00_PIN15, TOM04CH13_TOUT263_SEL1_PORT14_PIN15, TOM04CH13_TOUT231_SEL4_PORT24_PIN09, TOM04CH13_TOUT235_SEL0_PORT24_PIN13, TOM04CH14_TOUT236_SEL0_PORT24_PIN14, TOM04CH14_TOUT264_SEL1_PORT13_PIN15, TOM04CH14_TOUT151_SEL1_PORT02_PIN12, TOM04CH14_TOUT204_SEL0_PORT30_PIN14, TOM04CH14_TOUT153_SEL1_PORT02_PIN13, TOM04CH14_TOUT232_SEL4_PORT24_PIN10, TOM04CH15_TOUT233_SEL4_PORT24_PIN11, TOM04CH15_TOUT205_SEL0_PORT30_PIN15, TOM04CH15_TOUT237_SEL0_PORT24_PIN15, TOM04CH15_TOUT154_SEL1_PORT02_PIN14, TOM04CH15_TOUT152_SEL1_PORT02_PIN15, TOM04CH02_TOUT224_SEL0_PORT24_PIN02, TOM04CH02_TOUT164_SEL5_PORT01_PIN14, TOM04CH02_TOUT252_SEL1_PORT13_PIN14, TOM04CH02_TOUT192_SEL0_PORT30_PIN02, TOM04CH02_TOUT157_SEL1_PORT01_PIN15, TOM04CH03_TOUT225_SEL0_PORT24_PIN03, TOM04CH03_TOUT165_SEL1_PORT01_PIN11, TOM04CH03_TOUT253_SEL1_PORT13_PIN04, TOM04CH03_TOUT193_SEL0_PORT30_PIN03, TOM04CH04_TOUT254_SEL1_PORT13_PIN05, TOM04CH04_TOUT194_SEL0_PORT30_PIN04, TOM04CH04_TOUT158_SEL1_PORT01_PIN12, TOM04CH04_TOUT008_SEL4_PORT02_PIN08, TOM04CH04_TOUT111_SEL4_PORT01_PIN03, TOM04CH04_TOUT226_SEL0_PORT24_PIN04, TOM04CH05_TOUT255_SEL1_PORT13_PIN06, TOM04CH05_TOUT159_SEL1_PORT01_PIN01, TOM04CH05_TOUT227_SEL0_PORT24_PIN05, TOM04CH05_TOUT195_SEL0_PORT30_PIN05, TOM04CH05_TOUT116_SEL1_PORT02_PIN09, TOM04CH06_TOUT160_SEL1_PORT01_PIN09, TOM04CH06_TOUT196_SEL0_PORT30_PIN06, TOM04CH06_TOUT256_SEL1_PORT13_PIN07, TOM04CH06_TOUT228_SEL0_PORT24_PIN06, TOM04CH06_TOUT117_SEL1_PORT02_PIN10, TOM04CH07_TOUT264_SEL7_PORT13_PIN15, TOM04CH07_TOUT161_SEL1_PORT01_PIN13, TOM04CH07_TOUT197_SEL0_PORT30_PIN07, TOM04CH07_TOUT229_SEL0_PORT24_PIN07, TOM04CH07_TOUT118_SEL1_PORT02_PIN11, TOM04CH08_TOUT198_SEL0_PORT30_PIN08, TOM04CH08_TOUT162_SEL1_PORT01_PIN08, TOM04CH08_TOUT230_SEL0_PORT24_PIN08, TOM04CH08_TOUT258_SEL1_PORT14_PIN11, TOM04CH08_TOUT202_SEL4_PORT30_PIN12, TOM04CH09_TOUT231_SEL0_PORT24_PIN09, TOM04CH09_TOUT259_SEL1_PORT14_PIN14, TOM04CH09_TOUT203_SEL4_PORT30_PIN13, TOM04CH09_TOUT199_SEL0_PORT30_PIN09, TOM04CH09_TOUT163_SEL1_PORT01_PIN10}, origin=ChipowerTech, post-build-variant-value=true, set at post-build, default-value=TOMXXCHXX_NO_USED_TOM_CHANNEL  # This decides the output port and pin for the TOM Channel. This parameter is not applicable in case of configuration using bmd. While using Bmd, GtmToutConfiguration should be configured for Port assignment.
      container Atom [8..8]: requires-index=true  # This container contains the ATOM Configuration for GTM
        container AtomChannel [8..8]: requires-index=true  # This container contains the ATOM AGC Channel configuration
          container AtomChannelOutput  # This container contains the ATOM Channel Output configuration
            boolean GTM_Atom_Negative_Support: origin=ChipowerTech, post-build-variant-value=true, set at post-build, default-value=false  # This parameter specifies the Atom negative module used or not.
            integer AtomId: 0..7, scope=ECU, origin=ChipowerTech, set at pre-compile, default-value=0  # Id of the ATOM Cluster.
            integer ChannelId: 0..7, scope=ECU, origin=ChipowerTech, set at pre-compile, default-value=0  # Id of the ATOM channel.
            enumeration AtomChannelNegativePortPinSelect: {ATOMXCHXX_NO_USED_ATOM_CHANNEL, ATOM0CH0N_TOUT112_SEL8_PORT01_PIN04, ATOM0CH0N_TOUT054_SEL8_PORT21_PIN03, ATOM0CH0N_TOUT007_SEL8_PORT02_PIN07, ATOM0CH0N_TOUT017_SEL8_PORT00_PIN08, ATOM0CH0N_TOUT043_SEL8_PORT23_PIN02, ATOM0CH1N_TOUT041_SEL8_PORT23_PIN00, ATOM0CH1N_TOUT050_SELA_PORT22_PIN03, ATOM0CH1N_TOUT113_SEL8_PORT01_PIN05, ATOM0CH1N_TOUT004_SEL8_PORT02_PIN04, ATOM0CH1N_TOUT061_SELA_PORT20_PIN03, ATOM0CH1N_TOUT053_SEL8_PORT21_PIN02, ATOM0CH1N_TOUT014_SEL8_PORT00_PIN05, ATOM0CH1N_TOUT039_SEL9_PORT32_PIN03, ATOM0CH1N_TOUT057_SELA_PORT21_PIN06, ATOM0CH1N_TOUT055_SEL8_PORT21_PIN04, ATOM0CH2N_TOUT056_SEL8_PORT21_PIN05, ATOM0CH2N_TOUT065_SELA_PORT20_PIN09, ATOM0CH2N_TOUT041_SELA_PORT23_PIN00, ATOM0CH2N_TOUT005_SEL8_PORT02_PIN05, ATOM0CH2N_TOUT114_SEL8_PORT01_PIN06, ATOM0CH2N_TOUT044_SEL8_PORT23_PIN03, ATOM0CH2N_TOUT058_SEL8_PORT21_PIN07, ATOM0CH2N_TOUT040_SEL9_PORT32_PIN04, ATOM0CH2N_TOUT015_SEL8_PORT00_PIN06, ATOM0CH2N_TOUT023_SELA_PORT33_PIN01, ATOM0CH3N_TOUT024_SELA_PORT33_PIN02, ATOM0CH3N_TOUT115_SEL8_PORT01_PIN07, ATOM0CH3N_TOUT042_SELA_PORT23_PIN01, ATOM0CH3N_TOUT066_SELA_PORT20_PIN10, ATOM0CH3N_TOUT016_SEL8_PORT00_PIN07, ATOM0CH3N_TOUT059_SELA_PORT20_PIN00, ATOM0CH3N_TOUT006_SEL8_PORT02_PIN06, ATOM0CH3N_TOUT045_SEL8_PORT23_PIN04, ATOM0CH4N_TOUT135_SEL8_PORT22_PIN09, ATOM0CH4N_TOUT013_SEL8_PORT00_PIN04, ATOM0CH4N_TOUT118_SEL8_PORT02_PIN11, ATOM0CH4N_TOUT147_SEL8_PORT34_PIN02, ATOM0CH4N_TOUT003_SEL8_PORT02_PIN03, ATOM0CH5N_TOUT026_SELA_PORT33_PIN04, ATOM0CH5N_TOUT136_SEL8_PORT22_PIN10, ATOM0CH5N_TOUT008_SEL8_PORT02_PIN08, ATOM0CH5N_TOUT000_SEL8_PORT02_PIN00, ATOM0CH5N_TOUT148_SEL8_PORT34_PIN03, ATOM0CH5N_TOUT009_SEL8_PORT00_PIN00, ATOM0CH6N_TOUT137_SEL8_PORT22_PIN11, ATOM0CH6N_TOUT010_SEL8_PORT00_PIN01, ATOM0CH6N_TOUT027_SELA_PORT33_PIN05, ATOM0CH6N_TOUT116_SEL8_PORT02_PIN09, ATOM0CH6N_TOUT149_SEL8_PORT34_PIN04, ATOM0CH6N_TOUT001_SEL8_PORT02_PIN01, ATOM0CH6N_TOUT011_SEL8_PORT00_PIN02, ATOM0CH7N_TOUT028_SELA_PORT33_PIN06, ATOM0CH7N_TOUT150_SEL8_PORT34_PIN05, ATOM0CH7N_TOUT117_SEL8_PORT02_PIN10, ATOM0CH7N_TOUT012_SEL8_PORT00_PIN03, ATOM0CH7N_TOUT002_SEL8_PORT02_PIN02, ATOM1CH0N_TOUT112_SEL9_PORT01_PIN04, ATOM1CH0N_TOUT017_SEL9_PORT00_PIN08, ATOM1CH0N_TOUT007_SEL9_PORT02_PIN07, ATOM1CH1N_TOUT072_SEL9_PORT15_PIN01, ATOM1CH1N_TOUT102_SEL8_PORT10_PIN00, ATOM1CH1N_TOUT039_SELA_PORT32_PIN03, ATOM1CH1N_TOUT113_SEL9_PORT01_PIN05, ATOM1CH1N_TOUT061_SELB_PORT20_PIN03, ATOM1CH1N_TOUT004_SEL9_PORT02_PIN04, ATOM1CH1N_TOUT014_SEL9_PORT00_PIN05, ATOM1CH2N_TOUT110_SEL8_PORT10_PIN08, ATOM1CH2N_TOUT040_SELA_PORT32_PIN04, ATOM1CH2N_TOUT023_SELB_PORT33_PIN01, ATOM1CH2N_TOUT114_SEL9_PORT01_PIN06, ATOM1CH2N_TOUT015_SEL9_PORT00_PIN06, ATOM1CH2N_TOUT005_SEL9_PORT02_PIN05, ATOM1CH2N_TOUT073_SEL9_PORT15_PIN02, ATOM1CH2N_TOUT041_SELB_PORT23_PIN00, ATOM1CH3N_TOUT016_SEL9_PORT00_PIN07, ATOM1CH3N_TOUT106_SEL8_PORT10_PIN04, ATOM1CH3N_TOUT006_SEL9_PORT02_PIN06, ATOM1CH3N_TOUT024_SELB_PORT33_PIN02, ATOM1CH3N_TOUT042_SELB_PORT23_PIN01, ATOM1CH3N_TOUT115_SEL9_PORT01_PIN07, ATOM1CH3N_TOUT074_SEL9_PORT15_PIN03, ATOM1CH4N_TOUT071_SEL9_PORT15_PIN00, ATOM1CH4N_TOUT131_SEL8_PORT22_PIN05, ATOM1CH4N_TOUT075_SEL9_PORT15_PIN04, ATOM1CH4N_TOUT003_SEL9_PORT02_PIN03, ATOM1CH4N_TOUT147_SEL9_PORT34_PIN02, ATOM1CH4N_TOUT013_SEL9_PORT00_PIN04, ATOM1CH4N_TOUT105_SEL8_PORT10_PIN03, ATOM1CH4N_TOUT108_SEL8_PORT10_PIN06, ATOM1CH4N_TOUT118_SEL9_PORT02_PIN11, ATOM1CH5N_TOUT132_SEL8_PORT22_PIN06, ATOM1CH5N_TOUT000_SEL9_PORT02_PIN00, ATOM1CH5N_TOUT148_SEL9_PORT34_PIN03, ATOM1CH5N_TOUT009_SEL9_PORT00_PIN00, ATOM1CH5N_TOUT077_SEL9_PORT15_PIN06, ATOM1CH5N_TOUT008_SEL9_PORT02_PIN08, ATOM1CH5N_TOUT026_SELB_PORT33_PIN04, ATOM1CH5N_TOUT109_SEL8_PORT10_PIN07, ATOM1CH5N_TOUT076_SEL9_PORT15_PIN05, ATOM1CH6N_TOUT027_SELB_PORT33_PIN05, ATOM1CH6N_TOUT010_SEL9_PORT00_PIN01, ATOM1CH6N_TOUT149_SEL9_PORT34_PIN04, ATOM1CH6N_TOUT001_SEL9_PORT02_PIN01, ATOM1CH6N_TOUT103_SEL8_PORT10_PIN01, ATOM1CH6N_TOUT133_SEL8_PORT22_PIN07, ATOM1CH6N_TOUT011_SEL9_PORT00_PIN02, ATOM1CH6N_TOUT078_SEL9_PORT15_PIN07, ATOM1CH6N_TOUT116_SEL9_PORT02_PIN09, ATOM1CH7N_TOUT134_SEL8_PORT22_PIN08, ATOM1CH7N_TOUT117_SEL9_PORT02_PIN10, ATOM1CH7N_TOUT012_SEL9_PORT00_PIN03, ATOM1CH7N_TOUT107_SEL8_PORT10_PIN05, ATOM1CH7N_TOUT079_SEL9_PORT15_PIN08, ATOM1CH7N_TOUT028_SELB_PORT33_PIN06, ATOM1CH7N_TOUT104_SEL8_PORT10_PIN02, ATOM1CH7N_TOUT002_SEL9_PORT02_PIN02, ATOM1CH7N_TOUT150_SEL9_PORT34_PIN05, ATOM2CH0N_TOUT032_SEL8_PORT33_PIN10, ATOM2CH0N_TOUT037_SELA_PORT32_PIN01, ATOM2CH0N_TOUT025_SEL8_PORT33_PIN03, ATOM2CH0N_TOUT012_SELA_PORT00_PIN03, ATOM2CH0N_TOUT144_SEL8_PORT33_PIN15, ATOM2CH0N_TOUT108_SELA_PORT10_PIN06, ATOM2CH0N_TOUT101_SEL9_PORT11_PIN12, ATOM2CH1N_TOUT105_SELA_PORT10_PIN03, ATOM2CH1N_TOUT030_SEL8_PORT33_PIN08, ATOM2CH1N_TOUT091_SEL8_PORT13_PIN00, ATOM2CH1N_TOUT051_SEL8_PORT21_PIN00, ATOM2CH1N_TOUT098_SEL9_PORT11_PIN09, ATOM2CH1N_TOUT167_SELA_PORT00_PIN13, ATOM2CH1N_TOUT034_SEL8_PORT33_PIN12, ATOM2CH1N_TOUT009_SELA_PORT00_PIN00, ATOM2CH1N_TOUT090_SELA_PORT14_PIN10, ATOM2CH1N_TOUT022_SEL8_PORT33_PIN00, ATOM2CH2N_TOUT138_SELA_PORT23_PIN06, ATOM2CH2N_TOUT035_SEL8_PORT33_PIN13, ATOM2CH2N_TOUT114_SELA_PORT01_PIN06, ATOM2CH2N_TOUT031_SEL9_PORT33_PIN09, ATOM2CH2N_TOUT166_SELA_PORT00_PIN14, ATOM2CH2N_TOUT106_SELA_PORT10_PIN04, ATOM2CH2N_TOUT052_SEL8_PORT21_PIN01, ATOM2CH2N_TOUT023_SEL8_PORT33_PIN01, ATOM2CH2N_TOUT091_SELA_PORT13_PIN00, ATOM2CH2N_TOUT092_SEL8_PORT13_PIN01, ATOM2CH2N_TOUT099_SEL9_PORT11_PIN10, ATOM2CH2N_TOUT010_SELA_PORT00_PIN01, ATOM2CH3N_TOUT036_SEL8_PORT32_PIN00, ATOM2CH3N_TOUT011_SELA_PORT00_PIN02, ATOM2CH3N_TOUT139_SELA_PORT23_PIN07, ATOM2CH3N_TOUT093_SEL8_PORT13_PIN02, ATOM2CH3N_TOUT143_SEL8_PORT33_PIN14, ATOM2CH3N_TOUT168_SELA_PORT00_PIN15, ATOM2CH3N_TOUT115_SELA_PORT01_PIN07, ATOM2CH3N_TOUT092_SELA_PORT13_PIN01, ATOM2CH3N_TOUT024_SEL8_PORT33_PIN02, ATOM2CH3N_TOUT062_SELA_PORT20_PIN06, ATOM2CH3N_TOUT100_SEL9_PORT11_PIN11, ATOM2CH3N_TOUT107_SELA_PORT10_PIN05, ATOM2CH3N_TOUT033_SEL8_PORT33_PIN11, ATOM2CH4N_TOUT086_SEL8_PORT14_PIN06, ATOM2CH4N_TOUT057_SEL8_PORT21_PIN06, ATOM2CH4N_TOUT029_SEL8_PORT33_PIN07, ATOM2CH4N_TOUT097_SEL9_PORT11_PIN06, ATOM2CH5N_TOUT026_SEL8_PORT33_PIN04, ATOM2CH5N_TOUT059_SEL8_PORT20_PIN00, ATOM2CH5N_TOUT087_SEL8_PORT14_PIN07, ATOM2CH5N_TOUT120_SEL9_PORT11_PIN01, ATOM2CH5N_TOUT094_SEL9_PORT13_PIN03, ATOM2CH6N_TOUT088_SEL8_PORT14_PIN08, ATOM2CH6N_TOUT027_SEL8_PORT33_PIN05, ATOM2CH6N_TOUT060_SEL8_PORT20_PIN01, ATOM2CH6N_TOUT095_SEL9_PORT11_PIN02, ATOM2CH7N_TOUT061_SEL8_PORT20_PIN03, ATOM2CH7N_TOUT089_SEL8_PORT14_PIN09, ATOM2CH7N_TOUT096_SEL9_PORT11_PIN03, ATOM2CH7N_TOUT028_SEL8_PORT33_PIN06, ATOM3CH0N_TOUT101_SEL8_PORT11_PIN12, ATOM3CH0N_TOUT017_SELA_PORT00_PIN08, ATOM3CH0N_TOUT025_SEL9_PORT33_PIN03, ATOM3CH0N_TOUT032_SEL9_PORT33_PIN10, ATOM3CH0N_TOUT076_SEL8_PORT15_PIN05, ATOM3CH0N_TOUT037_SELB_PORT32_PIN01, ATOM3CH0N_TOUT144_SEL9_PORT33_PIN15, ATOM3CH0N_TOUT063_SELA_PORT20_PIN07, ATOM3CH1N_TOUT090_SELB_PORT14_PIN10, ATOM3CH1N_TOUT051_SELA_PORT21_PIN00, ATOM3CH1N_TOUT022_SEL9_PORT33_PIN00, ATOM3CH1N_TOUT098_SEL8_PORT11_PIN09, ATOM3CH1N_TOUT091_SEL9_PORT13_PIN00, ATOM3CH1N_TOUT079_SEL8_PORT15_PIN08, ATOM3CH1N_TOUT167_SELB_PORT00_PIN13, ATOM3CH1N_TOUT034_SEL9_PORT33_PIN12, ATOM3CH1N_TOUT030_SEL9_PORT33_PIN08, ATOM3CH1N_TOUT014_SELA_PORT00_PIN05, ATOM3CH2N_TOUT114_SELB_PORT01_PIN06, ATOM3CH2N_TOUT023_SEL9_PORT33_PIN01, ATOM3CH2N_TOUT031_SELA_PORT33_PIN09, ATOM3CH2N_TOUT015_SELA_PORT00_PIN06, ATOM3CH2N_TOUT052_SELA_PORT21_PIN01, ATOM3CH2N_TOUT166_SELB_PORT00_PIN14, ATOM3CH2N_TOUT091_SELB_PORT13_PIN00, ATOM3CH2N_TOUT035_SEL9_PORT33_PIN13, ATOM3CH2N_TOUT092_SEL9_PORT13_PIN01, ATOM3CH2N_TOUT078_SEL8_PORT15_PIN07, ATOM3CH2N_TOUT099_SEL8_PORT11_PIN10, ATOM3CH3N_TOUT143_SEL9_PORT33_PIN14, ATOM3CH3N_TOUT168_SELB_PORT00_PIN15, ATOM3CH3N_TOUT033_SEL9_PORT33_PIN11, ATOM3CH3N_TOUT100_SEL8_PORT11_PIN11, ATOM3CH3N_TOUT024_SEL9_PORT33_PIN02, ATOM3CH3N_TOUT077_SEL8_PORT15_PIN06, ATOM3CH3N_TOUT062_SELB_PORT20_PIN06, ATOM3CH3N_TOUT036_SEL9_PORT32_PIN00, ATOM3CH3N_TOUT115_SELB_PORT01_PIN07, ATOM3CH3N_TOUT016_SELA_PORT00_PIN07, ATOM3CH3N_TOUT092_SELB_PORT13_PIN01, ATOM3CH3N_TOUT093_SEL9_PORT13_PIN02, ATOM3CH4N_TOUT135_SEL3_PORT22_PIN09, ATOM3CH4N_TOUT029_SEL9_PORT33_PIN07, ATOM3CH4N_TOUT057_SEL9_PORT21_PIN06, ATOM3CH4N_TOUT021_SEL8_PORT00_PIN12, ATOM3CH4N_TOUT097_SEL8_PORT11_PIN06, ATOM3CH4N_TOUT086_SEL9_PORT14_PIN06, ATOM3CH5N_TOUT094_SEL8_PORT13_PIN03, ATOM3CH5N_TOUT059_SEL9_PORT20_PIN00, ATOM3CH5N_TOUT094_SELA_PORT13_PIN03, ATOM3CH5N_TOUT120_SELA_PORT11_PIN01, ATOM3CH5N_TOUT087_SEL9_PORT14_PIN07, ATOM3CH5N_TOUT018_SEL8_PORT00_PIN09, ATOM3CH5N_TOUT136_SEL3_PORT22_PIN10, ATOM3CH5N_TOUT026_SEL9_PORT33_PIN04, ATOM3CH6N_TOUT095_SEL8_PORT11_PIN02, ATOM3CH6N_TOUT137_SEL3_PORT22_PIN11, ATOM3CH6N_TOUT019_SEL8_PORT00_PIN10, ATOM3CH6N_TOUT027_SEL9_PORT33_PIN05, ATOM3CH6N_TOUT060_SEL9_PORT20_PIN01, ATOM3CH6N_TOUT088_SEL9_PORT14_PIN08, ATOM3CH7N_TOUT089_SEL9_PORT14_PIN09, ATOM3CH7N_TOUT028_SEL9_PORT33_PIN06, ATOM3CH7N_TOUT061_SEL9_PORT20_PIN03, ATOM3CH7N_TOUT096_SEL8_PORT11_PIN03, ATOM3CH7N_TOUT020_SEL8_PORT00_PIN11, ATOM4CH0N_TOUT087_SELA_PORT14_PIN07, ATOM4CH1N_TOUT044_SELA_PORT23_PIN03, ATOM4CH1N_TOUT085_SEL7_PORT14_PIN05, ATOM4CH1N_TOUT086_SELA_PORT14_PIN06, ATOM4CH1N_TOUT050_SEL9_PORT22_PIN03, ATOM4CH1N_TOUT102_SEL9_PORT10_PIN00, ATOM4CH1N_TOUT053_SEL9_PORT21_PIN02, ATOM4CH1N_TOUT072_SELA_PORT15_PIN01, ATOM4CH1N_TOUT057_SELB_PORT21_PIN06, ATOM4CH2N_TOUT073_SELA_PORT15_PIN02, ATOM4CH2N_TOUT045_SELA_PORT23_PIN04, ATOM4CH2N_TOUT081_SEL8_PORT14_PIN01, ATOM4CH2N_TOUT065_SELB_PORT20_PIN09, ATOM4CH2N_TOUT110_SEL9_PORT10_PIN08, ATOM4CH2N_TOUT052_SEL9_PORT21_PIN01, ATOM4CH2N_TOUT058_SEL9_PORT21_PIN07, ATOM4CH3N_TOUT046_SELA_PORT23_PIN05, ATOM4CH3N_TOUT051_SEL9_PORT21_PIN00, ATOM4CH3N_TOUT066_SELB_PORT20_PIN10, ATOM4CH3N_TOUT080_SEL8_PORT14_PIN00, ATOM4CH3N_TOUT059_SELB_PORT20_PIN00, ATOM4CH3N_TOUT074_SELA_PORT15_PIN03, ATOM4CH3N_TOUT106_SEL9_PORT10_PIN04, ATOM4CH4N_TOUT105_SEL9_PORT10_PIN03, ATOM4CH4N_TOUT132_SEL9_PORT22_PIN06, ATOM4CH4N_TOUT108_SEL9_PORT10_PIN06, ATOM4CH4N_TOUT075_SELA_PORT15_PIN04, ATOM4CH4N_TOUT071_SELA_PORT15_PIN00, ATOM4CH4N_TOUT021_SEL9_PORT00_PIN12, ATOM4CH4N_TOUT095_SELA_PORT11_PIN02, ATOM4CH4N_TOUT056_SEL9_PORT21_PIN05, ATOM4CH5N_TOUT121_SELA_PORT11_PIN04, ATOM4CH5N_TOUT018_SEL9_PORT00_PIN09, ATOM4CH5N_TOUT109_SEL9_PORT10_PIN07, ATOM4CH5N_TOUT133_SEL9_PORT22_PIN07, ATOM4CH5N_TOUT077_SELA_PORT15_PIN06, ATOM4CH5N_TOUT076_SELA_PORT15_PIN05, ATOM4CH6N_TOUT019_SEL9_PORT00_PIN10, ATOM4CH6N_TOUT103_SEL9_PORT10_PIN01, ATOM4CH6N_TOUT097_SELA_PORT11_PIN06, ATOM4CH6N_TOUT134_SEL9_PORT22_PIN08, ATOM4CH6N_TOUT078_SELA_PORT15_PIN07, ATOM4CH7N_TOUT124_SELA_PORT11_PIN08, ATOM4CH7N_TOUT104_SEL9_PORT10_PIN02, ATOM4CH7N_TOUT135_SEL9_PORT22_PIN09, ATOM4CH7N_TOUT020_SEL9_PORT00_PIN11, ATOM4CH7N_TOUT107_SEL9_PORT10_PIN05, ATOM4CH7N_TOUT079_SELA_PORT15_PIN08, ATOM5CH0N_TOUT181_SELA_PORT31_PIN07, ATOM5CH0N_TOUT213_SELA_PORT25_PIN07, ATOM5CH0N_TOUT150_SELB_PORT34_PIN05, ATOM5CH0N_TOUT261_SEL8_PORT14_PIN12, ATOM5CH0N_TOUT161_SEL8_PORT01_PIN13, ATOM5CH0N_TOUT126_SEL8_PORT11_PIN14, ATOM5CH0N_TOUT217_SELA_PORT25_PIN11, ATOM5CH0N_TOUT264_SEL8_PORT13_PIN15, ATOM5CH0N_TOUT134_SELB_PORT22_PIN08, ATOM5CH1N_TOUT210_SELA_PORT25_PIN04, ATOM5CH1N_TOUT123_SEL8_PORT11_PIN07, ATOM5CH1N_TOUT135_SELB_PORT22_PIN09, ATOM5CH1N_TOUT245_SEL8_PORT15_PIN13, ATOM5CH1N_TOUT178_SELA_PORT31_PIN04, ATOM5CH1N_TOUT140_SELA_PORT32_PIN05, ATOM5CH1N_TOUT128_SEL8_PORT12_PIN00, ATOM5CH1N_TOUT268_SEL9_PORT10_PIN13, ATOM5CH1N_TOUT158_SEL8_PORT01_PIN12, ATOM5CH1N_TOUT260_SEL8_PORT14_PIN13, ATOM5CH1N_TOUT248_SELA_PORT13_PIN09, ATOM5CH2N_TOUT141_SELA_PORT32_PIN06, ATOM5CH2N_TOUT136_SELB_PORT22_PIN10, ATOM5CH2N_TOUT246_SEL8_PORT15_PIN14, ATOM5CH2N_TOUT250_SELA_PORT13_PIN11, ATOM5CH2N_TOUT124_SEL8_PORT11_PIN08, ATOM5CH2N_TOUT159_SEL8_PORT01_PIN01, ATOM5CH2N_TOUT179_SELA_PORT31_PIN05, ATOM5CH2N_TOUT269_SEL9_PORT10_PIN11, ATOM5CH2N_TOUT211_SELA_PORT25_PIN05, ATOM5CH2N_TOUT259_SEL8_PORT14_PIN14, ATOM5CH3N_TOUT247_SEL8_PORT15_PIN15, ATOM5CH3N_TOUT123_SELA_PORT11_PIN07, ATOM5CH3N_TOUT160_SEL8_PORT01_PIN09, ATOM5CH3N_TOUT137_SELB_PORT22_PIN11, ATOM5CH3N_TOUT125_SEL8_PORT11_PIN13, ATOM5CH3N_TOUT180_SELA_PORT31_PIN06, ATOM5CH3N_TOUT212_SELA_PORT25_PIN06, ATOM5CH3N_TOUT212_SELA_PORT26_PIN00, ATOM5CH3N_TOUT270_SEL9_PORT10_PIN15, ATOM5CH3N_TOUT263_SEL8_PORT14_PIN15, ATOM5CH3N_TOUT249_SELA_PORT13_PIN12, ATOM5CH3N_TOUT142_SELA_PORT32_PIN07, ATOM5CH4N_TOUT177_SELA_PORT31_PIN03, ATOM5CH4N_TOUT267_SEL9_PORT10_PIN14, ATOM5CH4N_TOUT163_SELA_PORT01_PIN10, ATOM5CH4N_TOUT165_SEL8_PORT01_PIN11, ATOM5CH4N_TOUT209_SELA_PORT25_PIN03, ATOM5CH4N_TOUT129_SEL8_PORT12_PIN01, ATOM5CH4N_TOUT122_SEL8_PORT11_PIN05, ATOM5CH5N_TOUT155_SEL8_PORT01_PIN00, ATOM5CH5N_TOUT206_SELA_PORT25_PIN00, ATOM5CH5N_TOUT119_SEL8_PORT11_PIN00, ATOM5CH5N_TOUT162_SELA_PORT01_PIN08, ATOM5CH5N_TOUT174_SELA_PORT31_PIN00, ATOM5CH6N_TOUT158_SELA_PORT01_PIN12, ATOM5CH6N_TOUT175_SELA_PORT31_PIN01, ATOM5CH6N_TOUT156_SEL8_PORT01_PIN02, ATOM5CH6N_TOUT120_SEL8_PORT11_PIN01, ATOM5CH6N_TOUT207_SELA_PORT25_PIN01, ATOM5CH6N_TOUT096_SELA_PORT11_PIN03, ATOM5CH7N_TOUT157_SEL8_PORT01_PIN15, ATOM5CH7N_TOUT152_SELA_PORT02_PIN15, ATOM5CH7N_TOUT208_SELA_PORT25_PIN02, ATOM5CH7N_TOUT121_SEL8_PORT11_PIN04, ATOM5CH7N_TOUT176_SELA_PORT31_PIN02}, origin=ChipowerTech, post-build-variant-value=true, set at post-build, default-value=ATOMXCHXX_NO_USED_ATOM_CHANNEL  # This decides the output port and pin for the ATOM Channel. This parameter is not applicable in case of configuration using bmd. While using Bmd, GtmToutConfiguration should be configured for Port assignment.
            enumeration AtomChannelPortPinSelect: {ATOMXCHXX_NO_USED_ATOM_CHANNEL, ATOM0CH00_TOUT085_SEL2_PORT14_PIN05, ATOM0CH00_TOUT009_SEL2_PORT00_PIN00, ATOM0CH00_TOUT000_SEL2_PORT02_PIN00, ATOM0CH00_TOUT053_SEL2_PORT21_PIN02, ATOM0CH00_TOUT008_SEL2_PORT02_PIN08, ATOM0CH00_TOUT048_SEL2_PORT22_PIN01, ATOM0CH01_TOUT116_SELA_PORT02_PIN09, ATOM0CH01_TOUT084_SEL2_PORT14_PIN04, ATOM0CH01_TOUT001_SEL2_PORT02_PIN01, ATOM0CH01_TOUT010_SEL2_PORT00_PIN01, ATOM0CH01_TOUT031_SEL2_PORT33_PIN09, ATOM0CH01_TOUT011_SEL2_PORT00_PIN02, ATOM0CH01_TOUT054_SEL2_PORT21_PIN03, ATOM0CH01_TOUT047_SEL2_PORT22_PIN00, ATOM0CH02_TOUT002_SEL2_PORT02_PIN02, ATOM0CH02_TOUT042_SEL8_PORT23_PIN01, ATOM0CH02_TOUT083_SEL2_PORT14_PIN03, ATOM0CH02_TOUT033_SEL2_PORT33_PIN11, ATOM0CH02_TOUT117_SELA_PORT02_PIN10, ATOM0CH02_TOUT055_SEL2_PORT21_PIN04, ATOM0CH02_TOUT046_SEL2_PORT23_PIN05, ATOM0CH02_TOUT012_SEL2_PORT00_PIN03, ATOM0CH03_TOUT013_SEL2_PORT00_PIN04, ATOM0CH03_TOUT038_SEL2_PORT32_PIN02, ATOM0CH03_TOUT060_SEL2_PORT20_PIN01, ATOM0CH03_TOUT003_SEL2_PORT02_PIN03, ATOM0CH03_TOUT049_SEL2_PORT22_PIN02, ATOM0CH03_TOUT118_SELA_PORT02_PIN11, ATOM0CH03_TOUT082_SEL2_PORT14_PIN02, ATOM0CH03_TOUT056_SEL2_PORT21_PIN05, ATOM0CH04_TOUT004_SEL2_PORT02_PIN04, ATOM0CH04_TOUT050_SEL2_PORT22_PIN03, ATOM0CH04_TOUT039_SEL2_PORT32_PIN03, ATOM0CH04_TOUT146_SEL8_PORT34_PIN01, ATOM0CH04_TOUT029_SELA_PORT33_PIN07, ATOM0CH04_TOUT061_SEL2_PORT20_PIN03, ATOM0CH04_TOUT057_SEL2_PORT21_PIN06, ATOM0CH04_TOUT081_SEL2_PORT14_PIN01, ATOM0CH04_TOUT014_SEL2_PORT00_PIN05, ATOM0CH05_TOUT023_SEL2_PORT33_PIN01, ATOM0CH05_TOUT040_SEL2_PORT32_PIN04, ATOM0CH05_TOUT005_SEL2_PORT02_PIN05, ATOM0CH05_TOUT015_SEL2_PORT00_PIN06, ATOM0CH05_TOUT058_SEL2_PORT21_PIN07, ATOM0CH05_TOUT041_SEL2_PORT23_PIN00, ATOM0CH06_TOUT006_SEL2_PORT02_PIN06, ATOM0CH06_TOUT106_SEL2_PORT10_PIN04, ATOM0CH06_TOUT016_SEL2_PORT00_PIN07, ATOM0CH06_TOUT059_SEL2_PORT20_PIN00, ATOM0CH06_TOUT024_SEL2_PORT33_PIN02, ATOM0CH06_TOUT042_SEL2_PORT23_PIN01, ATOM0CH07_TOUT007_SEL2_PORT02_PIN07, ATOM0CH07_TOUT045_SEL2_PORT23_PIN04, ATOM0CH07_TOUT017_SEL2_PORT00_PIN08, ATOM0CH07_TOUT064_SEL2_PORT20_PIN08, ATOM0CH07_TOUT025_SEL2_PORT33_PIN03, ATOM1CH00_TOUT109_SEL2_PORT10_PIN07, ATOM1CH00_TOUT009_SEL3_PORT00_PIN00, ATOM1CH00_TOUT087_SEL2_PORT14_PIN07, ATOM1CH00_TOUT077_SEL2_PORT15_PIN06, ATOM1CH00_TOUT000_SEL3_PORT02_PIN00, ATOM1CH00_TOUT076_SEL2_PORT15_PIN05, ATOM1CH00_TOUT068_SEL2_PORT20_PIN12, ATOM1CH00_TOUT008_SEL3_PORT02_PIN08, ATOM1CH01_TOUT116_SELB_PORT02_PIN09, ATOM1CH01_TOUT103_SEL2_PORT10_PIN01, ATOM1CH01_TOUT079_SEL2_PORT15_PIN08, ATOM1CH01_TOUT031_SEL3_PORT33_PIN09, ATOM1CH01_TOUT069_SEL2_PORT20_PIN13, ATOM1CH01_TOUT011_SEL3_PORT00_PIN02, ATOM1CH01_TOUT001_SEL3_PORT02_PIN01, ATOM1CH01_TOUT010_SEL3_PORT00_PIN01, ATOM1CH01_TOUT086_SEL2_PORT14_PIN06, ATOM1CH01_TOUT078_SEL2_PORT15_PIN07, ATOM1CH02_TOUT033_SEL3_PORT33_PIN11, ATOM1CH02_TOUT080_SEL2_PORT14_PIN00, ATOM1CH02_TOUT104_SEL2_PORT10_PIN02, ATOM1CH02_TOUT107_SEL2_PORT10_PIN05, ATOM1CH02_TOUT012_SEL3_PORT00_PIN03, ATOM1CH02_TOUT002_SEL3_PORT02_PIN02, ATOM1CH02_TOUT070_SEL2_PORT20_PIN14, ATOM1CH02_TOUT117_SELB_PORT02_PIN10, ATOM1CH03_TOUT060_SEL3_PORT20_PIN01, ATOM1CH03_TOUT105_SEL2_PORT10_PIN03, ATOM1CH03_TOUT108_SEL2_PORT10_PIN06, ATOM1CH03_TOUT013_SEL3_PORT00_PIN04, ATOM1CH03_TOUT038_SEL3_PORT32_PIN02, ATOM1CH03_TOUT003_SEL3_PORT02_PIN03, ATOM1CH03_TOUT071_SEL2_PORT15_PIN00, ATOM1CH03_TOUT118_SELB_PORT02_PIN11, ATOM1CH04_TOUT029_SELB_PORT33_PIN07, ATOM1CH04_TOUT039_SEL3_PORT32_PIN03, ATOM1CH04_TOUT102_SEL2_PORT10_PIN00, ATOM1CH04_TOUT004_SEL3_PORT02_PIN04, ATOM1CH04_TOUT061_SEL3_PORT20_PIN03, ATOM1CH04_TOUT014_SEL3_PORT00_PIN05, ATOM1CH04_TOUT146_SEL9_PORT34_PIN01, ATOM1CH04_TOUT130_SEL8_PORT22_PIN04, ATOM1CH04_TOUT072_SEL2_PORT15_PIN01, ATOM1CH05_TOUT040_SEL3_PORT32_PIN04, ATOM1CH05_TOUT065_SEL2_PORT20_PIN09, ATOM1CH05_TOUT015_SEL3_PORT00_PIN06, ATOM1CH05_TOUT073_SEL2_PORT15_PIN02, ATOM1CH05_TOUT110_SEL2_PORT10_PIN08, ATOM1CH05_TOUT005_SEL3_PORT02_PIN05, ATOM1CH05_TOUT041_SEL3_PORT23_PIN00, ATOM1CH05_TOUT023_SEL3_PORT33_PIN01, ATOM1CH06_TOUT106_SELB_PORT10_PIN04, ATOM1CH06_TOUT006_SEL3_PORT02_PIN06, ATOM1CH06_TOUT074_SEL2_PORT15_PIN03, ATOM1CH06_TOUT066_SEL2_PORT20_PIN10, ATOM1CH06_TOUT042_SEL3_PORT23_PIN01, ATOM1CH06_TOUT024_SEL3_PORT33_PIN02, ATOM1CH06_TOUT016_SEL3_PORT00_PIN07, ATOM1CH07_TOUT075_SEL2_PORT15_PIN04, ATOM1CH07_TOUT025_SEL3_PORT33_PIN03, ATOM1CH07_TOUT067_SEL2_PORT20_PIN11, ATOM1CH07_TOUT007_SEL3_PORT02_PIN07, ATOM1CH07_TOUT017_SEL3_PORT00_PIN08, ATOM1CH07_TOUT045_SEL3_PORT23_PIN04, ATOM2CH00_TOUT018_SEL2_PORT00_PIN09, ATOM2CH00_TOUT094_SEL2_PORT13_PIN03, ATOM2CH00_TOUT032_SEL2_PORT33_PIN10, ATOM2CH00_TOUT026_SEL2_PORT33_PIN04, ATOM2CH00_TOUT109_SELA_PORT10_PIN07, ATOM2CH01_TOUT095_SEL2_PORT11_PIN02, ATOM2CH01_TOUT102_SELA_PORT10_PIN00, ATOM2CH01_TOUT043_SEL2_PORT23_PIN02, ATOM2CH01_TOUT019_SEL2_PORT00_PIN10, ATOM2CH01_TOUT090_SEL8_PORT14_PIN10, ATOM2CH01_TOUT027_SEL2_PORT33_PIN05, ATOM2CH02_TOUT103_SELA_PORT10_PIN01, ATOM2CH02_TOUT096_SEL2_PORT11_PIN03, ATOM2CH02_TOUT044_SEL2_PORT23_PIN03, ATOM2CH02_TOUT020_SEL2_PORT00_PIN11, ATOM2CH02_TOUT028_SEL2_PORT33_PIN06, ATOM2CH02_TOUT088_SEL2_PORT14_PIN08, ATOM2CH03_TOUT097_SEL2_PORT11_PIN06, ATOM2CH03_TOUT104_SELA_PORT10_PIN02, ATOM2CH03_TOUT021_SEL2_PORT00_PIN12, ATOM2CH03_TOUT089_SEL2_PORT14_PIN09, ATOM2CH03_TOUT029_SEL2_PORT33_PIN07, ATOM2CH04_TOUT098_SEL2_PORT11_PIN09, ATOM2CH04_TOUT167_SEL8_PORT00_PIN13, ATOM2CH04_TOUT051_SEL2_PORT21_PIN00, ATOM2CH04_TOUT022_SEL2_PORT33_PIN00, ATOM2CH04_TOUT030_SEL2_PORT33_PIN08, ATOM2CH04_TOUT034_SEL2_PORT33_PIN12, ATOM2CH04_TOUT090_SEL2_PORT14_PIN10, ATOM2CH05_TOUT166_SEL8_PORT00_PIN14, ATOM2CH05_TOUT052_SEL2_PORT21_PIN01, ATOM2CH05_TOUT035_SEL2_PORT33_PIN13, ATOM2CH05_TOUT065_SEL9_PORT20_PIN09, ATOM2CH05_TOUT099_SEL2_PORT11_PIN10, ATOM2CH05_TOUT138_SEL0_PORT23_PIN06, ATOM2CH05_TOUT091_SEL2_PORT13_PIN00, ATOM2CH06_TOUT168_SEL8_PORT00_PIN15, ATOM2CH06_TOUT092_SEL2_PORT13_PIN01, ATOM2CH06_TOUT139_SEL0_PORT23_PIN07, ATOM2CH06_TOUT036_SEL2_PORT32_PIN00, ATOM2CH06_TOUT100_SEL2_PORT11_PIN11, ATOM2CH06_TOUT143_SELA_PORT33_PIN14, ATOM2CH06_TOUT062_SEL2_PORT20_PIN06, ATOM2CH07_TOUT037_SEL2_PORT32_PIN01, ATOM2CH07_TOUT037_SEL8_PORT32_PIN01, ATOM2CH07_TOUT140_SEL0_PORT32_PIN05, ATOM2CH07_TOUT144_SELA_PORT33_PIN15, ATOM2CH07_TOUT093_SEL2_PORT13_PIN02, ATOM2CH07_TOUT063_SEL2_PORT20_PIN07, ATOM2CH07_TOUT101_SEL2_PORT11_PIN12, ATOM3CH00_TOUT026_SEL3_PORT33_PIN04, ATOM3CH00_TOUT018_SEL3_PORT00_PIN09, ATOM3CH00_TOUT094_SEL3_PORT13_PIN03, ATOM3CH00_TOUT032_SEL3_PORT33_PIN10, ATOM3CH00_TOUT065_SEL8_PORT20_PIN09, ATOM3CH01_TOUT128_SELA_PORT12_PIN00, ATOM3CH01_TOUT111_SEL2_PORT01_PIN03, ATOM3CH01_TOUT027_SEL3_PORT33_PIN05, ATOM3CH01_TOUT064_SEL8_PORT20_PIN08, ATOM3CH01_TOUT095_SEL3_PORT11_PIN02, ATOM3CH01_TOUT090_SEL9_PORT14_PIN10, ATOM3CH01_TOUT043_SEL3_PORT23_PIN02, ATOM3CH01_TOUT019_SEL3_PORT00_PIN10, ATOM3CH02_TOUT020_SEL3_PORT00_PIN11, ATOM3CH02_TOUT088_SEL3_PORT14_PIN08, ATOM3CH02_TOUT096_SEL3_PORT11_PIN03, ATOM3CH02_TOUT063_SEL8_PORT20_PIN07, ATOM3CH02_TOUT112_SEL0_PORT01_PIN04, ATOM3CH02_TOUT044_SEL3_PORT23_PIN03, ATOM3CH02_TOUT028_SEL3_PORT33_PIN06, ATOM3CH03_TOUT062_SEL8_PORT20_PIN06, ATOM3CH03_TOUT089_SEL3_PORT14_PIN09, ATOM3CH03_TOUT097_SEL3_PORT11_PIN06, ATOM3CH03_TOUT113_SEL0_PORT01_PIN05, ATOM3CH03_TOUT029_SEL3_PORT33_PIN07, ATOM3CH03_TOUT021_SEL3_PORT00_PIN12, ATOM3CH04_TOUT030_SEL3_PORT33_PIN08, ATOM3CH04_TOUT098_SEL3_PORT11_PIN09, ATOM3CH04_TOUT051_SEL3_PORT21_PIN00, ATOM3CH04_TOUT167_SEL9_PORT00_PIN13, ATOM3CH04_TOUT034_SEL3_PORT33_PIN12, ATOM3CH04_TOUT114_SEL0_PORT01_PIN06, ATOM3CH04_TOUT131_SEL3_PORT22_PIN05, ATOM3CH04_TOUT022_SEL3_PORT33_PIN00, ATOM3CH04_TOUT090_SEL3_PORT14_PIN10, ATOM3CH05_TOUT115_SEL0_PORT01_PIN07, ATOM3CH05_TOUT064_SEL9_PORT20_PIN08, ATOM3CH05_TOUT166_SEL9_PORT00_PIN14, ATOM3CH05_TOUT132_SEL3_PORT22_PIN06, ATOM3CH05_TOUT052_SEL3_PORT21_PIN01, ATOM3CH05_TOUT035_SEL3_PORT33_PIN13, ATOM3CH05_TOUT099_SEL3_PORT11_PIN10, ATOM3CH05_TOUT091_SEL3_PORT13_PIN00, ATOM3CH06_TOUT133_SEL3_PORT22_PIN07, ATOM3CH06_TOUT036_SEL3_PORT32_PIN00, ATOM3CH06_TOUT143_SELB_PORT33_PIN14, ATOM3CH06_TOUT168_SEL9_PORT00_PIN15, ATOM3CH06_TOUT062_SEL3_PORT20_PIN06, ATOM3CH06_TOUT100_SEL3_PORT11_PIN11, ATOM3CH06_TOUT092_SEL3_PORT13_PIN01, ATOM3CH07_TOUT144_SELB_PORT33_PIN15, ATOM3CH07_TOUT093_SEL3_PORT13_PIN02, ATOM3CH07_TOUT037_SEL9_PORT32_PIN01, ATOM3CH07_TOUT037_SEL3_PORT32_PIN01, ATOM3CH07_TOUT134_SEL3_PORT22_PIN08, ATOM3CH07_TOUT101_SEL3_PORT11_PIN12, ATOM3CH07_TOUT063_SEL3_PORT20_PIN07, ATOM4CH00_TOUT087_SEL3_PORT14_PIN07, ATOM4CH00_TOUT068_SEL3_PORT20_PIN12, ATOM4CH00_TOUT077_SEL3_PORT15_PIN06, ATOM4CH00_TOUT109_SEL3_PORT10_PIN07, ATOM4CH00_TOUT039_SEL8_PORT32_PIN03, ATOM4CH00_TOUT053_SEL3_PORT21_PIN02, ATOM4CH00_TOUT085_SEL3_PORT14_PIN05, ATOM4CH00_TOUT076_SEL3_PORT15_PIN05, ATOM4CH00_TOUT048_SEL3_PORT22_PIN01, ATOM4CH01_TOUT078_SEL3_PORT15_PIN07, ATOM4CH01_TOUT069_SEL3_PORT20_PIN13, ATOM4CH01_TOUT103_SEL3_PORT10_PIN01, ATOM4CH01_TOUT086_SEL3_PORT14_PIN06, ATOM4CH01_TOUT054_SEL3_PORT21_PIN03, ATOM4CH01_TOUT084_SEL3_PORT14_PIN04, ATOM4CH01_TOUT047_SEL3_PORT22_PIN00, ATOM4CH01_TOUT079_SEL3_PORT15_PIN08, ATOM4CH02_TOUT107_SEL3_PORT10_PIN05, ATOM4CH02_TOUT070_SEL3_PORT20_PIN14, ATOM4CH02_TOUT042_SEL9_PORT23_PIN01, ATOM4CH02_TOUT104_SEL3_PORT10_PIN02, ATOM4CH02_TOUT080_SEL3_PORT14_PIN00, ATOM4CH02_TOUT055_SEL3_PORT21_PIN04, ATOM4CH02_TOUT046_SEL3_PORT23_PIN05, ATOM4CH02_TOUT083_SEL3_PORT14_PIN03, ATOM4CH03_TOUT108_SEL3_PORT10_PIN06, ATOM4CH03_TOUT071_SEL3_PORT15_PIN00, ATOM4CH03_TOUT056_SEL3_PORT21_PIN05, ATOM4CH03_TOUT105_SEL3_PORT10_PIN03, ATOM4CH03_TOUT082_SEL3_PORT14_PIN02, ATOM4CH03_TOUT043_SEL9_PORT23_PIN02, ATOM4CH03_TOUT049_SEL3_PORT22_PIN02, ATOM4CH04_TOUT081_SEL3_PORT14_PIN01, ATOM4CH04_TOUT050_SEL3_PORT22_PIN03, ATOM4CH04_TOUT057_SEL3_PORT21_PIN06, ATOM4CH04_TOUT111_SEL8_PORT01_PIN03, ATOM4CH04_TOUT072_SEL3_PORT15_PIN01, ATOM4CH04_TOUT102_SEL3_PORT10_PIN00, ATOM4CH04_TOUT044_SEL9_PORT23_PIN03, ATOM4CH04_TOUT131_SEL9_PORT22_PIN05, ATOM4CH04_TOUT264_SEL9_PORT13_PIN15, ATOM4CH05_TOUT130_SEL9_PORT22_PIN04, ATOM4CH05_TOUT058_SEL3_PORT21_PIN07, ATOM4CH05_TOUT110_SEL3_PORT10_PIN08, ATOM4CH05_TOUT056_SELA_PORT21_PIN05, ATOM4CH05_TOUT116_SEL0_PORT02_PIN09, ATOM4CH05_TOUT045_SEL9_PORT23_PIN04, ATOM4CH05_TOUT065_SEL3_PORT20_PIN09, ATOM4CH05_TOUT128_SEL9_PORT12_PIN00, ATOM4CH05_TOUT073_SEL3_PORT15_PIN02, ATOM4CH06_TOUT129_SEL9_PORT12_PIN01, ATOM4CH06_TOUT074_SEL3_PORT15_PIN03, ATOM4CH06_TOUT117_SEL0_PORT02_PIN10, ATOM4CH06_TOUT046_SEL9_PORT23_PIN05, ATOM4CH06_TOUT066_SEL3_PORT20_PIN10, ATOM4CH06_TOUT139_SEL9_PORT23_PIN07, ATOM4CH06_TOUT059_SEL3_PORT20_PIN00, ATOM4CH06_TOUT106_SEL3_PORT10_PIN04, ATOM4CH07_TOUT064_SEL3_PORT20_PIN08, ATOM4CH07_TOUT067_SEL3_PORT20_PIN11, ATOM4CH07_TOUT119_SEL9_PORT11_PIN00, ATOM4CH07_TOUT118_SEL0_PORT02_PIN11, ATOM4CH07_TOUT040_SEL8_PORT32_PIN04, ATOM4CH07_TOUT075_SEL3_PORT15_PIN04, ATOM4CH07_TOUT138_SEL9_PORT23_PIN06, ATOM5CH00_TOUT174_SEL2_PORT31_PIN00, ATOM5CH00_TOUT146_SELA_PORT34_PIN01, ATOM5CH00_TOUT249_SEL2_PORT13_PIN12, ATOM5CH00_TOUT162_SEL8_PORT01_PIN08, ATOM5CH00_TOUT206_SEL2_PORT25_PIN00, ATOM5CH00_TOUT258_SEL8_PORT14_PIN11, ATOM5CH00_TOUT130_SELA_PORT22_PIN04, ATOM5CH00_TOUT119_SEL2_PORT11_PIN00, ATOM5CH00_TOUT155_SEL2_PORT01_PIN00, ATOM5CH01_TOUT147_SELA_PORT34_PIN02, ATOM5CH01_TOUT207_SEL2_PORT25_PIN01, ATOM5CH01_TOUT253_SEL8_PORT13_PIN04, ATOM5CH01_TOUT265_SEL2_PORT10_PIN09, ATOM5CH01_TOUT164_SEL8_PORT01_PIN14, ATOM5CH01_TOUT156_SEL2_PORT01_PIN02, ATOM5CH01_TOUT175_SEL2_PORT31_PIN01, ATOM5CH01_TOUT120_SEL2_PORT11_PIN01, ATOM5CH01_TOUT131_SELA_PORT22_PIN05, ATOM5CH01_TOUT242_SEL2_PORT15_PIN10, ATOM5CH02_TOUT254_SEL8_PORT13_PIN05, ATOM5CH02_TOUT132_SELA_PORT22_PIN06, ATOM5CH02_TOUT208_SEL2_PORT25_PIN02, ATOM5CH02_TOUT148_SELA_PORT34_PIN03, ATOM5CH02_TOUT157_SEL2_PORT01_PIN15, ATOM5CH02_TOUT243_SEL2_PORT15_PIN11, ATOM5CH02_TOUT266_SEL2_PORT10_PIN10, ATOM5CH02_TOUT152_SEL8_PORT02_PIN15, ATOM5CH02_TOUT176_SEL2_PORT31_PIN02, ATOM5CH02_TOUT121_SEL2_PORT11_PIN04, ATOM5CH03_TOUT122_SEL2_PORT11_PIN05, ATOM5CH03_TOUT209_SEL2_PORT25_PIN03, ATOM5CH03_TOUT244_SEL2_PORT15_PIN12, ATOM5CH03_TOUT133_SELA_PORT22_PIN07, ATOM5CH03_TOUT163_SEL8_PORT01_PIN10, ATOM5CH03_TOUT267_SEL2_PORT10_PIN14, ATOM5CH03_TOUT149_SELA_PORT34_PIN04, ATOM5CH03_TOUT177_SEL2_PORT31_PIN03, ATOM5CH03_TOUT165_SEL2_PORT01_PIN11, ATOM5CH03_TOUT255_SEL8_PORT13_PIN06, ATOM5CH04_TOUT123_SEL2_PORT11_PIN07, ATOM5CH04_TOUT248_SEL8_PORT13_PIN09, ATOM5CH04_TOUT178_SEL2_PORT31_PIN04, ATOM5CH04_TOUT134_SELA_PORT22_PIN08, ATOM5CH04_TOUT245_SEL2_PORT15_PIN13, ATOM5CH04_TOUT210_SEL2_PORT25_PIN04, ATOM5CH04_TOUT150_SELA_PORT34_PIN05, ATOM5CH04_TOUT268_SEL2_PORT10_PIN13, ATOM5CH04_TOUT158_SEL2_PORT01_PIN12, ATOM5CH05_TOUT124_SEL2_PORT11_PIN08, ATOM5CH05_TOUT246_SEL2_PORT15_PIN14, ATOM5CH05_TOUT179_SEL2_PORT31_PIN05, ATOM5CH05_TOUT269_SEL2_PORT10_PIN11, ATOM5CH05_TOUT250_SEL8_PORT13_PIN11, ATOM5CH05_TOUT159_SEL2_PORT01_PIN01, ATOM5CH05_TOUT140_SEL9_PORT32_PIN05, ATOM5CH05_TOUT135_SELA_PORT22_PIN09, ATOM5CH05_TOUT211_SEL2_PORT25_PIN05, ATOM5CH06_TOUT270_SEL2_PORT10_PIN15, ATOM5CH06_TOUT180_SEL2_PORT31_PIN06, ATOM5CH06_TOUT141_SEL9_PORT32_PIN06, ATOM5CH06_TOUT125_SEL2_PORT11_PIN13, ATOM5CH06_TOUT136_SELA_PORT22_PIN10, ATOM5CH06_TOUT212_SEL2_PORT25_PIN06, ATOM5CH06_TOUT212_SEL2_PORT26_PIN00, ATOM5CH06_TOUT160_SEL2_PORT01_PIN09, ATOM5CH06_TOUT247_SEL2_PORT15_PIN15, ATOM5CH06_TOUT249_SEL8_PORT13_PIN12, ATOM5CH07_TOUT126_SEL2_PORT11_PIN14, ATOM5CH07_TOUT137_SELA_PORT22_PIN11, ATOM5CH07_TOUT213_SEL2_PORT25_PIN07, ATOM5CH07_TOUT181_SEL2_PORT31_PIN07, ATOM5CH07_TOUT248_SEL2_PORT13_PIN09, ATOM5CH07_TOUT161_SEL2_PORT01_PIN13, ATOM5CH07_TOUT142_SEL9_PORT32_PIN07, ATOM6CH00_TOUT162_SEL9_PORT01_PIN08, ATOM6CH00_TOUT182_SEL2_PORT31_PIN08, ATOM6CH00_TOUT242_SEL8_PORT15_PIN10, ATOM6CH00_TOUT214_SEL2_PORT25_PIN08, ATOM6CH00_TOUT141_SEL2_PORT32_PIN06, ATOM6CH00_TOUT127_SEL2_PORT11_PIN15, ATOM6CH00_TOUT250_SEL2_PORT13_PIN11, ATOM6CH00_TOUT155_SEL3_PORT01_PIN00, ATOM6CH01_TOUT215_SEL2_PORT25_PIN09, ATOM6CH01_TOUT164_SEL9_PORT01_PIN14, ATOM6CH01_TOUT128_SEL2_PORT12_PIN00, ATOM6CH01_TOUT183_SEL2_PORT31_PIN09, ATOM6CH01_TOUT251_SEL2_PORT13_PIN10, ATOM6CH01_TOUT142_SEL2_PORT32_PIN07, ATOM6CH01_TOUT258_SEL2_PORT14_PIN11, ATOM6CH01_TOUT156_SEL3_PORT01_PIN02, ATOM6CH02_TOUT129_SEL2_PORT12_PIN01, ATOM6CH02_TOUT157_SEL3_PORT01_PIN15, ATOM6CH02_TOUT152_SEL9_PORT02_PIN15, ATOM6CH02_TOUT216_SEL2_PORT25_PIN10, ATOM6CH02_TOUT252_SEL2_PORT13_PIN14, ATOM6CH02_TOUT184_SEL2_PORT31_PIN10, ATOM6CH02_TOUT259_SEL2_PORT14_PIN14, ATOM6CH02_TOUT143_SEL2_PORT33_PIN14, ATOM6CH03_TOUT144_SEL2_PORT33_PIN15, ATOM6CH03_TOUT217_SEL2_PORT25_PIN11, ATOM6CH03_TOUT163_SEL9_PORT01_PIN10, ATOM6CH03_TOUT185_SEL2_PORT31_PIN11, ATOM6CH03_TOUT165_SEL3_PORT01_PIN11, ATOM6CH03_TOUT253_SEL2_PORT13_PIN04, ATOM6CH03_TOUT111_SEL9_PORT01_PIN03, ATOM6CH03_TOUT260_SEL2_PORT14_PIN13, ATOM6CH04_TOUT158_SEL3_PORT01_PIN12, ATOM6CH04_TOUT254_SEL2_PORT13_PIN05, ATOM6CH04_TOUT140_SEL8_PORT32_PIN05, ATOM6CH04_TOUT218_SEL2_PORT25_PIN12, ATOM6CH04_TOUT186_SEL2_PORT31_PIN12, ATOM6CH04_TOUT143_SEL3_PORT33_PIN14, ATOM6CH04_TOUT031_SEL8_PORT33_PIN09, ATOM6CH04_TOUT261_SEL2_PORT14_PIN12, ATOM6CH05_TOUT255_SEL2_PORT13_PIN06, ATOM6CH05_TOUT262_SEL2_PORT13_PIN13, ATOM6CH05_TOUT219_SEL2_PORT25_PIN13, ATOM6CH05_TOUT187_SEL2_PORT31_PIN13, ATOM6CH05_TOUT159_SEL3_PORT01_PIN01, ATOM6CH05_TOUT243_SEL8_PORT15_PIN11, ATOM6CH05_TOUT146_SEL2_PORT34_PIN01, ATOM6CH06_TOUT256_SEL2_PORT13_PIN07, ATOM6CH06_TOUT263_SEL2_PORT14_PIN15, ATOM6CH06_TOUT188_SEL2_PORT31_PIN14, ATOM6CH06_TOUT160_SEL3_PORT01_PIN09, ATOM6CH06_TOUT147_SEL2_PORT34_PIN02, ATOM6CH06_TOUT220_SEL2_PORT25_PIN14, ATOM6CH07_TOUT161_SEL3_PORT01_PIN13, ATOM6CH07_TOUT244_SEL8_PORT15_PIN12, ATOM6CH07_TOUT264_SEL2_PORT13_PIN15, ATOM6CH07_TOUT148_SEL2_PORT34_PIN03, ATOM6CH07_TOUT221_SEL2_PORT25_PIN15, ATOM6CH07_TOUT189_SEL2_PORT31_PIN15, ATOM7CH00_TOUT249_SEL3_PORT13_PIN12, ATOM7CH00_TOUT149_SEL2_PORT34_PIN04, ATOM7CH00_TOUT222_SEL2_PORT24_PIN00, ATOM7CH00_TOUT190_SEL2_PORT30_PIN00, ATOM7CH00_TOUT258_SEL9_PORT14_PIN11, ATOM7CH00_TOUT162_SEL2_PORT01_PIN08, ATOM7CH01_TOUT245_SEL9_PORT15_PIN13, ATOM7CH01_TOUT253_SEL9_PORT13_PIN04, ATOM7CH01_TOUT191_SEL2_PORT30_PIN01, ATOM7CH01_TOUT163_SEL2_PORT01_PIN10, ATOM7CH01_TOUT223_SEL2_PORT24_PIN01, ATOM7CH01_TOUT242_SEL3_PORT15_PIN10, ATOM7CH01_TOUT150_SEL2_PORT34_PIN05, ATOM7CH01_TOUT265_SEL3_PORT10_PIN09, ATOM7CH02_TOUT164_SEL2_PORT01_PIN14, ATOM7CH02_TOUT266_SEL3_PORT10_PIN10, ATOM7CH02_TOUT246_SEL9_PORT15_PIN14, ATOM7CH02_TOUT224_SEL2_PORT24_PIN02, ATOM7CH02_TOUT192_SEL2_PORT30_PIN02, ATOM7CH02_TOUT243_SEL3_PORT15_PIN11, ATOM7CH02_TOUT254_SEL9_PORT13_PIN05, ATOM7CH03_TOUT247_SEL9_PORT15_PIN15, ATOM7CH03_TOUT193_SEL2_PORT30_PIN03, ATOM7CH03_TOUT255_SEL9_PORT13_PIN06, ATOM7CH03_TOUT244_SEL3_PORT15_PIN12, ATOM7CH03_TOUT166_SEL2_PORT00_PIN14, ATOM7CH03_TOUT267_SEL3_PORT10_PIN14, ATOM7CH03_TOUT225_SEL2_PORT24_PIN03, ATOM7CH04_TOUT226_SEL2_PORT24_PIN04, ATOM7CH04_TOUT268_SEL3_PORT10_PIN13, ATOM7CH04_TOUT248_SEL9_PORT13_PIN09, ATOM7CH04_TOUT245_SEL3_PORT15_PIN13, ATOM7CH04_TOUT194_SEL2_PORT30_PIN04, ATOM7CH04_TOUT167_SEL2_PORT00_PIN13, ATOM7CH05_TOUT246_SEL3_PORT15_PIN14, ATOM7CH05_TOUT168_SEL2_PORT00_PIN15, ATOM7CH05_TOUT195_SEL2_PORT30_PIN05, ATOM7CH05_TOUT227_SEL2_PORT24_PIN05, ATOM7CH05_TOUT269_SEL3_PORT10_PIN11, ATOM7CH05_TOUT251_SEL9_PORT13_PIN10, ATOM7CH06_TOUT196_SEL2_PORT30_PIN06, ATOM7CH06_TOUT153_SEL2_PORT02_PIN13, ATOM7CH06_TOUT270_SEL3_PORT10_PIN15, ATOM7CH06_TOUT228_SEL2_PORT24_PIN06, ATOM7CH06_TOUT249_SEL9_PORT13_PIN12, ATOM7CH06_TOUT247_SEL3_PORT15_PIN15, ATOM7CH06_TOUT151_SEL2_PORT02_PIN12, ATOM7CH07_TOUT161_SELA_PORT01_PIN13, ATOM7CH07_TOUT152_SEL2_PORT02_PIN15, ATOM7CH07_TOUT154_SEL2_PORT02_PIN14, ATOM7CH07_TOUT261_SEL9_PORT14_PIN12, ATOM7CH07_TOUT197_SEL2_PORT30_PIN07, ATOM7CH07_TOUT229_SEL2_PORT24_PIN07, ATOM7CH07_TOUT248_SEL3_PORT13_PIN09}, origin=ChipowerTech, post-build-variant-value=true, set at post-build, default-value=ATOMXCHXX_NO_USED_ATOM_CHANNEL  # This decides the output port and pin for the ATOM Channel. This parameter is not applicable in case of configuration using BMD. In such a case, GtmToutConfiguration should be used instead.
      container Tim [8..8]: requires-index=true  # This container contains the TIM Configuration for GTM
        container TimChannel [8..8]: requires-index=true  # This container contains the TIM Channel Configuration
          container TimChannelGeneral  # This container contains the TIM Channel General Configuration
            integer TimId: 0..7, scope=ECU, origin=ChipowerTech, set at pre-compile, default-value=0  # Id of the TIM Cluster.
            integer ChannelId: 0..7, scope=ECU, origin=ChipowerTech, set at pre-compile, default-value=0  # Id of the TIM channel.
            enumeration TimChannelPortPinSelect: {TIM_CHANNEL_IS_NOUSED_SEL00, TIM0_CH0_PORT00_PIN09_SEL01, TIM0_CH0_PORT02_PIN00_SEL02, TIM0_CH0_PORT10_PIN07_SEL03, TIM0_CH0_PORT14_PIN05_SEL04, TIM0_CH0_PORT14_PIN07_SEL05, TIM0_CH0_PORT15_PIN06_SEL06, TIM0_CH0_PORT21_PIN02_SEL07, TIM0_CH0_PORT22_PIN01_SEL08, TIM0_CH0_PORT33_PIN10_SEL09, TIM0_CH0_PORT33_PIN04_SEL10, TIM0_CH0_DSADC_SRM0_0_SEL0E, TIM0_CH0_DSADC_SRM1_1_SEL0E, TIM0_CH0_DSADC_SRM2_2_SEL0E, TIM0_CH0_DSADC_SRM3_3_SEL0E, TIM0_CH0_DSADC_SRM4_4_SEL0E, TIM0_CH0_DSADC_SRM5_5_SEL0E, TIM0_CH0_DSADC_SRM6_6_SEL0E, TIM0_CH0_DSADC_SRM7_7_SEL0E, TIM0_CH0_DSADC_SRM8_8_SEL0E, TIM0_CH0_DSADC_SRM9_9_SEL0E, TIM0_CH0_DSADC_SAUL0_A_SEL0E, TIM0_CH0_DSADC_SBLL0_B_SEL0E, TIM0_CH0_DSADC_SAUL1_C_SEL0E, TIM0_CH0_DSADC_SBLL1_D_SEL0E, TIM0_CH1_PORT00_PIN10_SEL01, TIM0_CH1_PORT02_PIN01_SEL02, TIM0_CH1_PORT10_PIN01_SEL03, TIM0_CH1_PORT14_PIN06_SEL04, TIM0_CH1_PORT15_PIN07_SEL05, TIM0_CH1_PORT21_PIN03_SEL06, TIM0_CH1_PORT22_PIN00_SEL07, TIM0_CH1_PORT33_PIN05_SEL08, TIM0_CH1_PORT33_PIN09_SEL09, TIM0_CH1_PORT10_PIN09_SEL10, TIM0_CH1_DSADC_SRM0_0_SEL0E, TIM0_CH1_DSADC_SRM1_1_SEL0E, TIM0_CH1_DSADC_SRM2_2_SEL0E, TIM0_CH1_DSADC_SRM3_3_SEL0E, TIM0_CH1_DSADC_SRM4_4_SEL0E, TIM0_CH1_DSADC_SRM5_5_SEL0E, TIM0_CH1_DSADC_SRM6_6_SEL0E, TIM0_CH1_DSADC_SRM7_7_SEL0E, TIM0_CH1_DSADC_SRM8_8_SEL0E, TIM0_CH1_DSADC_SRM9_9_SEL0E, TIM0_CH1_DSADC_SAUL1_A_SEL0E, TIM0_CH1_DSADC_SBLL1_B_SEL0E, TIM0_CH1_DSADC_SAUL0_C_SEL0E, TIM0_CH1_DSADC_SBLL0_D_SEL0E, TIM0_CH2_PORT00_PIN11_SEL01, TIM0_CH2_PORT02_PIN02_SEL02, TIM0_CH2_PORT10_PIN02_SEL03, TIM0_CH2_PORT10_PIN05_SEL04, TIM0_CH2_PORT15_PIN08_SEL05, TIM0_CH2_PORT21_PIN04_SEL06, TIM0_CH2_PORT23_PIN05_SEL07, TIM0_CH2_PORT33_PIN11_SEL08, TIM0_CH2_PORT33_PIN06_SEL09, TIM0_CH2_PORT02_PIN09_SEL10, TIM0_CH2_PORT10_PIN10_SEL11, TIM0_CH2_DSADC_SRM0_0_SEL0E, TIM0_CH2_DSADC_SRM1_1_SEL0E, TIM0_CH2_DSADC_SRM2_2_SEL0E, TIM0_CH2_DSADC_SRM3_3_SEL0E, TIM0_CH2_DSADC_SRM4_4_SEL0E, TIM0_CH2_DSADC_SRM5_5_SEL0E, TIM0_CH2_DSADC_SRM6_6_SEL0E, TIM0_CH2_DSADC_SRM7_7_SEL0E, TIM0_CH2_DSADC_SRM8_8_SEL0E, TIM0_CH2_DSADC_SRM9_9_SEL0E, TIM0_CH2_DSADC_SAUL2_A_SEL0E, TIM0_CH2_DSADC_SBLL2_B_SEL0E, TIM0_CH2_DSADC_SAUL3_C_SEL0E, TIM0_CH2_DSADC_SBLL3_D_SEL0E, TIM0_CH3_PORT00_PIN12_SEL01, TIM0_CH3_PORT02_PIN03_SEL02, TIM0_CH3_PORT10_PIN03_SEL03, TIM0_CH3_PORT10_PIN06_SEL04, TIM0_CH3_PORT14_PIN00_SEL05, TIM0_CH3_PORT21_PIN05_SEL06, TIM0_CH3_PORT22_PIN02_SEL07, TIM0_CH3_PORT32_PIN02_SEL08, TIM0_CH3_PORT33_PIN07_SEL09, TIM0_CH3_PORT02_PIN10_SEL10, TIM0_CH3_PORT10_PIN14_SEL11, TIM0_CH3_DSADC_SRM0_0_SEL0E, TIM0_CH3_DSADC_SRM1_1_SEL0E, TIM0_CH3_DSADC_SRM2_2_SEL0E, TIM0_CH3_DSADC_SRM3_3_SEL0E, TIM0_CH3_DSADC_SAUL3_A_SEL0E, TIM0_CH3_DSADC_SBLL3_B_SEL0E, TIM0_CH3_DSADC_SAUL2_C_SEL0E, TIM0_CH3_DSADC_SBLL2_D_SEL0E, TIM0_CH4_PORT02_PIN04_SEL01, TIM0_CH4_PORT10_PIN00_SEL02, TIM0_CH4_PORT14_PIN01_SEL03, TIM0_CH4_PORT22_PIN03_SEL04, TIM0_CH4_PORT32_PIN03_SEL05, TIM0_CH4_PORT33_PIN00_SEL06, TIM0_CH4_PORT33_PIN08_SEL07, TIM0_CH4_PORT21_PIN06_SEL08, TIM0_CH4_PORT10_PIN13_SEL09, TIM0_CH4_DSADC_SRM0_0_SEL0E, TIM0_CH4_DSADC_SRM1_1_SEL0E, TIM0_CH4_DSADC_SRM2_2_SEL0E, TIM0_CH4_DSADC_SRM3_3_SEL0E, TIM0_CH4_DSADC_SRM4_4_SEL0E, TIM0_CH4_DSADC_SRM5_5_SEL0E, TIM0_CH4_DSADC_SRM6_6_SEL0E, TIM0_CH4_DSADC_SRM7_7_SEL0E, TIM0_CH4_DSADC_SRM8_8_SEL0E, TIM0_CH4_DSADC_SRM9_9_SEL0E, TIM0_CH4_DSADC_SAUL4_A_SEL0E, TIM0_CH4_DSADC_SBLL4_B_SEL0E, TIM0_CH4_DSADC_SAUL5_C_SEL0E, TIM0_CH4_DSADC_SBLL5_D_SEL0E, TIM0_CH5_PORT02_PIN05_SEL01, TIM0_CH5_PORT10_PIN08_SEL02, TIM0_CH5_PORT14_PIN02_SEL03, TIM0_CH5_PORT23_PIN00_SEL04, TIM0_CH5_PORT32_PIN04_SEL05, TIM0_CH5_PORT33_PIN01_SEL06, TIM0_CH5_PORT21_PIN07_SEL07, TIM0_CH5_PORT01_PIN03_SEL08, TIM0_CH5_PORT10_PIN11_SEL09, TIM0_CH5_DSADC_SRM0_0_SEL0E, TIM0_CH5_DSADC_SRM1_1_SEL0E, TIM0_CH5_DSADC_SRM2_2_SEL0E, TIM0_CH5_DSADC_SRM3_3_SEL0E, TIM0_CH5_DSADC_SRM4_4_SEL0E, TIM0_CH5_DSADC_SRM5_5_SEL0E, TIM0_CH5_DSADC_SRM6_6_SEL0E, TIM0_CH5_DSADC_SRM7_7_SEL0E, TIM0_CH5_DSADC_SRM8_8_SEL0E, TIM0_CH5_DSADC_SRM9_9_SEL0E, TIM0_CH5_DSADC_SAUL5_A_SEL0E, TIM0_CH5_DSADC_SBLL5_B_SEL0E, TIM0_CH5_DSADC_SAUL4_C_SEL0E, TIM0_CH5_DSADC_SBLL4_D_SEL0E, TIM0_CH6_PORT02_PIN06_SEL01, TIM0_CH6_PORT10_PIN04_SEL02, TIM0_CH6_PORT14_PIN03_SEL03, TIM0_CH6_PORT23_PIN01_SEL04, TIM0_CH6_PORT23_PIN02_SEL05, TIM0_CH6_PORT33_PIN02_SEL06, TIM0_CH6_PORT20_PIN00_SEL07, TIM0_CH6_PORT01_PIN04_SEL08, TIM0_CH6_PORT10_PIN15_SEL09, TIM0_CH6_DSADC_SRM0_0_SEL0E, TIM0_CH6_DSADC_SRM1_1_SEL0E, TIM0_CH6_DSADC_SRM2_2_SEL0E, TIM0_CH6_DSADC_SRM3_3_SEL0E, TIM0_CH6_DSADC_SRM4_4_SEL0E, TIM0_CH6_DSADC_SRM5_5_SEL0E, TIM0_CH6_DSADC_SRM6_6_SEL0E, TIM0_CH6_DSADC_SRM7_7_SEL0E, TIM0_CH6_DSADC_SRM8_8_SEL0E, TIM0_CH6_DSADC_SRM9_9_SEL0E, TIM0_CH6_DSADC_SAUL6_A_SEL0E, TIM0_CH6_DSADC_SBLL6_B_SEL0E, TIM0_CH6_DSADC_SAUL7_C_SEL0E, TIM0_CH6_DSADC_SBLL7_D_SEL0E, TIM0_CH7_PORT02_PIN07_SEL01, TIM0_CH7_PORT14_PIN04_SEL02, TIM0_CH7_PORT20_PIN08_SEL03, TIM0_CH7_PORT23_PIN03_SEL04, TIM0_CH7_PORT23_PIN04_SEL05, TIM0_CH7_PORT33_PIN03_SEL06, TIM0_CH7_PORT02_PIN11_SEL07, TIM0_CH7_PORT11_PIN15_SEL08, TIM0_CH7_DSADC_SRM0_0_SEL0E, TIM0_CH7_DSADC_SRM1_1_SEL0E, TIM0_CH7_DSADC_SRM2_2_SEL0E, TIM0_CH7_DSADC_SRM3_3_SEL0E, TIM0_CH7_DSADC_SRM4_4_SEL0E, TIM0_CH7_DSADC_SRM5_5_SEL0E, TIM0_CH7_DSADC_SRM6_6_SEL0E, TIM0_CH7_DSADC_SRM7_7_SEL0E, TIM0_CH7_DSADC_SRM8_8_SEL0E, TIM0_CH7_DSADC_SRM9_9_SEL0E, TIM0_CH7_DSADC_SAUL7_A_SEL0E, TIM0_CH7_DSADC_SBLL7_B_SEL0E, TIM0_CH7_DSADC_SAUL6_C_SEL0E, TIM0_CH7_DSADC_SBLL6_D_SEL0E, TIM1_CH0_PORT02_PIN00_SEL02, TIM1_CH0_PORT00_PIN09_SEL01, TIM1_CH0_PORT10_PIN07_SEL03, TIM1_CH0_PORT14_PIN05_SEL04, TIM1_CH0_PORT14_PIN07_SEL05, TIM1_CH0_PORT15_PIN06_SEL06, TIM1_CH0_PORT21_PIN02_SEL07, TIM1_CH0_PORT22_PIN01_SEL08, TIM1_CH0_PORT33_PIN10_SEL09, TIM1_CH0_PORT33_PIN04_SEL10, TIM1_CH0_DSADC_SRM0_0_SEL0B, TIM1_CH0_DSADC_SRM1_1_SEL0B, TIM1_CH0_DSADC_SRM2_2_SEL0B, TIM1_CH0_DSADC_SRM3_3_SEL0B, TIM1_CH0_DSADC_SRM4_4_SEL0B, TIM1_CH0_DSADC_SRM5_5_SEL0B, TIM1_CH0_DSADC_SRM6_6_SEL0B, TIM1_CH0_DSADC_SRM7_7_SEL0B, TIM1_CH0_DSADC_SRM8_8_SEL0B, TIM1_CH0_DSADC_SRM9_9_SEL0B, TIM1_CH0_DSADC_SAUL0_A_SEL0B, TIM1_CH0_DSADC_SBLL0_B_SEL0B, TIM1_CH0_DSADC_SAUL1_C_SEL0B, TIM1_CH0_DSADC_SBLL1_D_SEL0B, TIM1_CH1_PORT02_PIN01_SEL02, TIM1_CH1_PORT00_PIN10_SEL01, TIM1_CH1_PORT10_PIN01_SEL03, TIM1_CH1_PORT14_PIN06_SEL04, TIM1_CH1_PORT15_PIN07_SEL05, TIM1_CH1_PORT21_PIN03_SEL06, TIM1_CH1_PORT22_PIN00_SEL07, TIM1_CH1_PORT33_PIN05_SEL08, TIM1_CH1_PORT33_PIN09_SEL09, TIM1_CH1_DSADC_SRM0_0_SEL0B, TIM1_CH1_DSADC_SRM1_1_SEL0B, TIM1_CH1_DSADC_SRM2_2_SEL0B, TIM1_CH1_DSADC_SRM3_3_SEL0B, TIM1_CH1_DSADC_SRM4_4_SEL0B, TIM1_CH1_DSADC_SRM5_5_SEL0B, TIM1_CH1_DSADC_SRM6_6_SEL0B, TIM1_CH1_DSADC_SRM7_7_SEL0B, TIM1_CH1_DSADC_SRM8_8_SEL0B, TIM1_CH1_DSADC_SRM9_9_SEL0B, TIM1_CH1_DSADC_SAUL1_A_SEL0B, TIM1_CH1_DSADC_SBLL1_B_SEL0B, TIM1_CH1_DSADC_SAUL0_C_SEL0B, TIM1_CH1_DSADC_SBLL0_D_SEL0B, TIM1_CH2_PORT02_PIN02_SEL02, TIM1_CH2_PORT00_PIN11_SEL01, TIM1_CH2_PORT10_PIN02_SEL03, TIM1_CH2_PORT10_PIN05_SEL04, TIM1_CH2_PORT15_PIN08_SEL05, TIM1_CH2_PORT21_PIN04_SEL06, TIM1_CH2_PORT23_PIN05_SEL07, TIM1_CH2_PORT33_PIN11_SEL08, TIM1_CH2_PORT33_PIN06_SEL09, TIM1_CH2_PORT23_PIN06_SEL10, TIM1_CH2_DSADC_SRM0_0_SEL0B, TIM1_CH2_DSADC_SRM1_1_SEL0B, TIM1_CH2_DSADC_SRM2_2_SEL0B, TIM1_CH2_DSADC_SRM3_3_SEL0B, TIM1_CH2_DSADC_SRM4_4_SEL0B, TIM1_CH2_DSADC_SRM5_5_SEL0B, TIM1_CH2_DSADC_SRM6_6_SEL0B, TIM1_CH2_DSADC_SRM7_7_SEL0B, TIM1_CH2_DSADC_SRM8_8_SEL0B, TIM1_CH2_DSADC_SRM9_9_SEL0B, TIM1_CH2_DSADC_SAUL2_A_SEL0B, TIM1_CH2_DSADC_SBLL2_B_SEL0B, TIM1_CH2_DSADC_SAUL3_C_SEL0B, TIM1_CH2_DSADC_SBLL3_D_SEL0B, TIM1_CH3_PORT02_PIN03_SEL02, TIM1_CH3_PORT00_PIN12_SEL01, TIM1_CH3_PORT10_PIN03_SEL03, TIM1_CH3_PORT10_PIN06_SEL04, TIM1_CH3_PORT14_PIN00_SEL05, TIM1_CH3_PORT21_PIN05_SEL06, TIM1_CH3_PORT22_PIN02_SEL07, TIM1_CH3_PORT32_PIN02_SEL08, TIM1_CH3_PORT33_PIN07_SEL09, TIM1_CH3_PORT23_PIN07_SEL10, TIM1_CH3_DSADC_SRM0_0_SEL0E, TIM1_CH3_DSADC_SRM1_1_SEL0E, TIM1_CH3_DSADC_SRM2_2_SEL0E, TIM1_CH3_DSADC_SRM3_3_SEL0E, TIM1_CH3_DSADC_SRM4_4_SEL0E, TIM1_CH3_DSADC_SRM5_5_SEL0E, TIM1_CH3_DSADC_SRM6_6_SEL0E, TIM1_CH3_DSADC_SRM7_7_SEL0E, TIM1_CH3_DSADC_SRM8_8_SEL0E, TIM1_CH3_DSADC_SRM9_9_SEL0E, TIM1_CH3_DSADC_SAUL3_A_SEL0E, TIM1_CH3_DSADC_SBLL3_B_SEL0E, TIM1_CH3_DSADC_SAUL2_C_SEL0E, TIM1_CH3_DSADC_SBLL2_D_SEL0E, TIM1_CH4_PORT02_PIN04_SEL01, TIM1_CH4_PORT10_PIN00_SEL02, TIM1_CH4_PORT14_PIN01_SEL03, TIM1_CH4_PORT20_PIN00_SEL09, TIM1_CH4_PORT21_PIN06_SEL08, TIM1_CH4_PORT22_PIN03_SEL04, TIM1_CH4_PORT32_PIN03_SEL05, TIM1_CH4_PORT33_PIN00_SEL06, TIM1_CH4_PORT33_PIN08_SEL07, TIM1_CH4_DSADC_SRM0_0_SEL0E, TIM1_CH4_DSADC_SRM1_1_SEL0E, TIM1_CH4_DSADC_SRM2_2_SEL0E, TIM1_CH4_DSADC_SRM3_3_SEL0E, TIM1_CH4_DSADC_SRM4_4_SEL0E, TIM1_CH4_DSADC_SRM5_5_SEL0E, TIM1_CH4_DSADC_SRM6_6_SEL0E, TIM1_CH4_DSADC_SRM7_7_SEL0E, TIM1_CH4_DSADC_SRM8_8_SEL0E, TIM1_CH4_DSADC_SRM9_9_SEL0E, TIM1_CH4_DSADC_SAUL4_A_SEL0E, TIM1_CH4_DSADC_SBLL4_B_SEL0E, TIM1_CH4_DSADC_SAUL5_C_SEL0E, TIM1_CH4_DSADC_SBLL5_D_SEL0E, TIM1_CH5_PORT02_PIN05_SEL01, TIM1_CH5_PORT10_PIN08_SEL02, TIM1_CH5_PORT14_PIN02_SEL03, TIM1_CH5_PORT20_PIN07_SEL08, TIM1_CH5_PORT21_PIN07_SEL07, TIM1_CH5_PORT23_PIN00_SEL04, TIM1_CH5_PORT32_PIN04_SEL05, TIM1_CH5_PORT33_PIN01_SEL06, TIM1_CH5_DSADC_SRM0_0_SEL0E, TIM1_CH5_DSADC_SRM1_1_SEL0E, TIM1_CH5_DSADC_SRM2_2_SEL0E, TIM1_CH5_DSADC_SRM3_3_SEL0E, TIM1_CH5_DSADC_SRM4_4_SEL0E, TIM1_CH5_DSADC_SRM5_5_SEL0E, TIM1_CH5_DSADC_SRM6_6_SEL0E, TIM1_CH5_DSADC_SRM7_7_SEL0E, TIM1_CH5_DSADC_SRM8_8_SEL0E, TIM1_CH5_DSADC_SRM9_9_SEL0E, TIM1_CH5_DSADC_SAUL5_A_SEL0E, TIM1_CH5_DSADC_SBLL5_B_SEL0E, TIM1_CH5_DSADC_SAUL4_C_SEL0E, TIM1_CH5_DSADC_SBLL4_D_SEL0E, TIM1_CH6_PORT02_PIN06_SEL01, TIM1_CH6_PORT10_PIN04_SEL02, TIM1_CH6_PORT14_PIN03_SEL03, TIM1_CH6_PORT20_PIN00_SEL07, TIM1_CH6_PORT23_PIN01_SEL04, TIM1_CH6_PORT23_PIN02_SEL05, TIM1_CH6_PORT33_PIN02_SEL06, TIM1_CH6_DSADC_SRM0_0_SEL0E, TIM1_CH6_DSADC_SRM1_1_SEL0E, TIM1_CH6_DSADC_SRM2_2_SEL0E, TIM1_CH6_DSADC_SRM3_3_SEL0E, TIM1_CH6_DSADC_SRM4_4_SEL0E, TIM1_CH6_DSADC_SRM5_5_SEL0E, TIM1_CH6_DSADC_SRM6_6_SEL0E, TIM1_CH6_DSADC_SRM7_7_SEL0E, TIM1_CH6_DSADC_SRM8_8_SEL0E, TIM1_CH6_DSADC_SRM9_9_SEL0E, TIM1_CH6_DSADC_SAUL6_A_SEL0E, TIM1_CH6_DSADC_SBLL6_B_SEL0E, TIM1_CH6_DSADC_SAUL7_C_SEL0E, TIM1_CH6_DSADC_SBLL7_D_SEL0E, TIM1_CH7_PORT02_PIN07_SEL01, TIM1_CH7_PORT14_PIN04_SEL02, TIM1_CH7_PORT20_PIN08_SEL03, TIM1_CH7_PORT23_PIN03_SEL04, TIM1_CH7_PORT23_PIN04_SEL05, TIM1_CH7_PORT33_PIN03_SEL06, TIM1_CH7_DSADC_SRM0_0_SEL0E, TIM1_CH7_DSADC_SRM1_1_SEL0E, TIM1_CH7_DSADC_SRM2_2_SEL0E, TIM1_CH7_DSADC_SRM3_3_SEL0E, TIM1_CH7_DSADC_SRM4_4_SEL0E, TIM1_CH7_DSADC_SRM5_5_SEL0E, TIM1_CH7_DSADC_SRM6_6_SEL0E, TIM1_CH7_DSADC_SRM7_7_SEL0E, TIM1_CH7_DSADC_SRM8_8_SEL0E, TIM1_CH7_DSADC_SRM9_9_SEL0E, TIM1_CH7_DSADC_SAUL7_A_SEL0E, TIM1_CH7_DSADC_SBLL7_B_SEL0E, TIM1_CH7_DSADC_SAUL6_C_SEL0E, TIM1_CH7_DSADC_SBLL6_D_SEL0E, TIM2_CH0_PORT00_PIN00_SEL01, TIM2_CH0_PORT02_PIN08_SEL02, TIM2_CH0_PORT13_PIN03_SEL03, TIM2_CH0_PORT15_PIN05_SEL04, TIM2_CH0_PORT20_PIN12_SEL05, TIM2_CH0_PORT33_PIN12_SEL06, TIM2_CH0_PORT11_PIN00_SEL07, TIM2_CH0_PORT33_PIN14_SEL08, TIM2_CH0_PORT11_PIN10_SEL09, TIM2_CH0_PORT31_PIN00_SEL0D, TIM2_CH0_PORT01_PIN03_SEL0E, TIM2_CH0_DSADC_SRM0_0_SEL0B, TIM2_CH0_DSADC_SRM1_1_SEL0B, TIM2_CH0_DSADC_SRM2_2_SEL0B, TIM2_CH0_DSADC_SRM3_3_SEL0B, TIM2_CH0_DSADC_SRM4_4_SEL0B, TIM2_CH0_DSADC_SRM5_5_SEL0B, TIM2_CH0_DSADC_SRM6_6_SEL0B, TIM2_CH0_DSADC_SRM7_7_SEL0B, TIM2_CH0_DSADC_SRM8_8_SEL0B, TIM2_CH0_DSADC_SRM9_9_SEL0B, TIM2_CH0_DSADC_SAUL8_A_SEL0B, TIM2_CH0_DSADC_SBLL8_B_SEL0B, TIM2_CH0_DSADC_SAUL9_C_SEL0B, TIM2_CH0_DSADC_SBLL9_D_SEL0B, TIM2_CH1_PORT00_PIN01_SEL01, TIM2_CH1_PORT00_PIN02_SEL02, TIM2_CH1_PORT11_PIN02_SEL03, TIM2_CH1_PORT20_PIN13_SEL04, TIM2_CH1_PORT33_PIN13_SEL05, TIM2_CH1_PORT11_PIN01_SEL06, TIM2_CH1_PORT33_PIN15_SEL07, TIM2_CH1_PORT15_PIN10_SEL08, TIM2_CH1_PORT31_PIN01_SEL09, TIM2_CH1_PORT01_PIN04_SEL0E, TIM2_CH1_DSADC_SRM0_0_SEL0B, TIM2_CH1_DSADC_SRM1_1_SEL0B, TIM2_CH1_DSADC_SRM2_2_SEL0B, TIM2_CH1_DSADC_SRM3_3_SEL0B, TIM2_CH1_DSADC_SRM4_4_SEL0B, TIM2_CH1_DSADC_SRM5_5_SEL0B, TIM2_CH1_DSADC_SRM6_6_SEL0B, TIM2_CH1_DSADC_SRM7_7_SEL0B, TIM2_CH1_DSADC_SRM8_8_SEL0B, TIM2_CH1_DSADC_SRM9_9_SEL0B, TIM2_CH1_DSADC_SAUL9_A_SEL0B, TIM2_CH1_DSADC_SBLL9_B_SEL0B, TIM2_CH1_DSADC_SAUL8_C_SEL0B, TIM2_CH1_DSADC_SBLL8_D_SEL0B, TIM2_CH2_PORT00_PIN03_SEL01, TIM2_CH2_PORT11_PIN03_SEL02, TIM2_CH2_PORT14_PIN08_SEL03, TIM2_CH2_PORT20_PIN14_SEL04, TIM2_CH2_PORT32_PIN00_SEL05, TIM2_CH2_PORT11_PIN04_SEL06, TIM2_CH2_PORT01_PIN05_SEL07, TIM2_CH2_PORT15_PIN11_SEL08, TIM2_CH2_PORT31_PIN02_SEL09, TIM2_CH2_PORT15_PIN06_SEL0E, TIM2_CH2_DSADC_SRM0_0_SEL0B, TIM2_CH2_DSADC_SRM1_1_SEL0B, TIM2_CH2_DSADC_SRM2_2_SEL0B, TIM2_CH2_DSADC_SRM3_3_SEL0B, TIM2_CH2_DSADC_SRM4_4_SEL0B, TIM2_CH2_DSADC_SRM5_5_SEL0B, TIM2_CH2_DSADC_SRM6_6_SEL0B, TIM2_CH2_DSADC_SRM7_7_SEL0B, TIM2_CH2_DSADC_SRM8_8_SEL0B, TIM2_CH2_DSADC_SRM9_9_SEL0B, TIM2_CH3_PORT00_PIN04_SEL01, TIM2_CH3_PORT11_PIN06_SEL02, TIM2_CH3_PORT14_PIN09_SEL03, TIM2_CH3_PORT15_PIN00_SEL04, TIM2_CH3_PORT20_PIN01_SEL05, TIM2_CH3_PORT15_PIN12_SEL06, TIM2_CH3_PORT01_PIN05_SEL07, TIM2_CH3_PORT11_PIN05_SEL08, TIM2_CH3_PORT34_PIN01_SEL09, TIM2_CH3_PORT31_PIN03_SEL0E, TIM2_CH3_DSADC_SRM0_0_SEL0B, TIM2_CH3_DSADC_SRM1_1_SEL0B, TIM2_CH3_DSADC_SRM2_2_SEL0B, TIM2_CH3_DSADC_SRM3_3_SEL0B, TIM2_CH3_DSADC_SRM4_4_SEL0B, TIM2_CH3_DSADC_SRM5_5_SEL0B, TIM2_CH3_DSADC_SRM6_6_SEL0B, TIM2_CH3_DSADC_SRM7_7_SEL0B, TIM2_CH3_DSADC_SRM8_8_SEL0B, TIM2_CH3_DSADC_SRM9_9_SEL0B, TIM2_CH4_PORT00_PIN05_SEL01, TIM2_CH4_PORT11_PIN09_SEL02, TIM2_CH4_PORT14_PIN10_SEL03, TIM2_CH4_PORT15_PIN01_SEL04, TIM2_CH4_PORT20_PIN03_SEL05, TIM2_CH4_PORT21_PIN00_SEL06, TIM2_CH4_PORT11_PIN07_SEL07, TIM2_CH4_PORT34_PIN02_SEL08, TIM2_CH4_PORT15_PIN13_SEL09, TIM2_CH4_PORT31_PIN04_SEL0C, TIM2_CH4_PORT02_PIN14_SEL0E, TIM2_CH4_DSADC_SRM0_0_SEL0B, TIM2_CH4_DSADC_SRM1_1_SEL0B, TIM2_CH4_DSADC_SRM2_2_SEL0B, TIM2_CH4_DSADC_SRM3_3_SEL0B, TIM2_CH4_DSADC_SRM4_4_SEL0B, TIM2_CH4_DSADC_SRM5_5_SEL0B, TIM2_CH4_DSADC_SRM6_6_SEL0B, TIM2_CH4_DSADC_SRM7_7_SEL0B, TIM2_CH4_DSADC_SRM8_8_SEL0B, TIM2_CH4_DSADC_SRM9_9_SEL0B, TIM2_CH5_PORT00_PIN06_SEL01, TIM2_CH5_PORT11_PIN10_SEL02, TIM2_CH5_PORT13_PIN00_SEL03, TIM2_CH5_PORT15_PIN02_SEL04, TIM2_CH5_PORT20_PIN09_SEL05, TIM2_CH5_PORT21_PIN01_SEL06, TIM2_CH5_PORT01_PIN06_SEL07, TIM2_CH5_PORT11_PIN08_SEL08, TIM2_CH5_PORT34_PIN03_SEL09, TIM2_CH5_PORT15_PIN14_SEL0C, TIM2_CH5_PORT31_PIN05_SEL0D, TIM2_CH5_PORT02_PIN15_SEL0E, TIM2_CH5_DSADC_SRM0_0_SEL0B, TIM2_CH5_DSADC_SRM1_1_SEL0B, TIM2_CH5_DSADC_SRM2_2_SEL0B, TIM2_CH5_DSADC_SRM3_3_SEL0B, TIM2_CH5_DSADC_SRM4_4_SEL0B, TIM2_CH5_DSADC_SRM5_5_SEL0B, TIM2_CH5_DSADC_SRM6_6_SEL0B, TIM2_CH5_DSADC_SRM7_7_SEL0B, TIM2_CH5_DSADC_SRM8_8_SEL0B, TIM2_CH5_DSADC_SRM9_9_SEL0B, TIM2_CH6_PORT00_PIN07_SEL01, TIM2_CH6_PORT11_PIN11_SEL02, TIM2_CH6_PORT13_PIN01_SEL03, TIM2_CH6_PORT15_PIN03_SEL04, TIM2_CH6_PORT20_PIN06_SEL05, TIM2_CH6_PORT20_PIN10_SEL06, TIM2_CH6_PORT11_PIN13_SEL07, TIM2_CH6_PORT34_PIN04_SEL08, TIM2_CH6_PORT15_PIN15_SEL09, TIM2_CH6_PORT31_PIN06_SEL0C, TIM2_CH6_PORT01_PIN00_SEL0D, TIM2_CH6_PORT22_PIN06_SEL0E, TIM2_CH6_DSADC_SRM0_0_SEL0B, TIM2_CH6_DSADC_SRM1_1_SEL0B, TIM2_CH6_DSADC_SRM2_2_SEL0B, TIM2_CH6_DSADC_SRM3_3_SEL0B, TIM2_CH6_DSADC_SRM4_4_SEL0B, TIM2_CH6_DSADC_SRM5_5_SEL0B, TIM2_CH6_DSADC_SRM6_6_SEL0B, TIM2_CH6_DSADC_SRM7_7_SEL0B, TIM2_CH6_DSADC_SRM8_8_SEL0B, TIM2_CH6_DSADC_SRM9_9_SEL0B, TIM2_CH6_DSADC_SAUL0_A_SEL0B, TIM2_CH6_DSADC_SBLL0_B_SEL0B, TIM2_CH6_DSADC_SAUL1_C_SEL0B, TIM2_CH6_DSADC_SBLL1_D_SEL0B, TIM2_CH7_PORT00_PIN08_SEL01, TIM2_CH7_PORT11_PIN12_SEL02, TIM2_CH7_PORT13_PIN02_SEL03, TIM2_CH7_PORT15_PIN04_SEL04, TIM2_CH7_PORT20_PIN07_SEL05, TIM2_CH7_PORT20_PIN11_SEL06, TIM2_CH7_PORT01_PIN07_SEL07, TIM2_CH7_PORT11_PIN14_SEL08, TIM2_CH7_PORT34_PIN05_SEL09, TIM2_CH7_PORT13_PIN09_SEL0C, TIM2_CH7_PORT31_PIN07_SEL0E, TIM2_CH7_DSADC_SRM0_0_SEL0B, TIM2_CH7_DSADC_SRM1_1_SEL0B, TIM2_CH7_DSADC_SRM2_2_SEL0B, TIM2_CH7_DSADC_SRM3_3_SEL0B, TIM2_CH7_DSADC_SRM4_4_SEL0B, TIM2_CH7_DSADC_SRM5_5_SEL0B, TIM2_CH7_DSADC_SRM6_6_SEL0B, TIM2_CH7_DSADC_SRM7_7_SEL0B, TIM2_CH7_DSADC_SRM8_8_SEL0B, TIM2_CH7_DSADC_SRM9_9_SEL0B, TIM2_CH7_DSADC_SAUL1_A_SEL0B, TIM2_CH7_DSADC_SBLL1_B_SEL0B, TIM2_CH7_DSADC_SAUL0_C_SEL0B, TIM2_CH7_DSADC_SBLL0_D_SEL0B, TIM3_CH0_PORT00_PIN00_SEL01, TIM3_CH0_PORT02_PIN08_SEL02, TIM3_CH0_PORT13_PIN03_SEL03, TIM3_CH0_PORT15_PIN05_SEL04, TIM3_CH0_PORT20_PIN12_SEL05, TIM3_CH0_PORT33_PIN12_SEL06, TIM3_CH0_PORT12_PIN00_SEL07, TIM3_CH0_PORT22_PIN04_SEL08, TIM3_CH0_PORT13_PIN11_SEL09, TIM3_CH0_PORT02_PIN06_SEL0A, TIM3_CH0_PORT00_PIN05_SEL0B, TIM3_CH0_PORT25_PIN00_SEL0C, TIM3_CH0_PORT33_PIN00_SEL0D, TIM3_CH0_PORT11_PIN11_SEL0E, TIM3_CH0_DSADC_SRM2_0_SEL0F, TIM3_CH0_DSADC_SRM3_1_SEL0F, TIM3_CH0_DSADC_SRM4_2_SEL0F, TIM3_CH0_DSADC_SRM5_3_SEL0F, TIM3_CH0_DSADC_SRM6_4_SEL0F, TIM3_CH0_DSADC_SRM7_5_SEL0F, TIM3_CH0_DSADC_SRM8_6_SEL0F, TIM3_CH0_DSADC_SRM9_7_SEL0F, TIM3_CH0_DSADC_SAUL2_C_SEL0F, TIM3_CH0_DSADC_SBLL2_D_SEL0F, TIM3_CH0_DSADC_SAUL3_E_SEL0F, TIM3_CH0_DSADC_SBLL3_F_SEL0F, TIM3_CH1_PORT00_PIN01_SEL01, TIM3_CH1_PORT00_PIN02_SEL02, TIM3_CH1_PORT11_PIN02_SEL03, TIM3_CH1_PORT20_PIN13_SEL04, TIM3_CH1_PORT33_PIN13_SEL05, TIM3_CH1_PORT12_PIN01_SEL06, TIM3_CH1_PORT22_PIN05_SEL07, TIM3_CH1_PORT13_PIN10_SEL08, TIM3_CH1_PORT14_PIN11_SEL09, TIM3_CH1_PORT02_PIN07_SEL0A, TIM3_CH1_PORT25_PIN01_SEL0B, TIM3_CH1_PORT00_PIN06_SEL0E, TIM3_CH1_PORT33_PIN01_SEL0F, TIM3_CH1_DSADC_SRM2_0_SEL00, TIM3_CH1_DSADC_SRM3_1_SEL00, TIM3_CH1_DSADC_SRM4_2_SEL00, TIM3_CH1_DSADC_SRM5_3_SEL00, TIM3_CH1_DSADC_SRM6_4_SEL00, TIM3_CH1_DSADC_SRM7_5_SEL00, TIM3_CH1_DSADC_SRM8_6_SEL00, TIM3_CH1_DSADC_SRM9_7_SEL00, TIM3_CH1_DSADC_SAUL3_C_SEL00, TIM3_CH1_DSADC_SBLL3_D_SEL00, TIM3_CH1_DSADC_SAUL2_E_SEL00, TIM3_CH1_DSADC_SBLL2_F_SEL00, TIM3_CH2_PORT00_PIN03_SEL01, TIM3_CH2_PORT11_PIN03_SEL02, TIM3_CH2_PORT14_PIN08_SEL03, TIM3_CH2_PORT20_PIN14_SEL04, TIM3_CH2_PORT32_PIN00_SEL05, TIM3_CH2_PORT22_PIN06_SEL06, TIM3_CH2_PORT13_PIN14_SEL07, TIM3_CH2_PORT14_PIN14_SEL08, TIM3_CH2_PORT25_PIN02_SEL09, TIM3_CH2_PORT02_PIN08_SEL0A, TIM3_CH2_PORT00_PIN07_SEL0B, TIM3_CH2_PORT33_PIN02_SEL0E, TIM3_CH2_DSADC_SRM2_0_SEL0F, TIM3_CH2_DSADC_SRM3_1_SEL0F, TIM3_CH2_DSADC_SRM4_2_SEL0F, TIM3_CH2_DSADC_SRM5_3_SEL0F, TIM3_CH2_DSADC_SRM6_4_SEL0F, TIM3_CH2_DSADC_SRM7_5_SEL0F, TIM3_CH2_DSADC_SRM8_6_SEL0F, TIM3_CH2_DSADC_SRM9_7_SEL0F, TIM3_CH2_DSADC_SAUL4_C_SEL0F, TIM3_CH2_DSADC_SBLL4_D_SEL0F, TIM3_CH2_DSADC_SAUL5_E_SEL0F, TIM3_CH2_DSADC_SBLL5_F_SEL0F, TIM3_CH3_PORT00_PIN04_SEL01, TIM3_CH3_PORT11_PIN06_SEL02, TIM3_CH3_PORT14_PIN09_SEL03, TIM3_CH3_PORT15_PIN00_SEL04, TIM3_CH3_PORT20_PIN01_SEL05, TIM3_CH3_PORT14_PIN13_SEL06, TIM3_CH3_PORT22_PIN07_SEL07, TIM3_CH3_PORT13_PIN04_SEL08, TIM3_CH3_PORT25_PIN03_SEL09, TIM3_CH3_PORT02_PIN09_SEL0A, TIM3_CH3_PORT00_PIN08_SEL0B, TIM3_CH3_PORT33_PIN03_SEL0C, TIM3_CH3_PORT32_PIN01_SEL0F, TIM3_CH3_DSADC_SRM2_0_SEL0E, TIM3_CH3_DSADC_SRM3_1_SEL0E, TIM3_CH3_DSADC_SRM4_2_SEL0E, TIM3_CH3_DSADC_SRM5_3_SEL0E, TIM3_CH3_DSADC_SRM6_4_SEL0E, TIM3_CH3_DSADC_SRM7_5_SEL0E, TIM3_CH3_DSADC_SRM8_6_SEL0E, TIM3_CH3_DSADC_SRM9_7_SEL0E, TIM3_CH3_DSADC_SAUL5_C_SEL0E, TIM3_CH3_DSADC_SBLL5_D_SEL0E, TIM3_CH3_DSADC_SAUL4_E_SEL0E, TIM3_CH3_DSADC_SBLL4_F_SEL0E, TIM3_CH4_PORT00_PIN05_SEL01, TIM3_CH4_PORT11_PIN09_SEL02, TIM3_CH4_PORT14_PIN10_SEL03, TIM3_CH4_PORT15_PIN01_SEL04, TIM3_CH4_PORT20_PIN03_SEL05, TIM3_CH4_PORT21_PIN00_SEL06, TIM3_CH4_PORT22_PIN08_SEL07, TIM3_CH4_PORT14_PIN12_SEL08, TIM3_CH4_PORT13_PIN05_SEL09, TIM3_CH4_PORT25_PIN04_SEL0A, TIM3_CH4_PORT02_PIN10_SEL0B, TIM3_CH4_PORT34_PIN01_SEL0C, TIM3_CH4_DSADC_SRM2_0_SEL0E, TIM3_CH4_DSADC_SRM3_1_SEL0E, TIM3_CH4_DSADC_SRM4_2_SEL0E, TIM3_CH4_DSADC_SRM5_3_SEL0E, TIM3_CH4_DSADC_SRM6_4_SEL0E, TIM3_CH4_DSADC_SRM7_5_SEL0E, TIM3_CH4_DSADC_SRM8_6_SEL0E, TIM3_CH4_DSADC_SRM9_7_SEL0E, TIM3_CH4_DSADC_SAUL6_C_SEL0E, TIM3_CH4_DSADC_SBLL6_D_SEL0E, TIM3_CH4_DSADC_SAUL7_E_SEL0E, TIM3_CH4_DSADC_SBLL7_F_SEL0E, TIM3_CH5_PORT00_PIN06_SEL01, TIM3_CH5_PORT11_PIN10_SEL02, TIM3_CH5_PORT13_PIN00_SEL03, TIM3_CH5_PORT15_PIN02_SEL04, TIM3_CH5_PORT20_PIN09_SEL05, TIM3_CH5_PORT21_PIN01_SEL06, TIM3_CH5_PORT22_PIN09_SEL07, TIM3_CH5_PORT32_PIN05_SEL08, TIM3_CH5_PORT13_PIN13_SEL09, TIM3_CH5_PORT13_PIN06_SEL0A, TIM3_CH5_PORT25_PIN05_SEL0B, TIM3_CH5_PORT02_PIN11_SEL0C, TIM3_CH5_PORT34_PIN02_SEL0D, TIM3_CH5_DSADC_SRM2_0_SEL0E, TIM3_CH5_DSADC_SRM3_1_SEL0E, TIM3_CH5_DSADC_SRM4_2_SEL0E, TIM3_CH5_DSADC_SRM5_3_SEL0E, TIM3_CH5_DSADC_SRM6_4_SEL0E, TIM3_CH5_DSADC_SRM7_5_SEL0E, TIM3_CH5_DSADC_SRM8_6_SEL0E, TIM3_CH5_DSADC_SRM9_7_SEL0E, TIM3_CH5_DSADC_SAUL7_C_SEL0E, TIM3_CH5_DSADC_SBLL7_D_SEL0E, TIM3_CH5_DSADC_SAUL6_E_SEL0E, TIM3_CH5_DSADC_SBLL6_F_SEL0E, TIM3_CH6_PORT00_PIN07_SEL01, TIM3_CH6_PORT11_PIN11_SEL02, TIM3_CH6_PORT13_PIN01_SEL03, TIM3_CH6_PORT15_PIN03_SEL04, TIM3_CH6_PORT20_PIN06_SEL05, TIM3_CH6_PORT20_PIN10_SEL06, TIM3_CH6_PORT22_PIN10_SEL07, TIM3_CH6_PORT32_PIN06_SEL08, TIM3_CH6_PORT14_PIN15_SEL09, TIM3_CH6_PORT13_PIN07_SEL0A, TIM3_CH6_PORT26_PIN00_SEL0B, TIM3_CH6_PORT02_PIN12_SEL0C, TIM3_CH6_PORT34_PIN03_SEL0D, TIM3_CH6_PORT25_PIN06_SEL0E, TIM3_CH6_DSADC_SRM2_0_SEL0F, TIM3_CH6_DSADC_SRM3_1_SEL0F, TIM3_CH6_DSADC_SRM4_2_SEL0F, TIM3_CH6_DSADC_SRM5_3_SEL0F, TIM3_CH6_DSADC_SRM6_4_SEL0F, TIM3_CH6_DSADC_SRM7_5_SEL0F, TIM3_CH6_DSADC_SRM8_6_SEL0F, TIM3_CH6_DSADC_SRM9_7_SEL0F, TIM3_CH6_DSADC_SAUL8_C_SEL0F, TIM3_CH6_DSADC_SBLL8_D_SEL0F, TIM3_CH6_DSADC_SAUL9_E_SEL0F, TIM3_CH6_DSADC_SBLL9_F_SEL0F, TIM3_CH7_PORT00_PIN08_SEL01, TIM3_CH7_PORT11_PIN12_SEL02, TIM3_CH7_PORT13_PIN02_SEL03, TIM3_CH7_PORT15_PIN04_SEL04, TIM3_CH7_PORT20_PIN07_SEL05, TIM3_CH7_PORT20_PIN11_SEL06, TIM3_CH7_PORT22_PIN11_SEL07, TIM3_CH7_PORT32_PIN07_SEL08, TIM3_CH7_PORT13_PIN15_SEL09, TIM3_CH7_PORT25_PIN07_SEL0A, TIM3_CH7_PORT02_PIN13_SEL0B, TIM3_CH7_PORT34_PIN04_SEL0C, TIM3_CH7_DSADC_SRM2_0_SEL0E, TIM3_CH7_DSADC_SRM3_1_SEL0E, TIM3_CH7_DSADC_SRM4_2_SEL0E, TIM3_CH7_DSADC_SRM5_3_SEL0E, TIM3_CH7_DSADC_SRM6_4_SEL0E, TIM3_CH7_DSADC_SRM7_5_SEL0E, TIM3_CH7_DSADC_SRM8_6_SEL0E, TIM3_CH7_DSADC_SRM9_7_SEL0E, TIM3_CH7_DSADC_SAUL9_C_SEL0E, TIM3_CH7_DSADC_SBLL9_D_SEL0E, TIM3_CH7_DSADC_SAUL8_E_SEL0E, TIM3_CH7_DSADC_SBLL8_F_SEL0E, TIM4_CH0_PORT00_PIN13_SEL01, TIM4_CH0_PORT01_PIN12_SEL02, TIM4_CH0_PORT02_PIN12_SEL03, TIM4_CH0_PORT11_PIN00_SEL04, TIM4_CH0_PORT12_PIN00_SEL05, TIM4_CH0_PORT13_PIN12_SEL06, TIM4_CH0_PORT00_PIN09_SEL07, TIM4_CH0_PORT24_PIN00_SEL08, TIM4_CH0_PORT25_PIN08_SEL09, TIM4_CH0_PORT30_PIN00_SEL0A, TIM4_CH0_PORT21_PIN00_SEL0B, TIM4_CH0_PORT10_PIN00_SEL0C, TIM4_CH0_PORT10_PIN08_SEL0D, TIM4_CH0_PORT32_PIN07_SEL0F, TIM4_CH0_DSADC_SRM2_0_SEL0E, TIM4_CH0_DSADC_SRM3_1_SEL0E, TIM4_CH0_DSADC_SRM4_2_SEL0E, TIM4_CH0_DSADC_SRM5_3_SEL0E, TIM4_CH0_DSADC_SRM6_4_SEL0E, TIM4_CH0_DSADC_SRM7_5_SEL0E, TIM4_CH0_DSADC_SRM8_6_SEL0E, TIM4_CH0_DSADC_SRM9_7_SEL0E, TIM4_CH1_PORT00_PIN15_SEL01, TIM4_CH1_PORT01_PIN01_SEL02, TIM4_CH1_PORT02_PIN15_SEL03, TIM4_CH1_PORT10_PIN09_SEL04, TIM4_CH1_PORT11_PIN01_SEL05, TIM4_CH1_PORT12_PIN01_SEL06, TIM4_CH1_PORT15_PIN10_SEL07, TIM4_CH1_PORT24_PIN01_SEL08, TIM4_CH1_PORT25_PIN09_SEL09, TIM4_CH1_PORT30_PIN01_SEL0A, TIM4_CH1_PORT00_PIN10_SEL0B, TIM4_CH1_PORT21_PIN01_SEL0D, TIM4_CH1_PORT32_PIN05_SEL0E, TIM4_CH1_DSADC_SRM2_0_SEL0F, TIM4_CH1_DSADC_SRM3_1_SEL0F, TIM4_CH1_DSADC_SRM4_2_SEL0F, TIM4_CH1_DSADC_SRM5_3_SEL0F, TIM4_CH1_DSADC_SRM6_4_SEL0F, TIM4_CH1_DSADC_SRM7_5_SEL0F, TIM4_CH1_DSADC_SRM8_6_SEL0F, TIM4_CH1_DSADC_SRM9_7_SEL0F, TIM4_CH2_PORT01_PIN09_SEL01, TIM4_CH2_PORT02_PIN09_SEL02, TIM4_CH2_PORT02_PIN13_SEL03, TIM4_CH2_PORT10_PIN10_SEL04, TIM4_CH2_PORT11_PIN04_SEL05, TIM4_CH2_PORT15_PIN11_SEL06, TIM4_CH2_PORT23_PIN06_SEL07, TIM4_CH2_PORT24_PIN02_SEL08, TIM4_CH2_PORT25_PIN10_SEL09, TIM4_CH2_PORT30_PIN02_SEL0A, TIM4_CH2_PORT00_PIN11_SEL0B, TIM4_CH2_PORT21_PIN06_SEL0C, TIM4_CH2_PORT10_PIN06_SEL0D, TIM4_CH2_DSADC_SRM2_0_SEL0E, TIM4_CH2_DSADC_SRM3_1_SEL0E, TIM4_CH2_DSADC_SRM4_2_SEL0E, TIM4_CH2_DSADC_SRM5_3_SEL0E, TIM4_CH2_DSADC_SRM6_4_SEL0E, TIM4_CH2_DSADC_SRM7_5_SEL0E, TIM4_CH2_DSADC_SRM8_6_SEL0E, TIM4_CH2_DSADC_SRM9_7_SEL0E, TIM4_CH3_PORT01_PIN13_SEL01, TIM4_CH3_PORT02_PIN10_SEL02, TIM4_CH3_PORT02_PIN14_SEL03, TIM4_CH3_PORT10_PIN14_SEL04, TIM4_CH3_PORT11_PIN05_SEL05, TIM4_CH3_PORT15_PIN12_SEL06, TIM4_CH3_PORT23_PIN07_SEL07, TIM4_CH3_PORT24_PIN03_SEL08, TIM4_CH3_PORT25_PIN11_SEL09, TIM4_CH3_PORT30_PIN03_SEL0A, TIM4_CH3_PORT00_PIN12_SEL0B, TIM4_CH3_PORT21_PIN07_SEL0C, TIM4_CH3_PORT10_PIN05_SEL0D, TIM4_CH3_DSADC_SRM2_0_SEL0E, TIM4_CH3_DSADC_SRM3_1_SEL0E, TIM4_CH3_DSADC_SRM4_2_SEL0E, TIM4_CH3_DSADC_SRM5_3_SEL0E, TIM4_CH3_DSADC_SRM6_4_SEL0E, TIM4_CH3_DSADC_SRM7_5_SEL0E, TIM4_CH3_DSADC_SRM8_6_SEL0E, TIM4_CH3_DSADC_SRM9_7_SEL0E, TIM4_CH4_PORT01_PIN00_SEL01, TIM4_CH4_PORT01_PIN08_SEL02, TIM4_CH4_PORT02_PIN11_SEL03, TIM4_CH4_PORT10_PIN13_SEL04, TIM4_CH4_PORT11_PIN07_SEL05, TIM4_CH4_PORT15_PIN13_SEL06, TIM4_CH4_PORT24_PIN04_SEL07, TIM4_CH4_PORT25_PIN12_SEL08, TIM4_CH4_PORT30_PIN04_SEL09, TIM4_CH4_PORT33_PIN04_SEL0A, TIM4_CH4_PORT20_PIN01_SEL0B, TIM4_CH4_PORT10_PIN01_SEL0C, TIM4_CH4_PORT33_PIN10_SEL0E, TIM4_CH4_PORT32_PIN06_SEL0F, TIM4_CH4_DSADC_SRM2_0_SEL0D, TIM4_CH4_DSADC_SRM3_1_SEL0D, TIM4_CH4_DSADC_SRM4_2_SEL0D, TIM4_CH4_DSADC_SRM5_3_SEL0D, TIM4_CH4_DSADC_SRM6_4_SEL0D, TIM4_CH4_DSADC_SRM7_5_SEL0D, TIM4_CH4_DSADC_SRM8_6_SEL0D, TIM4_CH4_DSADC_SRM9_7_SEL0D, TIM4_CH4_DSADC_SAUL0_C_SEL0D, TIM4_CH4_DSADC_SBLL0_D_SEL0D, TIM4_CH4_DSADC_SAUL1_E_SEL0D, TIM4_CH4_DSADC_SBLL1_F_SEL0D, TIM4_CH5_PORT01_PIN02_SEL01, TIM4_CH5_PORT01_PIN03_SEL02, TIM4_CH5_PORT01_PIN10_SEL03, TIM4_CH5_PORT10_PIN11_SEL04, TIM4_CH5_PORT11_PIN08_SEL05, TIM4_CH5_PORT15_PIN14_SEL06, TIM4_CH5_PORT24_PIN05_SEL07, TIM4_CH5_PORT25_PIN13_SEL08, TIM4_CH5_PORT30_PIN05_SEL09, TIM4_CH5_PORT33_PIN05_SEL0A, TIM4_CH5_PORT20_PIN03_SEL0B, TIM4_CH5_PORT10_PIN02_SEL0C, TIM4_CH5_PORT33_PIN14_SEL0E, TIM4_CH5_DSADC_SRM2_0_SEL0D, TIM4_CH5_DSADC_SRM3_1_SEL0D, TIM4_CH5_DSADC_SRM4_2_SEL0D, TIM4_CH5_DSADC_SRM5_3_SEL0D, TIM4_CH5_DSADC_SRM6_4_SEL0D, TIM4_CH5_DSADC_SRM7_5_SEL0D, TIM4_CH5_DSADC_SRM8_6_SEL0D, TIM4_CH5_DSADC_SRM9_7_SEL0D, TIM4_CH5_DSADC_SAUL1_C_SEL0D, TIM4_CH5_DSADC_SBLL1_D_SEL0D, TIM4_CH5_DSADC_SAUL0_E_SEL0D, TIM4_CH5_DSADC_SBLL0_F_SEL0D, TIM4_CH6_PORT01_PIN15_SEL01, TIM4_CH6_PORT01_PIN04_SEL02, TIM4_CH6_PORT01_PIN14_SEL03, TIM4_CH6_PORT10_PIN15_SEL04, TIM4_CH6_PORT11_PIN13_SEL05, TIM4_CH6_PORT15_PIN15_SEL06, TIM4_CH6_PORT24_PIN06_SEL07, TIM4_CH6_PORT25_PIN14_SEL08, TIM4_CH6_PORT30_PIN06_SEL09, TIM4_CH6_PORT10_PIN03_SEL0A, TIM4_CH6_PORT33_PIN15_SEL0C, TIM4_CH6_DSADC_SRM2_0_SEL0B, TIM4_CH6_DSADC_SRM3_1_SEL0B, TIM4_CH6_DSADC_SRM4_2_SEL0B, TIM4_CH6_DSADC_SRM5_3_SEL0B, TIM4_CH6_DSADC_SRM6_4_SEL0B, TIM4_CH6_DSADC_SRM7_5_SEL0B, TIM4_CH6_DSADC_SRM8_6_SEL0B, TIM4_CH6_DSADC_SRM9_7_SEL0B, TIM4_CH6_DSADC_SAUL2_C_SEL0B, TIM4_CH6_DSADC_SBLL2_D_SEL0B, TIM4_CH6_DSADC_SAUL3_E_SEL0B, TIM4_CH6_DSADC_SBLL3_F_SEL0B, TIM4_CH7_PORT00_PIN14_SEL01, TIM4_CH7_PORT01_PIN11_SEL02, TIM4_CH7_PORT10_PIN04_SEL03, TIM4_CH7_PORT11_PIN14_SEL04, TIM4_CH7_PORT11_PIN15_SEL05, TIM4_CH7_PORT13_PIN09_SEL06, TIM4_CH7_PORT24_PIN07_SEL07, TIM4_CH7_PORT25_PIN15_SEL08, TIM4_CH7_PORT30_PIN07_SEL09, TIM4_CH7_PORT14_PIN07_SEL0A, TIM4_CH7_PORT34_PIN05_SEL0C, TIM4_CH7_DSADC_SRM2_0_SEL0B, TIM4_CH7_DSADC_SRM3_1_SEL0B, TIM4_CH7_DSADC_SRM4_2_SEL0B, TIM4_CH7_DSADC_SRM5_3_SEL0B, TIM4_CH7_DSADC_SRM6_4_SEL0B, TIM4_CH7_DSADC_SRM7_5_SEL0B, TIM4_CH7_DSADC_SRM8_6_SEL0B, TIM4_CH7_DSADC_SRM9_7_SEL0B, TIM4_CH7_DSADC_SAUL3_C_SEL0B, TIM4_CH7_DSADC_SBLL3_D_SEL0B, TIM4_CH7_DSADC_SAUL2_E_SEL0B, TIM4_CH7_DSADC_SBLL2_F_SEL0B, TIM5_CH0_PORT00_PIN13_SEL01, TIM5_CH0_PORT01_PIN12_SEL02, TIM5_CH0_PORT02_PIN12_SEL03, TIM5_CH0_PORT22_PIN08_SEL04, TIM5_CH0_PORT24_PIN08_SEL05, TIM5_CH0_PORT30_PIN08_SEL06, TIM5_CH0_PORT31_PIN08_SEL07, TIM5_CH0_PORT33_PIN14_SEL08, TIM5_CH0_PORT13_PIN11_SEL09, TIM5_CH0_PORT01_PIN08_SEL0A, TIM5_CH0_DSADC_SRM2_0_SEL0B, TIM5_CH0_DSADC_SRM3_1_SEL0B, TIM5_CH0_DSADC_SRM4_2_SEL0B, TIM5_CH0_DSADC_SRM5_3_SEL0B, TIM5_CH0_DSADC_SRM6_4_SEL0B, TIM5_CH0_DSADC_SRM7_5_SEL0B, TIM5_CH0_DSADC_SRM8_6_SEL0B, TIM5_CH0_DSADC_SRM9_7_SEL0B, TIM5_CH0_DSADC_SAUL4_C_SEL0B, TIM5_CH0_DSADC_SBLL4_D_SEL0B, TIM5_CH0_DSADC_SAUL5_E_SEL0B, TIM5_CH0_DSADC_SBLL5_F_SEL0B, TIM5_CH1_PORT00_PIN15_SEL01, TIM5_CH1_PORT01_PIN01_SEL02, TIM5_CH1_PORT02_PIN15_SEL03, TIM5_CH1_PORT14_PIN11_SEL04, TIM5_CH1_PORT13_PIN10_SEL05, TIM5_CH1_PORT24_PIN09_SEL06, TIM5_CH1_PORT30_PIN09_SEL07, TIM5_CH1_PORT31_PIN09_SEL08, TIM5_CH1_PORT33_PIN15_SEL09, TIM5_CH1_PORT22_PIN09_SEL0A, TIM5_CH1_PORT01_PIN09_SEL0B, TIM5_CH1_DSADC_SRM2_0_SEL0C, TIM5_CH1_DSADC_SRM3_1_SEL0C, TIM5_CH1_DSADC_SRM4_2_SEL0C, TIM5_CH1_DSADC_SRM5_3_SEL0C, TIM5_CH1_DSADC_SRM6_4_SEL0C, TIM5_CH1_DSADC_SRM7_5_SEL0C, TIM5_CH1_DSADC_SRM8_6_SEL0C, TIM5_CH1_DSADC_SRM9_7_SEL0C, TIM5_CH1_DSADC_SAUL5_C_SEL0C, TIM5_CH1_DSADC_SBLL5_D_SEL0C, TIM5_CH1_DSADC_SAUL4_E_SEL0C, TIM5_CH1_DSADC_SBLL4_F_SEL0C, TIM5_CH2_PORT01_PIN09_SEL01, TIM5_CH2_PORT02_PIN13_SEL02, TIM5_CH2_PORT14_PIN14_SEL03, TIM5_CH2_PORT13_PIN14_SEL04, TIM5_CH2_PORT24_PIN10_SEL05, TIM5_CH2_PORT30_PIN10_SEL06, TIM5_CH2_PORT31_PIN10_SEL07, TIM5_CH2_PORT22_PIN10_SEL08, TIM5_CH2_PORT01_PIN10_SEL09, TIM5_CH2_DSADC_SRM2_0_SEL0A, TIM5_CH2_DSADC_SRM3_1_SEL0A, TIM5_CH2_DSADC_SRM4_2_SEL0A, TIM5_CH2_DSADC_SRM5_3_SEL0A, TIM5_CH2_DSADC_SRM6_4_SEL0A, TIM5_CH2_DSADC_SRM7_5_SEL0A, TIM5_CH2_DSADC_SRM8_6_SEL0A, TIM5_CH2_DSADC_SRM9_7_SEL0A, TIM5_CH2_DSADC_SAUL6_C_SEL0A, TIM5_CH2_DSADC_SBLL6_D_SEL0A, TIM5_CH2_DSADC_SAUL7_E_SEL0A, TIM5_CH2_DSADC_SBLL7_F_SEL0A, TIM5_CH3_PORT01_PIN13_SEL01, TIM5_CH3_PORT01_PIN05_SEL02, TIM5_CH3_PORT02_PIN14_SEL03, TIM5_CH3_PORT13_PIN04_SEL04, TIM5_CH3_PORT14_PIN13_SEL05, TIM5_CH3_PORT24_PIN11_SEL06, TIM5_CH3_PORT30_PIN11_SEL07, TIM5_CH3_PORT31_PIN11_SEL08, TIM5_CH3_PORT34_PIN01_SEL09, TIM5_CH3_PORT22_PIN11_SEL0A, TIM5_CH3_PORT01_PIN11_SEL0B, TIM5_CH3_DSADC_SRM2_0_SEL0C, TIM5_CH3_DSADC_SRM3_1_SEL0C, TIM5_CH3_DSADC_SRM4_2_SEL0C, TIM5_CH3_DSADC_SRM5_3_SEL0C, TIM5_CH3_DSADC_SRM6_4_SEL0C, TIM5_CH3_DSADC_SRM7_5_SEL0C, TIM5_CH3_DSADC_SRM8_6_SEL0C, TIM5_CH3_DSADC_SRM9_7_SEL0C, TIM5_CH3_DSADC_SAUL7_C_SEL0C, TIM5_CH3_DSADC_SBLL7_D_SEL0C, TIM5_CH3_DSADC_SAUL6_E_SEL0C, TIM5_CH3_DSADC_SBLL6_F_SEL0C, TIM5_CH4_PORT01_PIN00_SEL01, TIM5_CH4_PORT01_PIN08_SEL02, TIM5_CH4_PORT13_PIN05_SEL04, TIM5_CH4_PORT14_PIN12_SEL05, TIM5_CH4_PORT24_PIN12_SEL06, TIM5_CH4_PORT30_PIN12_SEL07, TIM5_CH4_PORT31_PIN12_SEL08, TIM5_CH4_PORT34_PIN02_SEL09, TIM5_CH4_PORT00_PIN00_SEL0A, TIM5_CH4_PORT21_PIN02_SEL0B, TIM5_CH4_DSADC_SRM2_0_SEL03, TIM5_CH4_DSADC_SRM3_1_SEL03, TIM5_CH4_DSADC_SRM4_2_SEL03, TIM5_CH4_DSADC_SRM5_3_SEL03, TIM5_CH4_DSADC_SRM6_4_SEL03, TIM5_CH4_DSADC_SRM7_5_SEL03, TIM5_CH4_DSADC_SRM8_6_SEL03, TIM5_CH4_DSADC_SRM9_7_SEL03, TIM5_CH4_DSADC_SAUL8_C_SEL03, TIM5_CH4_DSADC_SBLL8_D_SEL03, TIM5_CH4_DSADC_SAUL9_E_SEL03, TIM5_CH4_DSADC_SBLL9_F_SEL03, TIM5_CH5_PORT01_PIN02_SEL01, TIM5_CH5_PORT01_PIN10_SEL02, TIM5_CH5_PORT01_PIN06_SEL03, TIM5_CH5_PORT13_PIN06_SEL04, TIM5_CH5_PORT13_PIN13_SEL05, TIM5_CH5_PORT24_PIN13_SEL06, TIM5_CH5_PORT30_PIN13_SEL07, TIM5_CH5_PORT31_PIN13_SEL08, TIM5_CH5_PORT32_PIN05_SEL09, TIM5_CH5_PORT34_PIN03_SEL0A, TIM5_CH5_PORT00_PIN01_SEL0B, TIM5_CH5_PORT21_PIN03_SEL0C, TIM5_CH5_DSADC_SRM2_0_SEL0D, TIM5_CH5_DSADC_SRM3_1_SEL0D, TIM5_CH5_DSADC_SRM4_2_SEL0D, TIM5_CH5_DSADC_SRM5_3_SEL0D, TIM5_CH5_DSADC_SRM6_4_SEL0D, TIM5_CH5_DSADC_SRM7_5_SEL0D, TIM5_CH5_DSADC_SRM8_6_SEL0D, TIM5_CH5_DSADC_SRM9_7_SEL0D, TIM5_CH5_DSADC_SAUL9_C_SEL0D, TIM5_CH5_DSADC_SBLL9_D_SEL0D, TIM5_CH5_DSADC_SAUL8_E_SEL0D, TIM5_CH5_DSADC_SBLL8_F_SEL0D, TIM5_CH6_PORT01_PIN15_SEL01, TIM5_CH6_PORT01_PIN06_SEL02, TIM5_CH6_PORT01_PIN14_SEL03, TIM5_CH6_PORT13_PIN07_SEL04, TIM5_CH6_PORT14_PIN15_SEL05, TIM5_CH6_PORT24_PIN14_SEL06, TIM5_CH6_PORT30_PIN14_SEL07, TIM5_CH6_PORT31_PIN14_SEL08, TIM5_CH6_PORT32_PIN06_SEL09, TIM5_CH6_PORT34_PIN04_SEL0A, TIM5_CH6_PORT00_PIN02_SEL0B, TIM5_CH6_PORT21_PIN04_SEL0C, TIM5_CH6_DSADC_SRM2_0_SEL0D, TIM5_CH6_DSADC_SRM3_1_SEL0D, TIM5_CH6_DSADC_SRM4_2_SEL0D, TIM5_CH6_DSADC_SRM5_3_SEL0D, TIM5_CH6_DSADC_SRM6_4_SEL0D, TIM5_CH6_DSADC_SRM7_5_SEL0D, TIM5_CH6_DSADC_SRM8_6_SEL0D, TIM5_CH6_DSADC_SRM9_7_SEL0D, TIM5_CH7_PORT00_PIN14_SEL01, TIM5_CH7_PORT01_PIN07_SEL02, TIM5_CH7_PORT01_PIN11_SEL03, TIM5_CH7_PORT13_PIN15_SEL04, TIM5_CH7_PORT24_PIN15_SEL05, TIM5_CH7_PORT30_PIN15_SEL06, TIM5_CH7_PORT32_PIN07_SEL07, TIM5_CH7_PORT34_PIN05_SEL08, TIM5_CH7_PORT00_PIN03_SEL09, TIM5_CH7_PORT21_PIN05_SEL0A, TIM5_CH7_PORT34_PIN05_SEL0C, TIM5_CH7_DSADC_SRM2_0_SEL0B, TIM5_CH7_DSADC_SRM3_1_SEL0B, TIM5_CH7_DSADC_SRM4_2_SEL0B, TIM5_CH7_DSADC_SRM5_3_SEL0B, TIM5_CH7_DSADC_SRM6_4_SEL0B, TIM5_CH7_DSADC_SRM7_5_SEL0B, TIM5_CH7_DSADC_SRM8_6_SEL0B, TIM5_CH7_DSADC_SRM9_7_SEL0B, TIM6_CH0_PORT20_PIN06_SEL01, TIM6_CH0_PORT23_PIN07_SEL02, TIM6_CH0_PORT01_PIN12_SEL03, TIM6_CH0_PORT13_PIN04_SEL04, TIM6_CH0_PORT10_PIN09_SEL05, TIM6_CH0_PORT24_PIN00_SEL06, TIM6_CH0_PORT25_PIN00_SEL07, TIM6_CH0_PORT30_PIN08_SEL08, TIM6_CH0_PORT31_PIN08_SEL09, TIM6_CH1_PORT20_PIN07_SEL01, TIM6_CH1_PORT23_PIN06_SEL02, TIM6_CH1_PORT01_PIN13_SEL03, TIM6_CH1_PORT13_PIN05_SEL04, TIM6_CH1_PORT10_PIN10_SEL05, TIM6_CH1_PORT24_PIN01_SEL06, TIM6_CH1_PORT25_PIN01_SEL07, TIM6_CH1_PORT30_PIN09_SEL08, TIM6_CH1_PORT31_PIN09_SEL09, TIM6_CH2_PORT20_PIN08_SEL01, TIM6_CH2_PORT23_PIN05_SEL02, TIM6_CH2_PORT01_PIN14_SEL03, TIM6_CH2_PORT13_PIN06_SEL04, TIM6_CH2_PORT10_PIN11_SEL05, TIM6_CH2_PORT24_PIN02_SEL06, TIM6_CH2_PORT25_PIN02_SEL07, TIM6_CH2_PORT30_PIN10_SEL08, TIM6_CH2_PORT31_PIN10_SEL09, TIM6_CH3_PORT20_PIN09_SEL01, TIM6_CH3_PORT23_PIN04_SEL02, TIM6_CH3_PORT01_PIN15_SEL03, TIM6_CH3_PORT13_PIN07_SEL04, TIM6_CH3_PORT10_PIN13_SEL05, TIM6_CH3_PORT24_PIN03_SEL06, TIM6_CH3_PORT25_PIN03_SEL07, TIM6_CH3_PORT30_PIN11_SEL08, TIM6_CH3_PORT31_PIN11_SEL09, TIM6_CH4_PORT00_PIN04_SEL01, TIM6_CH4_PORT23_PIN03_SEL02, TIM6_CH4_PORT14_PIN12_SEL03, TIM6_CH4_PORT13_PIN09_SEL04, TIM6_CH4_PORT24_PIN04_SEL05, TIM6_CH4_PORT25_PIN04_SEL06, TIM6_CH4_PORT30_PIN12_SEL07, TIM6_CH4_PORT31_PIN12_SEL08, TIM6_CH5_PORT23_PIN02_SEL01, TIM6_CH5_PORT00_PIN13_SEL02, TIM6_CH5_PORT14_PIN13_SEL03, TIM6_CH5_PORT13_PIN10_SEL04, TIM6_CH5_PORT24_PIN05_SEL05, TIM6_CH5_PORT25_PIN05_SEL06, TIM6_CH5_PORT30_PIN13_SEL07, TIM6_CH5_PORT31_PIN13_SEL08, TIM6_CH6_PORT23_PIN01_SEL01, TIM6_CH6_PORT00_PIN14_SEL02, TIM6_CH6_PORT14_PIN14_SEL03, TIM6_CH6_PORT13_PIN11_SEL04, TIM6_CH6_PORT24_PIN06_SEL05, TIM6_CH6_PORT25_PIN06_SEL06, TIM6_CH6_PORT30_PIN14_SEL07, TIM6_CH6_PORT31_PIN14_SEL08, TIM6_CH6_PORT26_PIN00_SEL09, TIM6_CH7_PORT23_PIN00_SEL01, TIM6_CH7_PORT00_PIN15_SEL02, TIM6_CH7_PORT14_PIN15_SEL03, TIM6_CH7_PORT13_PIN12_SEL04, TIM6_CH7_PORT24_PIN07_SEL05, TIM6_CH7_PORT25_PIN07_SEL06, TIM6_CH7_PORT30_PIN15_SEL07, TIM6_CH7_PORT31_PIN15_SEL08, TIM7_CH0_PORT22_PIN03_SEL01, TIM7_CH0_PORT15_PIN10_SEL02, TIM7_CH0_PORT13_PIN13_SEL03, TIM7_CH0_PORT10_PIN14_SEL04, TIM7_CH0_PORT24_PIN08_SEL05, TIM7_CH0_PORT25_PIN08_SEL06, TIM7_CH0_PORT30_PIN00_SEL07, TIM7_CH0_PORT31_PIN00_SEL08, TIM7_CH1_PORT22_PIN02_SEL01, TIM7_CH1_PORT15_PIN11_SEL02, TIM7_CH1_PORT13_PIN14_SEL03, TIM7_CH1_PORT10_PIN15_SEL04, TIM7_CH1_PORT24_PIN09_SEL05, TIM7_CH1_PORT25_PIN09_SEL06, TIM7_CH1_PORT30_PIN01_SEL07, TIM7_CH1_PORT31_PIN01_SEL08, TIM7_CH2_PORT22_PIN01_SEL01, TIM7_CH2_PORT15_PIN12_SEL02, TIM7_CH2_PORT13_PIN15_SEL03, TIM7_CH2_PORT24_PIN10_SEL04, TIM7_CH2_PORT25_PIN10_SEL05, TIM7_CH2_PORT30_PIN02_SEL06, TIM7_CH2_PORT31_PIN02_SEL07, TIM7_CH3_PORT22_PIN00_SEL01, TIM7_CH3_PORT12_PIN00_SEL02, TIM7_CH3_PORT15_PIN13_SEL03, TIM7_CH3_PORT24_PIN11_SEL04, TIM7_CH3_PORT25_PIN11_SEL05, TIM7_CH3_PORT30_PIN03_SEL06, TIM7_CH3_PORT31_PIN03_SEL07, TIM7_CH4_PORT12_PIN01_SEL01, TIM7_CH4_PORT15_PIN14_SEL02, TIM7_CH4_PORT24_PIN12_SEL03, TIM7_CH4_PORT25_PIN12_SEL04, TIM7_CH4_PORT30_PIN04_SEL05, TIM7_CH4_PORT31_PIN04_SEL06, TIM7_CH5_PORT11_PIN00_SEL01, TIM7_CH5_PORT15_PIN15_SEL02, TIM7_CH5_PORT24_PIN13_SEL03, TIM7_CH5_PORT25_PIN13_SEL04, TIM7_CH5_PORT30_PIN05_SEL05, TIM7_CH5_PORT31_PIN05_SEL06, TIM7_CH6_PORT11_PIN01_SEL01, TIM7_CH6_PORT14_PIN11_SEL02, TIM7_CH6_PORT24_PIN14_SEL03, TIM7_CH6_PORT25_PIN14_SEL04, TIM7_CH6_PORT30_PIN06_SEL05, TIM7_CH6_PORT31_PIN06_SEL06, TIM7_CH7_PORT11_PIN04_SEL01, TIM7_CH7_PORT24_PIN15_SEL02, TIM7_CH7_PORT24_PIN14_SEL03, TIM7_CH7_PORT30_PIN07_SEL04, TIM7_CH7_PORT31_PIN07_SEL05}, origin=ChipowerTech, post-build-variant-value=true, set at post-build, default-value=TIM_CHANNEL_IS_NOUSED_SEL00  # This decides the input port and pin of the TIM Channel. This value is applicable for this channel only if TimChannelInputSelect is configured as 'INPUT_OF_CURRENT_TIM_CHANNEL'
      container GtmToPeripheral: multiplicity set at post-build  # This container defines the Connections between GTM and Peripheral Modules
        container SaradcSent [48..48]: requires-index=true  # This Specifies the TOM/ATOM channels that can be used as ADC/SENT Triggers
          integer ChannelId: 0..11, scope=ECU, origin=ChipowerTech, set at pre-compile, default-value=0  # Id of the Gtm to ADC or SENT Module ID, Only TRIXCHY_* (X:0 , Y:0~11) is used by Sent. THA6206: channelId0:Sent/SarAdc0 channelId1:Sent/SarAdc1 channelId2:Sent/SarAdc2 channelId3:Sent/SarAdc3 channelId4:Sent channelId5:Sent channelId6:Sent channelId7:Sent channelId8:Sent/SarAdc8 channelId9:Sent/SarAdc9 channelId10:Sent channelId11:Sent THA6412: channelId0:Sent/SarAdc0 channelId1:Sent/SarAdc1 channelId2:Sent/SarAdc2 channelId3:Sent/SarAdc3 channelId4:Sent/SarAdc4 channelId5:Sent/SarAdc5 channelId6:Sent/SarAdc6 channelId7:Sent/SarAdc7 channelId8:Sent/SarAdc8 channelId9:Sent/SarAdc9 channelId10:Sent/SarAdc10 channelId11:Sent/SarAdc11
          enumeration GtmTriggerSelect: {TRIXCHXX_NO_TRIGGER_SELX_CH00, TRI0CH00_TOM00_CH06_SEL0_CH01, TRI0CH00_TOM00_CH07_SEL0_CH02, TRI0CH00_TOM00_CH13_SEL0_CH03, TRI0CH00_TOM00_CH14_SEL0_CH04, TRI0CH00_ATOM0_CH04_SEL0_CH05, TRI0CH00_ATOM0_CH05_SEL0_CH06, TRI0CH00_ATOM0_CH06_SEL0_CH07, TRI0CH00_ATOM0_CH07_SEL0_CH08, TRI0CH00_ATOM1_CH04_SEL0_CH09, TRI0CH00_ATOM1_CH05_SEL0_CH10, TRI0CH00_ATOM1_CH06_SEL0_CH11, TRI0CH00_ATOM1_CH07_SEL0_CH12, TRI0CH00_ATOM2_CH04_SEL0_CH13, TRI0CH00_ATOM2_CH07_SEL0_CH14, TRI0CH00_TOM02_CH13_SEL0_CH15, TRI1CH00_TOM01_CH06_SEL0_CH01, TRI1CH00_TOM01_CH07_SEL0_CH02, TRI1CH00_TOM01_CH13_SEL0_CH03, TRI1CH00_TOM01_CH14_SEL0_CH04, TRI1CH00_ATOM1_CH04_SEL0_CH05, TRI1CH00_ATOM1_CH05_SEL0_CH06, TRI1CH00_ATOM1_CH06_SEL0_CH07, TRI1CH00_ATOM1_CH07_SEL0_CH08, TRI1CH00_TOM00_CH14_SEL0_CH09, TRI1CH00_TOM00_CH15_SEL0_CH10, TRI1CH00_ATOM0_CH04_SEL0_CH11, TRI1CH00_ATOM0_CH05_SEL0_CH12, TRI1CH00_ATOM0_CH06_SEL0_CH13, TRI1CH00_ATOM0_CH07_SEL0_CH14, TRI1CH00_TOM03_CH13_SEL0_CH15, TRI2CH00_TOM00_CH03_SEL0_CH01, TRI2CH00_TOM00_CH04_SEL0_CH02, TRI2CH00_TOM0_CH05N_SEL0_CH03, TRI2CH00_TOM0_CH06N_SEL0_CH04, TRI2CH00_TOM00_CH07_SEL0_CH05, TRI2CH00_TOM00_CH11_SEL0_CH06, TRI2CH00_TOM00_CH15_SEL0_CH07, TRI2CH00_TOM01_CH03_SEL0_CH08, TRI2CH00_TOM01_CH04_SEL0_CH09, TRI2CH00_TOM1_CH05N_SEL0_CH10, TRI2CH00_TOM1_CH06N_SEL0_CH11, TRI2CH00_TOM01_CH07_SEL0_CH12, TRI2CH00_TOM01_CH11_SEL0_CH13, TRI2CH00_TOM01_CH15_SEL0_CH14, TRI3CH00_ATOM0_CH03_SEL0_CH01, TRI3CH00_ATOM0_CH5N_SEL0_CH02, TRI3CH00_ATOM1_CH03_SEL0_CH03, TRI3CH00_ATOM1_CH5N_SEL0_CH04, TRI3CH00_ATOM2_CH03_SEL0_CH05, TRI3CH00_ATOM2_CH5N_SEL0_CH06, TRI3CH00_ATOM3_CH03_SEL0_CH07, TRI3CH00_ATOM3_CH04_SEL0_CH08, TRI3CH00_ATOM3_CH5N_SEL0_CH09, TRI3CH00_ATOM3_CH07_SEL0_CH10, TRI3CH00_ATOM4_CH03_SEL0_CH11, TRI3CH00_ATOM4_CH04_SEL0_CH12, TRI3CH00_ATOM4_CH5N_SEL0_CH13, TRI3CH00_ATOM4_CH07_SEL0_CH14, TRI3CH00_TOM02_CH14_SEL0_CH15, TRI4CH00_TOM02_CH03_SEL0_CH01, TRI4CH00_TOM02_CH04_SEL0_CH02, TRI4CH00_TOM2_CH05N_SEL0_CH03, TRI4CH00_TOM02_CH07_SEL0_CH04, TRI4CH00_TOM02_CH11_SEL0_CH05, TRI4CH00_TOM02_CH12_SEL0_CH06, TRI4CH00_TOM03_CH03_SEL0_CH07, TRI4CH00_TOM03_CH04_SEL0_CH08, TRI4CH00_TOM3_CH05N_SEL0_CH09, TRI4CH00_TOM03_CH07_SEL0_CH10, TRI4CH00_ATOM5_CH03_SEL0_CH11, TRI4CH00_ATOM5_CH04_SEL0_CH12, TRI4CH00_ATOM5_CH5N_SEL0_CH13, TRI4CH00_ATOM5_CH07_SEL0_CH14, TRI4CH00_TOM03_CH14_SEL0_CH15, TRI0CH01_TOM00_CH06_SEL1_CH01, TRI0CH01_TOM00_CH07_SEL1_CH02, TRI0CH01_TOM00_CH13_SEL1_CH03, TRI0CH01_TOM00_CH14_SEL1_CH04, TRI0CH01_ATOM0_CH04_SEL1_CH05, TRI0CH01_ATOM0_CH05_SEL1_CH06, TRI0CH01_ATOM0_CH06_SEL1_CH07, TRI0CH01_ATOM0_CH07_SEL1_CH08, TRI0CH01_ATOM1_CH04_SEL1_CH09, TRI0CH01_ATOM1_CH05_SEL1_CH10, TRI0CH01_ATOM1_CH06_SEL1_CH11, TRI0CH01_ATOM1_CH07_SEL1_CH12, TRI0CH01_ATOM2_CH04_SEL1_CH13, TRI0CH01_ATOM2_CH07_SEL1_CH14, TRI0CH01_TOM02_CH13_SEL1_CH15, TRI1CH01_TOM01_CH06_SEL1_CH01, TRI1CH01_TOM01_CH07_SEL1_CH02, TRI1CH01_TOM01_CH13_SEL1_CH03, TRI1CH01_TOM01_CH14_SEL1_CH04, TRI1CH01_ATOM1_CH04_SEL1_CH05, TRI1CH01_ATOM1_CH05_SEL1_CH06, TRI1CH01_ATOM1_CH06_SEL1_CH07, TRI1CH01_ATOM1_CH07_SEL1_CH08, TRI1CH01_TOM00_CH14_SEL1_CH09, TRI1CH01_TOM00_CH15_SEL1_CH10, TRI1CH01_ATOM0_CH04_SEL1_CH11, TRI1CH01_ATOM0_CH05_SEL1_CH12, TRI1CH01_ATOM0_CH06_SEL1_CH13, TRI1CH01_ATOM0_CH07_SEL1_CH14, TRI1CH01_TOM03_CH13_SEL1_CH15, TRI2CH01_TOM00_CH03_SEL1_CH01, TRI2CH01_TOM00_CH04_SEL1_CH02, TRI2CH01_TOM0_CH05N_SEL1_CH03, TRI2CH01_TOM0_CH06N_SEL1_CH04, TRI2CH01_TOM00_CH07_SEL1_CH05, TRI2CH01_TOM00_CH11_SEL1_CH06, TRI2CH01_TOM00_CH15_SEL1_CH07, TRI2CH01_TOM01_CH03_SEL1_CH08, TRI2CH01_TOM01_CH04_SEL1_CH09, TRI2CH01_TOM1_CH05N_SEL1_CH10, TRI2CH01_TOM1_CH06N_SEL1_CH11, TRI2CH01_TOM01_CH07_SEL1_CH12, TRI2CH01_TOM01_CH11_SEL1_CH13, TRI2CH01_TOM01_CH15_SEL1_CH14, TRI3CH01_ATOM0_CH03_SEL1_CH01, TRI3CH01_ATOM0_CH5N_SEL1_CH02, TRI3CH01_ATOM1_CH03_SEL1_CH03, TRI3CH01_ATOM1_CH5N_SEL1_CH04, TRI3CH01_ATOM2_CH03_SEL1_CH05, TRI3CH01_ATOM2_CH5N_SEL1_CH06, TRI3CH01_ATOM3_CH03_SEL1_CH07, TRI3CH01_ATOM3_CH04_SEL1_CH08, TRI3CH01_ATOM3_CH5N_SEL1_CH09, TRI3CH01_ATOM3_CH07_SEL1_CH10, TRI3CH01_ATOM4_CH03_SEL1_CH11, TRI3CH01_ATOM4_CH04_SEL1_CH12, TRI3CH01_ATOM4_CH5N_SEL1_CH13, TRI3CH01_ATOM4_CH07_SEL1_CH14, TRI3CH01_TOM02_CH14_SEL1_CH15, TRI4CH01_TOM02_CH03_SEL1_CH01, TRI4CH01_TOM02_CH04_SEL1_CH02, TRI4CH01_TOM2_CH05N_SEL1_CH03, TRI4CH01_TOM02_CH07_SEL1_CH04, TRI4CH01_TOM02_CH11_SEL1_CH05, TRI4CH01_TOM02_CH12_SEL1_CH06, TRI4CH01_TOM03_CH03_SEL1_CH07, TRI4CH01_TOM03_CH04_SEL1_CH08, TRI4CH01_TOM3_CH05N_SEL1_CH09, TRI4CH01_TOM03_CH07_SEL1_CH10, TRI4CH01_ATOM5_CH03_SEL1_CH11, TRI4CH01_ATOM5_CH04_SEL1_CH12, TRI4CH01_ATOM5_CH5N_SEL1_CH13, TRI4CH01_ATOM5_CH07_SEL1_CH14, TRI4CH01_TOM03_CH14_SEL1_CH15, TRI0CH02_TOM00_CH06_SEL2_CH01, TRI0CH02_TOM00_CH07_SEL2_CH02, TRI0CH02_TOM00_CH13_SEL2_CH03, TRI0CH02_TOM00_CH14_SEL2_CH04, TRI0CH02_ATOM0_CH04_SEL2_CH05, TRI0CH02_ATOM0_CH05_SEL2_CH06, TRI0CH02_ATOM0_CH06_SEL2_CH07, TRI0CH02_ATOM0_CH07_SEL2_CH08, TRI0CH02_ATOM1_CH04_SEL2_CH09, TRI0CH02_ATOM1_CH05_SEL2_CH10, TRI0CH02_ATOM1_CH06_SEL2_CH11, TRI0CH02_ATOM1_CH07_SEL2_CH12, TRI0CH02_ATOM2_CH04_SEL2_CH13, TRI0CH02_ATOM2_CH07_SEL2_CH14, TRI0CH02_TOM02_CH13_SEL2_CH15, TRI1CH02_TOM01_CH06_SEL2_CH01, TRI1CH02_TOM01_CH07_SEL2_CH02, TRI1CH02_TOM01_CH13_SEL2_CH03, TRI1CH02_TOM01_CH14_SEL2_CH04, TRI1CH02_ATOM1_CH04_SEL2_CH05, TRI1CH02_ATOM1_CH05_SEL2_CH06, TRI1CH02_ATOM1_CH06_SEL2_CH07, TRI1CH02_ATOM1_CH07_SEL2_CH08, TRI1CH02_TOM00_CH14_SEL2_CH09, TRI1CH02_TOM00_CH15_SEL2_CH10, TRI1CH02_ATOM0_CH04_SEL2_CH11, TRI1CH02_ATOM0_CH05_SEL2_CH12, TRI1CH02_ATOM0_CH06_SEL2_CH13, TRI1CH02_ATOM0_CH07_SEL2_CH14, TRI1CH02_TOM03_CH13_SEL2_CH15, TRI2CH02_TOM00_CH03_SEL2_CH01, TRI2CH02_TOM00_CH04_SEL2_CH02, TRI2CH02_TOM0_CH05N_SEL2_CH03, TRI2CH02_TOM0_CH06N_SEL2_CH04, TRI2CH02_TOM00_CH07_SEL2_CH05, TRI2CH02_TOM00_CH11_SEL2_CH06, TRI2CH02_TOM00_CH15_SEL2_CH07, TRI2CH02_TOM01_CH03_SEL2_CH08, TRI2CH02_TOM01_CH04_SEL2_CH09, TRI2CH02_TOM1_CH05N_SEL2_CH10, TRI2CH02_TOM1_CH06N_SEL2_CH11, TRI2CH02_TOM01_CH07_SEL2_CH12, TRI2CH02_TOM01_CH11_SEL2_CH13, TRI2CH02_TOM01_CH15_SEL2_CH14, TRI3CH02_ATOM0_CH03_SEL2_CH01, TRI3CH02_ATOM0_CH5N_SEL2_CH02, TRI3CH02_ATOM1_CH03_SEL2_CH03, TRI3CH02_ATOM1_CH5N_SEL2_CH04, TRI3CH02_ATOM2_CH03_SEL2_CH05, TRI3CH02_ATOM2_CH5N_SEL2_CH06, TRI3CH02_ATOM3_CH03_SEL2_CH07, TRI3CH02_ATOM3_CH04_SEL2_CH08, TRI3CH02_ATOM3_CH5N_SEL2_CH09, TRI3CH02_ATOM3_CH07_SEL2_CH10, TRI3CH02_ATOM4_CH03_SEL2_CH11, TRI3CH02_ATOM4_CH04_SEL2_CH12, TRI3CH02_ATOM4_CH5N_SEL2_CH13, TRI3CH02_ATOM4_CH07_SEL2_CH14, TRI3CH02_TOM02_CH14_SEL2_CH15, TRI4CH02_TOM02_CH03_SEL2_CH01, TRI4CH02_TOM02_CH04_SEL2_CH02, TRI4CH02_TOM2_CH05N_SEL2_CH03, TRI4CH02_TOM02_CH07_SEL2_CH04, TRI4CH02_TOM02_CH11_SEL2_CH05, TRI4CH02_TOM02_CH12_SEL2_CH06, TRI4CH02_TOM03_CH03_SEL2_CH07, TRI4CH02_TOM03_CH04_SEL2_CH08, TRI4CH02_TOM3_CH05N_SEL2_CH09, TRI4CH02_TOM03_CH07_SEL2_CH10, TRI4CH02_ATOM5_CH03_SEL2_CH11, TRI4CH02_ATOM5_CH04_SEL2_CH12, TRI4CH02_ATOM5_CH5N_SEL2_CH13, TRI4CH02_ATOM5_CH07_SEL2_CH14, TRI4CH02_TOM03_CH14_SEL2_CH15, TRI0CH03_TOM00_CH06_SEL3_CH01, TRI0CH03_TOM00_CH07_SEL3_CH02, TRI0CH03_TOM00_CH13_SEL3_CH03, TRI0CH03_TOM00_CH14_SEL3_CH04, TRI0CH03_ATOM0_CH04_SEL3_CH05, TRI0CH03_ATOM0_CH05_SEL3_CH06, TRI0CH03_ATOM0_CH06_SEL3_CH07, TRI0CH03_ATOM0_CH07_SEL3_CH08, TRI0CH03_TOM01_CH06_SEL3_CH09, TRI0CH03_TOM01_CH07_SEL3_CH10, TRI0CH03_ATOM2_CH04_SEL3_CH11, TRI0CH03_ATOM2_CH05_SEL3_CH12, TRI0CH03_ATOM3_CH04_SEL3_CH13, TRI0CH03_ATOM3_CH05_SEL3_CH14, TRI0CH03_TOM02_CH13_SEL3_CH15, TRI1CH03_TOM01_CH06_SEL3_CH01, TRI1CH03_TOM01_CH07_SEL3_CH02, TRI1CH03_TOM01_CH13_SEL3_CH03, TRI1CH03_TOM01_CH14_SEL3_CH04, TRI1CH03_ATOM1_CH04_SEL3_CH05, TRI1CH03_ATOM1_CH05_SEL3_CH06, TRI1CH03_ATOM1_CH06_SEL3_CH07, TRI1CH03_ATOM1_CH07_SEL3_CH08, TRI1CH03_TOM01_CH14_SEL3_CH09, TRI1CH03_TOM01_CH15_SEL3_CH10, TRI1CH03_ATOM2_CH06_SEL3_CH11, TRI1CH03_ATOM2_CH07_SEL3_CH12, TRI1CH03_ATOM3_CH06_SEL3_CH13, TRI1CH03_ATOM3_CH07_SEL3_CH14, TRI1CH03_TOM03_CH13_SEL3_CH15, TRI2CH03_TOM00_CH03_SEL3_CH01, TRI2CH03_TOM00_CH04_SEL3_CH02, TRI2CH03_TOM0_CH05N_SEL3_CH03, TRI2CH03_TOM0_CH06N_SEL3_CH04, TRI2CH03_TOM00_CH07_SEL3_CH05, TRI2CH03_TOM00_CH11_SEL3_CH06, TRI2CH03_TOM00_CH15_SEL3_CH07, TRI2CH03_TOM01_CH03_SEL3_CH08, TRI2CH03_TOM01_CH04_SEL3_CH09, TRI2CH03_TOM1_CH05N_SEL3_CH10, TRI2CH03_TOM1_CH06N_SEL3_CH11, TRI2CH03_TOM01_CH07_SEL3_CH12, TRI2CH03_TOM01_CH11_SEL3_CH13, TRI2CH03_TOM01_CH15_SEL3_CH14, TRI3CH03_ATOM0_CH03_SEL3_CH01, TRI3CH03_ATOM0_CH5N_SEL3_CH02, TRI3CH03_ATOM1_CH03_SEL3_CH03, TRI3CH03_ATOM1_CH5N_SEL3_CH04, TRI3CH03_ATOM2_CH03_SEL3_CH05, TRI3CH03_ATOM2_CH5N_SEL3_CH06, TRI3CH03_ATOM2_CH07_SEL3_CH07, TRI3CH03_ATOM3_CH03_SEL3_CH08, TRI3CH03_ATOM3_CH5N_SEL3_CH09, TRI3CH03_ATOM4_CH03_SEL3_CH10, TRI3CH03_ATOM4_CH04_SEL3_CH11, TRI3CH03_ATOM4_CH5N_SEL3_CH12, TRI3CH03_ATOM4_CH07_SEL3_CH13, TRI3CH03_TOM02_CH14_SEL3_CH15, TRI4CH03_TOM02_CH03_SEL3_CH01, TRI4CH03_TOM02_CH04_SEL3_CH02, TRI4CH03_TOM2_CH05N_SEL3_CH03, TRI4CH03_TOM02_CH07_SEL3_CH04, TRI4CH03_TOM02_CH11_SEL3_CH05, TRI4CH03_TOM02_CH12_SEL3_CH06, TRI4CH03_TOM03_CH03_SEL3_CH07, TRI4CH03_TOM03_CH04_SEL3_CH08, TRI4CH03_TOM3_CH05N_SEL3_CH09, TRI4CH03_TOM03_CH07_SEL3_CH10, TRI4CH03_ATOM5_CH03_SEL3_CH11, TRI4CH03_ATOM5_CH04_SEL3_CH12, TRI4CH03_ATOM5_CH5N_SEL3_CH13, TRI4CH03_ATOM5_CH07_SEL3_CH14, TRI4CH03_TOM03_CH14_SEL3_CH15, TRI0CH04_TOM00_CH06_SEL4_CH01, TRI0CH04_TOM00_CH07_SEL4_CH02, TRI0CH04_TOM00_CH13_SEL4_CH03, TRI0CH04_TOM00_CH14_SEL4_CH04, TRI0CH04_ATOM0_CH04_SEL4_CH05, TRI0CH04_ATOM0_CH05_SEL4_CH06, TRI0CH04_ATOM0_CH06_SEL4_CH07, TRI0CH04_ATOM0_CH07_SEL4_CH08, TRI0CH04_TOM01_CH06_SEL4_CH09, TRI0CH04_TOM01_CH07_SEL4_CH10, TRI0CH04_ATOM2_CH04_SEL4_CH11, TRI0CH04_ATOM2_CH05_SEL4_CH12, TRI0CH04_ATOM3_CH04_SEL4_CH13, TRI0CH04_ATOM3_CH05_SEL4_CH14, TRI0CH04_TOM02_CH13_SEL4_CH15, TRI1CH04_TOM01_CH06_SEL4_CH01, TRI1CH04_TOM01_CH07_SEL4_CH02, TRI1CH04_TOM01_CH13_SEL4_CH03, TRI1CH04_TOM01_CH14_SEL4_CH04, TRI1CH04_ATOM1_CH04_SEL4_CH05, TRI1CH04_ATOM1_CH05_SEL4_CH06, TRI1CH04_ATOM1_CH06_SEL4_CH07, TRI1CH04_ATOM1_CH07_SEL4_CH08, TRI1CH04_TOM01_CH14_SEL4_CH09, TRI1CH04_TOM01_CH15_SEL4_CH10, TRI1CH04_ATOM2_CH06_SEL4_CH11, TRI1CH04_ATOM2_CH07_SEL4_CH12, TRI1CH04_ATOM3_CH06_SEL4_CH13, TRI1CH04_ATOM3_CH07_SEL4_CH14, TRI1CH04_TOM03_CH13_SEL4_CH15, TRI2CH04_TOM00_CH03_SEL4_CH01, TRI2CH04_TOM00_CH04_SEL4_CH02, TRI2CH04_TOM0_CH05N_SEL4_CH03, TRI2CH04_TOM0_CH06N_SEL4_CH04, TRI2CH04_TOM00_CH07_SEL4_CH05, TRI2CH04_TOM00_CH11_SEL4_CH06, TRI2CH04_TOM00_CH15_SEL4_CH07, TRI2CH04_TOM01_CH03_SEL4_CH08, TRI2CH04_TOM01_CH04_SEL4_CH09, TRI2CH04_TOM1_CH05N_SEL4_CH10, TRI2CH04_TOM1_CH06N_SEL4_CH11, TRI2CH04_TOM01_CH07_SEL4_CH12, TRI2CH04_TOM01_CH11_SEL4_CH13, TRI2CH04_TOM01_CH15_SEL4_CH14, TRI3CH04_ATOM0_CH03_SEL4_CH01, TRI3CH04_ATOM0_CH5N_SEL4_CH02, TRI3CH04_ATOM1_CH03_SEL4_CH03, TRI3CH04_ATOM1_CH5N_SEL4_CH04, TRI3CH04_ATOM2_CH03_SEL4_CH05, TRI3CH04_ATOM2_CH5N_SEL4_CH06, TRI3CH04_ATOM2_CH07_SEL4_CH07, TRI3CH04_ATOM3_CH03_SEL4_CH08, TRI3CH04_ATOM3_CH5N_SEL4_CH09, TRI3CH04_ATOM4_CH03_SEL4_CH10, TRI3CH04_ATOM4_CH04_SEL4_CH11, TRI3CH04_ATOM4_CH5N_SEL4_CH12, TRI3CH04_ATOM4_CH07_SEL4_CH13, TRI3CH04_TOM02_CH14_SEL4_CH15, TRI4CH04_TOM02_CH03_SEL4_CH01, TRI4CH04_TOM02_CH04_SEL4_CH02, TRI4CH04_TOM2_CH05N_SEL4_CH03, TRI4CH04_TOM02_CH07_SEL4_CH04, TRI4CH04_TOM02_CH11_SEL4_CH05, TRI4CH04_TOM02_CH12_SEL4_CH06, TRI4CH04_TOM03_CH03_SEL4_CH07, TRI4CH04_TOM03_CH04_SEL4_CH08, TRI4CH04_TOM3_CH05N_SEL4_CH09, TRI4CH04_TOM03_CH07_SEL4_CH10, TRI4CH04_ATOM5_CH03_SEL4_CH11, TRI4CH04_ATOM5_CH04_SEL4_CH12, TRI4CH04_ATOM5_CH5N_SEL4_CH13, TRI4CH04_ATOM5_CH07_SEL4_CH14, TRI4CH04_TOM03_CH14_SEL4_CH15, TRI0CH05_TOM02_CH06_SEL5_CH01, TRI0CH05_TOM02_CH07_SEL5_CH02, TRI0CH05_TOM00_CH13_SEL5_CH03, TRI0CH05_TOM00_CH14_SEL5_CH04, TRI0CH05_ATOM4_CH04_SEL5_CH05, TRI0CH05_ATOM4_CH05_SEL5_CH06, TRI0CH05_ATOM5_CH04_SEL5_CH07, TRI0CH05_ATOM5_CH05_SEL5_CH08, TRI0CH05_TOM00_CH06_SEL5_CH09, TRI0CH05_TOM00_CH07_SEL5_CH10, TRI0CH05_ATOM0_CH04_SEL5_CH11, TRI0CH05_ATOM0_CH05_SEL5_CH12, TRI0CH05_ATOM0_CH06_SEL5_CH13, TRI0CH05_ATOM0_CH07_SEL5_CH14, TRI0CH05_ATOM2_CH07_SEL5_CH15, TRI1CH05_TOM02_CH14_SEL5_CH01, TRI1CH05_TOM02_CH15_SEL5_CH02, TRI1CH05_TOM01_CH13_SEL5_CH03, TRI1CH05_TOM01_CH14_SEL5_CH04, TRI1CH05_ATOM4_CH06_SEL5_CH05, TRI1CH05_ATOM4_CH07_SEL5_CH06, TRI1CH05_ATOM5_CH06_SEL5_CH07, TRI1CH05_ATOM5_CH07_SEL5_CH08, TRI1CH05_TOM01_CH06_SEL5_CH09, TRI1CH05_TOM01_CH07_SEL5_CH10, TRI1CH05_ATOM1_CH04_SEL5_CH11, TRI1CH05_ATOM1_CH05_SEL5_CH12, TRI1CH05_ATOM1_CH06_SEL5_CH13, TRI1CH05_ATOM1_CH07_SEL5_CH14, TRI1CH05_ATOM3_CH07_SEL5_CH15, TRI2CH05_TOM00_CH03_SEL5_CH01, TRI2CH05_TOM00_CH04_SEL5_CH02, TRI2CH05_TOM0_CH05N_SEL5_CH03, TRI2CH05_TOM01_CH03_SEL5_CH04, TRI2CH05_TOM01_CH04_SEL5_CH05, TRI2CH05_TOM1_CH05N_SEL5_CH06, TRI2CH05_TOM02_CH03_SEL5_CH07, TRI2CH05_TOM02_CH04_SEL5_CH08, TRI2CH05_TOM2_CH05N_SEL5_CH09, TRI2CH05_TOM03_CH04_SEL5_CH10, TRI2CH05_TOM3_CH05N_SEL5_CH11, TRI2CH05_TOM03_CH07_SEL5_CH12, TRI2CH05_TOM04_CH04_SEL5_CH13, TRI2CH05_TOM4_CH05N_SEL5_CH14, TRI2CH05_TOM04_CH07_SEL5_CH15, TRI3CH05_ATOM0_CH03_SEL5_CH01, TRI3CH05_ATOM0_CH5N_SEL5_CH02, TRI3CH05_ATOM1_CH03_SEL5_CH03, TRI3CH05_ATOM1_CH5N_SEL5_CH04, TRI3CH05_ATOM2_CH03_SEL5_CH05, TRI3CH05_ATOM2_CH5N_SEL5_CH06, TRI3CH05_ATOM3_CH03_SEL5_CH07, TRI3CH05_ATOM3_CH5N_SEL5_CH08, TRI3CH05_ATOM4_CH03_SEL5_CH09, TRI3CH05_ATOM4_CH5N_SEL5_CH10, TRI3CH05_ATOM5_CH03_SEL5_CH11, TRI3CH05_ATOM5_CH5N_SEL5_CH12, TRI3CH05_ATOM6_CH04_SEL5_CH13, TRI3CH05_ATOM6_CH5N_SEL5_CH14, TRI3CH05_ATOM6_CH07_SEL5_CH15, TRI4CH05_TOM04_CH14_SEL5_CH01, TRI4CH05_ATOM7_CH05_SEL5_CH03, TRI4CH05_ATOM7_CH07_SEL5_CH04, TRI0CH06_TOM02_CH06_SEL6_CH01, TRI0CH06_TOM02_CH07_SEL6_CH02, TRI0CH06_TOM00_CH13_SEL6_CH03, TRI0CH06_TOM00_CH14_SEL6_CH04, TRI0CH06_ATOM4_CH04_SEL6_CH05, TRI0CH06_ATOM4_CH05_SEL6_CH06, TRI0CH06_ATOM5_CH04_SEL6_CH07, TRI0CH06_ATOM5_CH05_SEL6_CH08, TRI0CH06_TOM00_CH06_SEL6_CH09, TRI0CH06_TOM00_CH07_SEL6_CH10, TRI0CH06_ATOM0_CH04_SEL6_CH11, TRI0CH06_ATOM0_CH05_SEL6_CH12, TRI0CH06_ATOM0_CH06_SEL6_CH13, TRI0CH06_ATOM0_CH07_SEL6_CH14, TRI0CH06_ATOM2_CH07_SEL6_CH15, TRI1CH06_TOM02_CH14_SEL6_CH01, TRI1CH06_TOM02_CH15_SEL6_CH02, TRI1CH06_TOM01_CH13_SEL6_CH03, TRI1CH06_TOM01_CH14_SEL6_CH04, TRI1CH06_ATOM4_CH06_SEL6_CH05, TRI1CH06_ATOM4_CH07_SEL6_CH06, TRI1CH06_ATOM5_CH06_SEL6_CH07, TRI1CH06_ATOM5_CH07_SEL6_CH08, TRI1CH06_TOM01_CH06_SEL6_CH09, TRI1CH06_TOM01_CH07_SEL6_CH10, TRI1CH06_ATOM1_CH04_SEL6_CH11, TRI1CH06_ATOM1_CH05_SEL6_CH12, TRI1CH06_ATOM1_CH06_SEL6_CH13, TRI1CH06_ATOM1_CH07_SEL6_CH14, TRI1CH06_ATOM3_CH07_SEL6_CH15, TRI2CH06_TOM00_CH03_SEL6_CH01, TRI2CH06_TOM00_CH04_SEL6_CH02, TRI2CH06_TOM0_CH05N_SEL6_CH03, TRI2CH06_TOM01_CH03_SEL6_CH04, TRI2CH06_TOM01_CH04_SEL6_CH05, TRI2CH06_TOM1_CH05N_SEL6_CH06, TRI2CH06_TOM02_CH03_SEL6_CH07, TRI2CH06_TOM02_CH04_SEL6_CH08, TRI2CH06_TOM2_CH05N_SEL6_CH09, TRI2CH06_TOM03_CH04_SEL6_CH10, TRI2CH06_TOM3_CH05N_SEL6_CH11, TRI2CH06_TOM03_CH07_SEL6_CH12, TRI2CH06_TOM04_CH04_SEL6_CH13, TRI2CH06_TOM4_CH05N_SEL6_CH14, TRI2CH06_TOM04_CH07_SEL6_CH15, TRI3CH06_ATOM0_CH03_SEL6_CH01, TRI3CH06_ATOM0_CH5N_SEL6_CH02, TRI3CH06_ATOM1_CH03_SEL6_CH03, TRI3CH06_ATOM1_CH5N_SEL6_CH04, TRI3CH06_ATOM2_CH03_SEL6_CH05, TRI3CH06_ATOM2_CH5N_SEL6_CH06, TRI3CH06_ATOM3_CH03_SEL6_CH07, TRI3CH06_ATOM3_CH5N_SEL6_CH08, TRI3CH06_ATOM4_CH03_SEL6_CH09, TRI3CH06_ATOM4_CH5N_SEL6_CH10, TRI3CH06_ATOM5_CH03_SEL6_CH11, TRI3CH06_ATOM5_CH5N_SEL6_CH12, TRI3CH06_ATOM6_CH04_SEL6_CH13, TRI3CH06_ATOM6_CH5N_SEL6_CH14, TRI3CH06_ATOM6_CH07_SEL6_CH15, TRI4CH06_TOM04_CH14_SEL6_CH01, TRI4CH06_ATOM7_CH05_SEL6_CH03, TRI4CH06_ATOM7_CH07_SEL6_CH04, TRI0CH07_TOM02_CH06_SEL7_CH01, TRI0CH07_TOM02_CH07_SEL7_CH02, TRI0CH07_TOM00_CH13_SEL7_CH03, TRI0CH07_TOM00_CH14_SEL7_CH04, TRI0CH07_ATOM4_CH04_SEL7_CH05, TRI0CH07_ATOM4_CH05_SEL7_CH06, TRI0CH07_ATOM5_CH04_SEL7_CH07, TRI0CH07_ATOM5_CH05_SEL7_CH08, TRI0CH07_TOM00_CH06_SEL7_CH09, TRI0CH07_TOM00_CH07_SEL7_CH10, TRI0CH07_ATOM0_CH04_SEL7_CH11, TRI0CH07_ATOM0_CH05_SEL7_CH12, TRI0CH07_ATOM0_CH06_SEL7_CH13, TRI0CH07_ATOM0_CH07_SEL7_CH14, TRI0CH07_ATOM2_CH07_SEL7_CH15, TRI1CH07_TOM02_CH14_SEL7_CH01, TRI1CH07_TOM02_CH15_SEL7_CH02, TRI1CH07_TOM01_CH13_SEL7_CH03, TRI1CH07_TOM01_CH14_SEL7_CH04, TRI1CH07_ATOM4_CH06_SEL7_CH05, TRI1CH07_ATOM4_CH07_SEL7_CH06, TRI1CH07_ATOM5_CH06_SEL7_CH07, TRI1CH07_ATOM5_CH07_SEL7_CH08, TRI1CH07_TOM01_CH06_SEL7_CH09, TRI1CH07_TOM01_CH07_SEL7_CH10, TRI1CH07_ATOM1_CH04_SEL7_CH11, TRI1CH07_ATOM1_CH05_SEL7_CH12, TRI1CH07_ATOM1_CH06_SEL7_CH13, TRI1CH07_ATOM1_CH07_SEL7_CH14, TRI1CH07_ATOM3_CH07_SEL7_CH15, TRI2CH07_TOM00_CH03_SEL7_CH01, TRI2CH07_TOM00_CH04_SEL7_CH02, TRI2CH07_TOM0_CH05N_SEL7_CH03, TRI2CH07_TOM01_CH03_SEL7_CH04, TRI2CH07_TOM01_CH04_SEL7_CH05, TRI2CH07_TOM1_CH05N_SEL7_CH06, TRI2CH07_TOM02_CH03_SEL7_CH07, TRI2CH07_TOM02_CH04_SEL7_CH08, TRI2CH07_TOM2_CH05N_SEL7_CH09, TRI2CH07_TOM03_CH04_SEL7_CH10, TRI2CH07_TOM3_CH05N_SEL7_CH11, TRI2CH07_TOM03_CH07_SEL7_CH12, TRI2CH07_TOM04_CH04_SEL7_CH13, TRI2CH07_TOM4_CH05N_SEL7_CH14, TRI2CH07_TOM04_CH07_SEL7_CH15, TRI3CH07_ATOM0_CH03_SEL7_CH01, TRI3CH07_ATOM0_CH5N_SEL7_CH02, TRI3CH07_ATOM1_CH03_SEL7_CH03, TRI3CH07_ATOM1_CH5N_SEL7_CH04, TRI3CH07_ATOM2_CH03_SEL7_CH05, TRI3CH07_ATOM2_CH5N_SEL7_CH06, TRI3CH07_ATOM3_CH03_SEL7_CH07, TRI3CH07_ATOM3_CH5N_SEL7_CH08, TRI3CH07_ATOM4_CH03_SEL7_CH09, TRI3CH07_ATOM4_CH5N_SEL7_CH10, TRI3CH07_ATOM5_CH03_SEL7_CH11, TRI3CH07_ATOM5_CH5N_SEL7_CH12, TRI3CH07_ATOM6_CH04_SEL7_CH13, TRI3CH07_ATOM6_CH5N_SEL7_CH14, TRI3CH07_ATOM6_CH07_SEL7_CH15, TRI4CH07_TOM04_CH14_SEL7_CH01, TRI4CH07_ATOM7_CH05_SEL7_CH03, TRI4CH07_ATOM7_CH07_SEL7_CH04, TRI0CH08_TOM00_CH06_SEL8_CH01, TRI0CH08_TOM00_CH07_SEL8_CH02, TRI0CH08_TOM00_CH13_SEL8_CH03, TRI0CH08_TOM00_CH14_SEL8_CH04, TRI0CH08_ATOM0_CH04_SEL8_CH05, TRI0CH08_ATOM0_CH05_SEL8_CH06, TRI0CH08_ATOM0_CH06_SEL8_CH07, TRI0CH08_ATOM0_CH07_SEL8_CH08, TRI0CH08_TOM00_CH06_SEL8_CH09, TRI0CH08_TOM00_CH07_SEL8_CH10, TRI0CH08_ATOM4_CH04_SEL8_CH11, TRI0CH08_ATOM4_CH05_SEL8_CH12, TRI0CH08_ATOM3_CH04_SEL8_CH13, TRI0CH08_ATOM3_CH05_SEL8_CH14, TRI0CH08_TOM00_CH15_SEL8_CH15, TRI1CH08_TOM01_CH06_SEL8_CH01, TRI1CH08_TOM01_CH07_SEL8_CH02, TRI1CH08_TOM01_CH13_SEL8_CH03, TRI1CH08_TOM01_CH14_SEL8_CH04, TRI1CH08_ATOM1_CH04_SEL8_CH05, TRI1CH08_ATOM1_CH05_SEL8_CH06, TRI1CH08_ATOM1_CH06_SEL8_CH07, TRI1CH08_ATOM1_CH07_SEL8_CH08, TRI1CH08_TOM00_CH14_SEL8_CH09, TRI1CH08_TOM00_CH15_SEL8_CH10, TRI1CH08_ATOM4_CH06_SEL8_CH11, TRI1CH08_ATOM4_CH07_SEL8_CH12, TRI1CH08_ATOM3_CH06_SEL8_CH13, TRI1CH08_ATOM3_CH07_SEL8_CH14, TRI1CH08_ATOM5_CH03_SEL8_CH15, TRI2CH08_TOM00_CH03_SEL8_CH01, TRI2CH08_TOM00_CH04_SEL8_CH02, TRI2CH08_TOM0_CH05N_SEL8_CH03, TRI2CH08_TOM01_CH03_SEL8_CH04, TRI2CH08_TOM01_CH04_SEL8_CH05, TRI2CH08_TOM1_CH05N_SEL8_CH06, TRI2CH08_TOM02_CH03_SEL8_CH07, TRI2CH08_TOM02_CH04_SEL8_CH08, TRI2CH08_TOM2_CH05N_SEL8_CH09, TRI2CH08_TOM02_CH07_SEL8_CH10, TRI2CH08_TOM03_CH03_SEL8_CH11, TRI2CH08_TOM03_CH04_SEL8_CH12, TRI2CH08_TOM3_CH05N_SEL8_CH13, TRI2CH08_TOM03_CH07_SEL8_CH14, TRI2CH08_TOM04_CH03_SEL8_CH15, TRI3CH08_ATOM0_CH03_SEL8_CH01, TRI3CH08_ATOM0_CH5N_SEL8_CH02, TRI3CH08_ATOM1_CH03_SEL8_CH03, TRI3CH08_ATOM1_CH5N_SEL8_CH04, TRI3CH08_ATOM2_CH03_SEL8_CH05, TRI3CH08_ATOM2_CH04_SEL8_CH06, TRI3CH08_ATOM2_CH5N_SEL8_CH07, TRI3CH08_ATOM2_CH07_SEL8_CH08, TRI3CH08_ATOM3_CH03_SEL8_CH09, TRI3CH08_ATOM3_CH5N_SEL8_CH10, TRI3CH08_ATOM4_CH03_SEL8_CH11, TRI3CH08_ATOM4_CH5N_SEL8_CH12, TRI3CH08_ATOM5_CH04_SEL8_CH13, TRI3CH08_ATOM5_CH5N_SEL8_CH14, TRI3CH08_ATOM5_CH07_SEL8_CH15, TRI4CH08_TOM02_CH14_SEL8_CH01, TRI4CH08_TOM03_CH14_SEL8_CH02, TRI4CH08_TOM04_CH14_SEL8_CH03, TRI4CH08_ATOM6_CH04_SEL8_CH04, TRI4CH08_ATOM6_CH5N_SEL8_CH05, TRI4CH08_ATOM6_CH07_SEL8_CH06, TRI4CH08_ATOM7_CH04_SEL8_CH07, TRI4CH08_ATOM7_CH05_SEL8_CH08, TRI4CH08_ATOM7_CH07_SEL8_CH09, TRI4CH08_TOM04_CH04_SEL8_CH13, TRI4CH08_TOM4_CH05N_SEL8_CH14, TRI4CH08_TOM04_CH07_SEL8_CH15, TRI0CH09_TOM00_CH06_SEL9_CH01, TRI0CH09_TOM00_CH07_SEL9_CH02, TRI0CH09_TOM00_CH13_SEL9_CH03, TRI0CH09_TOM00_CH14_SEL9_CH04, TRI0CH09_ATOM0_CH04_SEL9_CH05, TRI0CH09_ATOM0_CH05_SEL9_CH06, TRI0CH09_ATOM0_CH06_SEL9_CH07, TRI0CH09_ATOM0_CH07_SEL9_CH08, TRI0CH09_TOM00_CH06_SEL9_CH09, TRI0CH09_TOM00_CH07_SEL9_CH10, TRI0CH09_ATOM4_CH04_SEL9_CH11, TRI0CH09_ATOM4_CH05_SEL9_CH12, TRI0CH09_ATOM3_CH04_SEL9_CH13, TRI0CH09_ATOM3_CH05_SEL9_CH14, TRI0CH09_TOM00_CH15_SEL9_CH15, TRI1CH09_TOM01_CH06_SEL9_CH01, TRI1CH09_TOM01_CH07_SEL9_CH02, TRI1CH09_TOM01_CH13_SEL9_CH03, TRI1CH09_TOM01_CH14_SEL9_CH04, TRI1CH09_ATOM1_CH04_SEL9_CH05, TRI1CH09_ATOM1_CH05_SEL9_CH06, TRI1CH09_ATOM1_CH06_SEL9_CH07, TRI1CH09_ATOM1_CH07_SEL9_CH08, TRI1CH09_TOM00_CH14_SEL9_CH09, TRI1CH09_TOM00_CH15_SEL9_CH10, TRI1CH09_ATOM4_CH06_SEL9_CH11, TRI1CH09_ATOM4_CH07_SEL9_CH12, TRI1CH09_ATOM3_CH06_SEL9_CH13, TRI1CH09_ATOM3_CH07_SEL9_CH14, TRI1CH09_ATOM5_CH03_SEL9_CH15, TRI2CH09_TOM00_CH03_SEL9_CH01, TRI2CH09_TOM00_CH04_SEL9_CH02, TRI2CH09_TOM0_CH05N_SEL9_CH03, TRI2CH09_TOM01_CH03_SEL9_CH04, TRI2CH09_TOM01_CH04_SEL9_CH05, TRI2CH09_TOM1_CH05N_SEL9_CH06, TRI2CH09_TOM02_CH03_SEL9_CH07, TRI2CH09_TOM02_CH04_SEL9_CH08, TRI2CH09_TOM2_CH05N_SEL9_CH09, TRI2CH09_TOM02_CH07_SEL9_CH10, TRI2CH09_TOM03_CH03_SEL9_CH11, TRI2CH09_TOM03_CH04_SEL9_CH12, TRI2CH09_TOM3_CH05N_SEL9_CH13, TRI2CH09_TOM03_CH07_SEL9_CH14, TRI2CH09_TOM04_CH03_SEL9_CH15, TRI3CH09_ATOM0_CH03_SEL9_CH01, TRI3CH09_ATOM0_CH5N_SEL9_CH02, TRI3CH09_ATOM1_CH03_SEL9_CH03, TRI3CH09_ATOM1_CH5N_SEL9_CH04, TRI3CH09_ATOM2_CH03_SEL9_CH05, TRI3CH09_ATOM2_CH04_SEL9_CH06, TRI3CH09_ATOM2_CH5N_SEL9_CH07, TRI3CH09_ATOM2_CH07_SEL9_CH08, TRI3CH09_ATOM3_CH03_SEL9_CH09, TRI3CH09_ATOM3_CH5N_SEL9_CH10, TRI3CH09_ATOM4_CH03_SEL9_CH11, TRI3CH09_ATOM4_CH5N_SEL9_CH12, TRI3CH09_ATOM5_CH04_SEL9_CH13, TRI3CH09_ATOM5_CH5N_SEL9_CH14, TRI3CH09_ATOM5_CH07_SEL9_CH15, TRI4CH09_TOM02_CH14_SEL9_CH01, TRI4CH09_TOM03_CH14_SEL9_CH02, TRI4CH09_TOM04_CH14_SEL9_CH03, TRI4CH09_ATOM6_CH04_SEL9_CH04, TRI4CH09_ATOM6_CH5N_SEL9_CH05, TRI4CH09_ATOM6_CH07_SEL9_CH06, TRI4CH09_ATOM7_CH04_SEL9_CH07, TRI4CH09_ATOM7_CH05_SEL9_CH08, TRI4CH09_ATOM7_CH07_SEL9_CH09, TRI4CH09_TOM04_CH04_SEL9_CH13, TRI4CH09_TOM4_CH05N_SEL9_CH14, TRI4CH09_TOM04_CH07_SEL9_CH15, TRI0CH0A_TOM00_CH06_SELA_CH01, TRI0CH0A_TOM00_CH07_SELA_CH02, TRI0CH0A_TOM00_CH13_SELA_CH03, TRI0CH0A_TOM00_CH14_SELA_CH04, TRI0CH0A_ATOM0_CH04_SELA_CH05, TRI0CH0A_ATOM0_CH05_SELA_CH06, TRI0CH0A_ATOM0_CH06_SELA_CH07, TRI0CH0A_ATOM0_CH07_SELA_CH08, TRI0CH0A_TOM00_CH06_SELA_CH09, TRI0CH0A_TOM00_CH07_SELA_CH10, TRI0CH0A_ATOM4_CH04_SELA_CH11, TRI0CH0A_ATOM4_CH05_SELA_CH12, TRI0CH0A_ATOM3_CH04_SELA_CH13, TRI0CH0A_ATOM3_CH05_SELA_CH14, TRI0CH0A_TOM00_CH15_SELA_CH15, TRI1CH0A_TOM01_CH06_SELA_CH01, TRI1CH0A_TOM01_CH07_SELA_CH02, TRI1CH0A_TOM01_CH13_SELA_CH03, TRI1CH0A_TOM01_CH14_SELA_CH04, TRI1CH0A_ATOM1_CH04_SELA_CH05, TRI1CH0A_ATOM1_CH05_SELA_CH06, TRI1CH0A_ATOM1_CH06_SELA_CH07, TRI1CH0A_ATOM1_CH07_SELA_CH08, TRI1CH0A_TOM00_CH14_SELA_CH09, TRI1CH0A_TOM00_CH15_SELA_CH10, TRI1CH0A_ATOM4_CH06_SELA_CH11, TRI1CH0A_ATOM4_CH07_SELA_CH12, TRI1CH0A_ATOM3_CH06_SELA_CH13, TRI1CH0A_ATOM3_CH07_SELA_CH14, TRI1CH0A_ATOM5_CH03_SELA_CH15, TRI2CH0A_TOM00_CH03_SELA_CH01, TRI2CH0A_TOM00_CH04_SELA_CH02, TRI2CH0A_TOM0_CH05N_SELA_CH03, TRI2CH0A_TOM01_CH03_SELA_CH04, TRI2CH0A_TOM01_CH04_SELA_CH05, TRI2CH0A_TOM1_CH05N_SELA_CH06, TRI2CH0A_TOM02_CH03_SELA_CH07, TRI2CH0A_TOM02_CH04_SELA_CH08, TRI2CH0A_TOM2_CH05N_SELA_CH09, TRI2CH0A_TOM02_CH07_SELA_CH10, TRI2CH0A_TOM03_CH03_SELA_CH11, TRI2CH0A_TOM03_CH04_SELA_CH12, TRI2CH0A_TOM3_CH05N_SELA_CH13, TRI2CH0A_TOM03_CH07_SELA_CH14, TRI2CH0A_TOM04_CH03_SELA_CH15, TRI3CH0A_ATOM0_CH03_SELA_CH01, TRI3CH0A_ATOM0_CH5N_SELA_CH02, TRI3CH0A_ATOM1_CH03_SELA_CH03, TRI3CH0A_ATOM1_CH5N_SELA_CH04, TRI3CH0A_ATOM2_CH03_SELA_CH05, TRI3CH0A_ATOM2_CH04_SELA_CH06, TRI3CH0A_ATOM2_CH5N_SELA_CH07, TRI3CH0A_ATOM2_CH07_SELA_CH08, TRI3CH0A_ATOM3_CH03_SELA_CH09, TRI3CH0A_ATOM3_CH5N_SELA_CH10, TRI3CH0A_ATOM4_CH03_SELA_CH11, TRI3CH0A_ATOM4_CH5N_SELA_CH12, TRI3CH0A_ATOM5_CH04_SELA_CH13, TRI3CH0A_ATOM5_CH5N_SELA_CH14, TRI3CH0A_ATOM5_CH07_SELA_CH15, TRI4CH0A_TOM02_CH14_SELA_CH01, TRI4CH0A_TOM03_CH14_SELA_CH02, TRI4CH0A_TOM04_CH14_SELA_CH03, TRI4CH0A_ATOM6_CH04_SELA_CH04, TRI4CH0A_ATOM6_CH5N_SELA_CH05, TRI4CH0A_ATOM6_CH07_SELA_CH06, TRI4CH0A_ATOM7_CH04_SELA_CH07, TRI4CH0A_ATOM7_CH05_SELA_CH08, TRI4CH0A_ATOM7_CH07_SELA_CH09, TRI4CH0A_TOM04_CH04_SELA_CH13, TRI4CH0A_TOM4_CH05N_SELA_CH14, TRI4CH0A_TOM04_CH07_SELA_CH15, TRI0CH0B_TOM00_CH06_SELB_CH01, TRI0CH0B_TOM00_CH07_SELB_CH02, TRI0CH0B_TOM00_CH13_SELB_CH03, TRI0CH0B_TOM00_CH14_SELB_CH04, TRI0CH0B_ATOM0_CH04_SELB_CH05, TRI0CH0B_ATOM0_CH05_SELB_CH06, TRI0CH0B_ATOM0_CH06_SELB_CH07, TRI0CH0B_ATOM0_CH07_SELB_CH08, TRI0CH0B_TOM00_CH06_SELB_CH09, TRI0CH0B_TOM00_CH07_SELB_CH10, TRI0CH0B_ATOM4_CH04_SELB_CH11, TRI0CH0B_ATOM4_CH05_SELB_CH12, TRI0CH0B_ATOM3_CH04_SELB_CH13, TRI0CH0B_ATOM3_CH05_SELB_CH14, TRI0CH0B_TOM00_CH15_SELB_CH15, TRI1CH0B_TOM01_CH06_SELB_CH01, TRI1CH0B_TOM01_CH07_SELB_CH02, TRI1CH0B_TOM01_CH13_SELB_CH03, TRI1CH0B_TOM01_CH14_SELB_CH04, TRI1CH0B_ATOM1_CH04_SELB_CH05, TRI1CH0B_ATOM1_CH05_SELB_CH06, TRI1CH0B_ATOM1_CH06_SELB_CH07, TRI1CH0B_ATOM1_CH07_SELB_CH08, TRI1CH0B_TOM00_CH14_SELB_CH09, TRI1CH0B_TOM00_CH15_SELB_CH10, TRI1CH0B_ATOM4_CH06_SELB_CH11, TRI1CH0B_ATOM4_CH07_SELB_CH12, TRI1CH0B_ATOM3_CH06_SELB_CH13, TRI1CH0B_ATOM3_CH07_SELB_CH14, TRI1CH0B_ATOM5_CH03_SELB_CH15, TRI2CH0B_TOM00_CH03_SELB_CH01, TRI2CH0B_TOM00_CH04_SELB_CH02, TRI2CH0B_TOM0_CH05N_SELB_CH03, TRI2CH0B_TOM01_CH03_SELB_CH04, TRI2CH0B_TOM01_CH04_SELB_CH05, TRI2CH0B_TOM1_CH05N_SELB_CH06, TRI2CH0B_TOM02_CH03_SELB_CH07, TRI2CH0B_TOM02_CH04_SELB_CH08, TRI2CH0B_TOM2_CH05N_SELB_CH09, TRI2CH0B_TOM02_CH07_SELB_CH10, TRI2CH0B_TOM03_CH03_SELB_CH11, TRI2CH0B_TOM03_CH04_SELB_CH12, TRI2CH0B_TOM3_CH05N_SELB_CH13, TRI2CH0B_TOM03_CH07_SELB_CH14, TRI2CH0B_TOM04_CH03_SELB_CH15, TRI3CH0B_ATOM0_CH03_SELB_CH01, TRI3CH0B_ATOM0_CH5N_SELB_CH02, TRI3CH0B_ATOM1_CH03_SELB_CH03, TRI3CH0B_ATOM1_CH5N_SELB_CH04, TRI3CH0B_ATOM2_CH03_SELB_CH05, TRI3CH0B_ATOM2_CH04_SELB_CH06, TRI3CH0B_ATOM2_CH5N_SELB_CH07, TRI3CH0B_ATOM2_CH07_SELB_CH08, TRI3CH0B_ATOM3_CH03_SELB_CH09, TRI3CH0B_ATOM3_CH5N_SELB_CH10, TRI3CH0B_ATOM4_CH03_SELB_CH11, TRI3CH0B_ATOM4_CH5N_SELB_CH12, TRI3CH0B_ATOM5_CH04_SELB_CH13, TRI3CH0B_ATOM5_CH5N_SELB_CH14, TRI3CH0B_ATOM5_CH07_SELB_CH15, TRI4CH0B_TOM02_CH14_SELB_CH01, TRI4CH0B_TOM03_CH14_SELB_CH02, TRI4CH0B_TOM04_CH14_SELB_CH03, TRI4CH0B_ATOM6_CH04_SELB_CH04, TRI4CH0B_ATOM6_CH5N_SELB_CH05, TRI4CH0B_ATOM6_CH07_SELB_CH06, TRI4CH0B_ATOM7_CH04_SELB_CH07, TRI4CH0B_ATOM7_CH05_SELB_CH08, TRI4CH0B_ATOM7_CH07_SELB_CH09, TRI4CH0B_TOM04_CH04_SELB_CH13, TRI4CH0B_TOM4_CH05N_SELB_CH14, TRI4CH0B_TOM04_CH07_SELB_CH15}, origin=ChipowerTech, post-build-variant-value=true, set at post-build, default-value=TRIXCHXX_NO_TRIGGER_SELX_CH00  # This Specifies the TOM/ATOM channel that will be used as GTM Trigger. This configuration is to set GTM_ADCTRGxOUTy
        container Dsadc [10..10]: requires-index=true  # This Specifies the TOM/ATOM channels that can be used as DSADC Triggers
          integer ChannelId: 0..9, scope=ECU, origin=ChipowerTech, set at pre-compile, default-value=0  # Id of the DSADC channel.
          enumeration GtmTriggerSelect: {TRIXCHXX_NO_TRIGGER_SELX_CH0F, TRI0CH00_TOM00_CH06_SEL0_CH00, TRI0CH00_TOM00_CH07_SEL0_CH01, TRI0CH00_TOM00_CH13_SEL0_CH02, TRI0CH00_TOM00_CH14_SEL0_CH03, TRI0CH00_ATOM0_CH04_SEL0_CH04, TRI0CH00_ATOM0_CH05_SEL0_CH05, TRI0CH00_ATOM0_CH06_SEL0_CH06, TRI0CH00_ATOM0_CH07_SEL0_CH07, TRI0CH00_ATOM1_CH04_SEL0_CH08, TRI0CH00_ATOM1_CH05_SEL0_CH09, TRI0CH00_ATOM1_CH06_SEL0_CH10, TRI0CH00_ATOM1_CH07_SEL0_CH11, TRI0CH00_ATOM4_CH06_SEL0_CH12, TRI0CH00_ATOM4_CH07_SEL0_CH13, TRI0CH00_ATOM6_CH06_SEL0_CH14, TRI0CH01_TOM00_CH06_SEL0_CH00, TRI0CH01_TOM00_CH07_SEL0_CH01, TRI0CH01_TOM00_CH13_SEL0_CH02, TRI0CH01_TOM00_CH14_SEL0_CH03, TRI0CH01_ATOM0_CH04_SEL0_CH04, TRI0CH01_ATOM0_CH05_SEL0_CH05, TRI0CH01_ATOM0_CH06_SEL0_CH06, TRI0CH01_ATOM0_CH07_SEL0_CH07, TRI0CH01_ATOM1_CH04_SEL0_CH08, TRI0CH01_ATOM1_CH05_SEL0_CH09, TRI0CH01_ATOM1_CH06_SEL0_CH10, TRI0CH01_ATOM1_CH07_SEL0_CH11, TRI0CH01_ATOM4_CH06_SEL0_CH12, TRI0CH01_ATOM4_CH07_SEL0_CH13, TRI0CH01_ATOM6_CH06_SEL0_CH14, TRI0CH02_TOM00_CH06_SEL0_CH00, TRI0CH02_TOM00_CH07_SEL0_CH01, TRI0CH02_TOM00_CH13_SEL0_CH02, TRI0CH02_TOM00_CH14_SEL0_CH03, TRI0CH02_ATOM0_CH04_SEL0_CH04, TRI0CH02_ATOM0_CH05_SEL0_CH05, TRI0CH02_ATOM0_CH06_SEL0_CH06, TRI0CH02_ATOM0_CH07_SEL0_CH07, TRI0CH02_ATOM1_CH04_SEL0_CH08, TRI0CH02_ATOM1_CH05_SEL0_CH09, TRI0CH02_ATOM1_CH06_SEL0_CH10, TRI0CH02_ATOM1_CH07_SEL0_CH11, TRI0CH02_ATOM4_CH06_SEL0_CH12, TRI0CH02_ATOM4_CH07_SEL0_CH13, TRI0CH02_ATOM6_CH06_SEL0_CH14, TRI0CH03_TOM00_CH06_SEL0_CH00, TRI0CH03_TOM00_CH07_SEL0_CH01, TRI0CH03_TOM00_CH13_SEL0_CH02, TRI0CH03_TOM00_CH14_SEL0_CH03, TRI0CH03_ATOM0_CH04_SEL0_CH04, TRI0CH03_ATOM0_CH05_SEL0_CH05, TRI0CH03_ATOM0_CH06_SEL0_CH06, TRI0CH03_ATOM0_CH07_SEL0_CH07, TRI0CH03_ATOM1_CH04_SEL0_CH08, TRI0CH03_ATOM1_CH05_SEL0_CH09, TRI0CH03_ATOM1_CH06_SEL0_CH10, TRI0CH03_ATOM1_CH07_SEL0_CH11, TRI0CH03_ATOM4_CH06_SEL0_CH12, TRI0CH03_ATOM4_CH07_SEL0_CH13, TRI0CH03_ATOM6_CH06_SEL0_CH14, TRI0CH04_TOM00_CH06_SEL0_CH00, TRI0CH04_TOM00_CH07_SEL0_CH01, TRI0CH04_TOM00_CH13_SEL0_CH02, TRI0CH04_TOM00_CH14_SEL0_CH03, TRI0CH04_ATOM0_CH04_SEL0_CH04, TRI0CH04_ATOM0_CH05_SEL0_CH05, TRI0CH04_ATOM0_CH06_SEL0_CH06, TRI0CH04_ATOM0_CH07_SEL0_CH07, TRI0CH04_ATOM1_CH04_SEL0_CH08, TRI0CH04_ATOM1_CH05_SEL0_CH09, TRI0CH04_ATOM1_CH06_SEL0_CH10, TRI0CH04_ATOM1_CH07_SEL0_CH11, TRI0CH04_ATOM4_CH06_SEL0_CH12, TRI0CH04_ATOM4_CH07_SEL0_CH13, TRI0CH04_ATOM6_CH06_SEL0_CH14, TRI0CH05_TOM00_CH06_SEL0_CH00, TRI0CH05_TOM00_CH07_SEL0_CH01, TRI0CH05_TOM00_CH13_SEL0_CH02, TRI0CH05_TOM00_CH14_SEL0_CH03, TRI0CH05_ATOM0_CH04_SEL0_CH04, TRI0CH05_ATOM0_CH05_SEL0_CH05, TRI0CH05_ATOM0_CH06_SEL0_CH06, TRI0CH05_ATOM0_CH07_SEL0_CH07, TRI0CH05_ATOM1_CH04_SEL0_CH08, TRI0CH05_ATOM1_CH05_SEL0_CH09, TRI0CH05_ATOM1_CH06_SEL0_CH10, TRI0CH05_ATOM1_CH07_SEL0_CH11, TRI0CH05_ATOM4_CH06_SEL0_CH12, TRI0CH05_ATOM4_CH07_SEL0_CH13, TRI0CH05_ATOM6_CH06_SEL0_CH14, TRI0CH06_TOM00_CH06_SEL0_CH00, TRI0CH06_TOM00_CH07_SEL0_CH01, TRI0CH06_TOM00_CH13_SEL0_CH02, TRI0CH06_TOM00_CH14_SEL0_CH03, TRI0CH06_ATOM0_CH04_SEL0_CH04, TRI0CH06_ATOM0_CH05_SEL0_CH05, TRI0CH06_ATOM0_CH06_SEL0_CH06, TRI0CH06_ATOM0_CH07_SEL0_CH07, TRI0CH06_ATOM1_CH04_SEL0_CH08, TRI0CH06_ATOM1_CH05_SEL0_CH09, TRI0CH06_ATOM1_CH06_SEL0_CH10, TRI0CH06_ATOM1_CH07_SEL0_CH11, TRI0CH06_ATOM4_CH06_SEL0_CH12, TRI0CH06_ATOM4_CH07_SEL0_CH13, TRI0CH06_ATOM6_CH06_SEL0_CH14, TRI0CH07_TOM00_CH06_SEL0_CH00, TRI0CH07_TOM00_CH07_SEL0_CH01, TRI0CH07_TOM00_CH13_SEL0_CH02, TRI0CH07_TOM00_CH14_SEL0_CH03, TRI0CH07_ATOM0_CH04_SEL0_CH04, TRI0CH07_ATOM0_CH05_SEL0_CH05, TRI0CH07_ATOM0_CH06_SEL0_CH06, TRI0CH07_ATOM0_CH07_SEL0_CH07, TRI0CH07_ATOM1_CH04_SEL0_CH08, TRI0CH07_ATOM1_CH05_SEL0_CH09, TRI0CH07_ATOM1_CH06_SEL0_CH10, TRI0CH07_ATOM1_CH07_SEL0_CH11, TRI0CH07_ATOM4_CH06_SEL0_CH12, TRI0CH07_ATOM4_CH07_SEL0_CH13, TRI0CH07_ATOM6_CH06_SEL0_CH14, TRI0CH08_TOM00_CH06_SEL0_CH00, TRI0CH08_TOM00_CH07_SEL0_CH01, TRI0CH08_TOM00_CH13_SEL0_CH02, TRI0CH08_TOM00_CH14_SEL0_CH03, TRI0CH08_ATOM0_CH04_SEL0_CH04, TRI0CH08_ATOM0_CH05_SEL0_CH05, TRI0CH08_ATOM0_CH06_SEL0_CH06, TRI0CH08_ATOM0_CH07_SEL0_CH07, TRI0CH08_ATOM1_CH04_SEL0_CH08, TRI0CH08_ATOM1_CH05_SEL0_CH09, TRI0CH08_ATOM1_CH06_SEL0_CH10, TRI0CH08_ATOM1_CH07_SEL0_CH11, TRI0CH08_ATOM4_CH06_SEL0_CH12, TRI0CH08_ATOM4_CH07_SEL0_CH13, TRI0CH08_ATOM6_CH06_SEL0_CH14, TRI0CH09_TOM00_CH06_SEL0_CH00, TRI0CH09_TOM00_CH07_SEL0_CH01, TRI0CH09_TOM00_CH13_SEL0_CH02, TRI0CH09_TOM00_CH14_SEL0_CH03, TRI0CH09_ATOM0_CH04_SEL0_CH04, TRI0CH09_ATOM0_CH05_SEL0_CH05, TRI0CH09_ATOM0_CH06_SEL0_CH06, TRI0CH09_ATOM0_CH07_SEL0_CH07, TRI0CH09_ATOM1_CH04_SEL0_CH08, TRI0CH09_ATOM1_CH05_SEL0_CH09, TRI0CH09_ATOM1_CH06_SEL0_CH10, TRI0CH09_ATOM1_CH07_SEL0_CH11, TRI0CH09_ATOM4_CH06_SEL0_CH12, TRI0CH09_ATOM4_CH07_SEL0_CH13, TRI0CH09_ATOM6_CH06_SEL0_CH14, TRI1CH00_TOM02_CH06_SEL0_CH00, TRI1CH00_TOM02_CH07_SEL0_CH01, TRI1CH00_TOM02_CH13_SEL0_CH02, TRI1CH00_TOM02_CH14_SEL0_CH03, TRI1CH00_ATOM2_CH04_SEL0_CH04, TRI1CH00_ATOM2_CH05_SEL0_CH05, TRI1CH00_ATOM2_CH06_SEL0_CH06, TRI1CH00_ATOM2_CH07_SEL0_CH07, TRI1CH00_ATOM3_CH04_SEL0_CH08, TRI1CH00_ATOM3_CH05_SEL0_CH09, TRI1CH00_ATOM3_CH06_SEL0_CH10, TRI1CH00_ATOM3_CH07_SEL0_CH11, TRI1CH00_ATOM5_CH06_SEL0_CH12, TRI1CH00_ATOM5_CH07_SEL0_CH13, TRI1CH00_ATOM6_CH07_SEL0_CH14, TRI1CH01_TOM02_CH06_SEL0_CH00, TRI1CH01_TOM02_CH07_SEL0_CH01, TRI1CH01_TOM02_CH13_SEL0_CH02, TRI1CH01_TOM02_CH14_SEL0_CH03, TRI1CH01_ATOM2_CH04_SEL0_CH04, TRI1CH01_ATOM2_CH05_SEL0_CH05, TRI1CH01_ATOM2_CH06_SEL0_CH06, TRI1CH01_ATOM2_CH07_SEL0_CH07, TRI1CH01_ATOM3_CH04_SEL0_CH08, TRI1CH01_ATOM3_CH05_SEL0_CH09, TRI1CH01_ATOM3_CH06_SEL0_CH10, TRI1CH01_ATOM3_CH07_SEL0_CH11, TRI1CH01_ATOM5_CH06_SEL0_CH12, TRI1CH01_ATOM5_CH07_SEL0_CH13, TRI1CH01_ATOM6_CH07_SEL0_CH14, TRI1CH02_TOM02_CH06_SEL0_CH00, TRI1CH02_TOM02_CH07_SEL0_CH01, TRI1CH02_TOM02_CH13_SEL0_CH02, TRI1CH02_TOM02_CH14_SEL0_CH03, TRI1CH02_ATOM2_CH04_SEL0_CH04, TRI1CH02_ATOM2_CH05_SEL0_CH05, TRI1CH02_ATOM2_CH06_SEL0_CH06, TRI1CH02_ATOM2_CH07_SEL0_CH07, TRI1CH02_ATOM3_CH04_SEL0_CH08, TRI1CH02_ATOM3_CH05_SEL0_CH09, TRI1CH02_ATOM3_CH06_SEL0_CH10, TRI1CH02_ATOM3_CH07_SEL0_CH11, TRI1CH02_ATOM5_CH06_SEL0_CH12, TRI1CH02_ATOM5_CH07_SEL0_CH13, TRI1CH02_ATOM6_CH07_SEL0_CH14, TRI1CH03_TOM02_CH06_SEL0_CH00, TRI1CH03_TOM02_CH07_SEL0_CH01, TRI1CH03_TOM02_CH13_SEL0_CH02, TRI1CH03_TOM02_CH14_SEL0_CH03, TRI1CH03_ATOM2_CH04_SEL0_CH04, TRI1CH03_ATOM2_CH05_SEL0_CH05, TRI1CH03_ATOM2_CH06_SEL0_CH06, TRI1CH03_ATOM2_CH07_SEL0_CH07, TRI1CH03_ATOM3_CH04_SEL0_CH08, TRI1CH03_ATOM3_CH05_SEL0_CH09, TRI1CH03_ATOM3_CH06_SEL0_CH10, TRI1CH03_ATOM3_CH07_SEL0_CH11, TRI1CH03_ATOM5_CH06_SEL0_CH12, TRI1CH03_ATOM5_CH07_SEL0_CH13, TRI1CH03_ATOM6_CH07_SEL0_CH14, TRI1CH04_TOM02_CH06_SEL0_CH00, TRI1CH04_TOM02_CH07_SEL0_CH01, TRI1CH04_TOM02_CH13_SEL0_CH02, TRI1CH04_TOM02_CH14_SEL0_CH03, TRI1CH04_ATOM2_CH04_SEL0_CH04, TRI1CH04_ATOM2_CH05_SEL0_CH05, TRI1CH04_ATOM2_CH06_SEL0_CH06, TRI1CH04_ATOM2_CH07_SEL0_CH07, TRI1CH04_ATOM3_CH04_SEL0_CH08, TRI1CH04_ATOM3_CH05_SEL0_CH09, TRI1CH04_ATOM3_CH06_SEL0_CH10, TRI1CH04_ATOM3_CH07_SEL0_CH11, TRI1CH04_ATOM5_CH06_SEL0_CH12, TRI1CH04_ATOM5_CH07_SEL0_CH13, TRI1CH04_ATOM6_CH07_SEL0_CH14, TRI1CH05_TOM02_CH06_SEL0_CH00, TRI1CH05_TOM02_CH07_SEL0_CH01, TRI1CH05_TOM02_CH13_SEL0_CH02, TRI1CH05_TOM02_CH14_SEL0_CH03, TRI1CH05_ATOM2_CH04_SEL0_CH04, TRI1CH05_ATOM2_CH05_SEL0_CH05, TRI1CH05_ATOM2_CH06_SEL0_CH06, TRI1CH05_ATOM2_CH07_SEL0_CH07, TRI1CH05_ATOM3_CH04_SEL0_CH08, TRI1CH05_ATOM3_CH05_SEL0_CH09, TRI1CH05_ATOM3_CH06_SEL0_CH10, TRI1CH05_ATOM3_CH07_SEL0_CH11, TRI1CH05_ATOM5_CH06_SEL0_CH12, TRI1CH05_ATOM5_CH07_SEL0_CH13, TRI1CH05_ATOM6_CH07_SEL0_CH14, TRI1CH06_TOM02_CH06_SEL0_CH00, TRI1CH06_TOM02_CH07_SEL0_CH01, TRI1CH06_TOM02_CH13_SEL0_CH02, TRI1CH06_TOM02_CH14_SEL0_CH03, TRI1CH06_ATOM2_CH04_SEL0_CH04, TRI1CH06_ATOM2_CH05_SEL0_CH05, TRI1CH06_ATOM2_CH06_SEL0_CH06, TRI1CH06_ATOM2_CH07_SEL0_CH07, TRI1CH06_ATOM3_CH04_SEL0_CH08, TRI1CH06_ATOM3_CH05_SEL0_CH09, TRI1CH06_ATOM3_CH06_SEL0_CH10, TRI1CH06_ATOM3_CH07_SEL0_CH11, TRI1CH06_ATOM5_CH06_SEL0_CH12, TRI1CH06_ATOM5_CH07_SEL0_CH13, TRI1CH06_ATOM6_CH07_SEL0_CH14, TRI1CH07_TOM02_CH06_SEL0_CH00, TRI1CH07_TOM02_CH07_SEL0_CH01, TRI1CH07_TOM02_CH13_SEL0_CH02, TRI1CH07_TOM02_CH14_SEL0_CH03, TRI1CH07_ATOM2_CH04_SEL0_CH04, TRI1CH07_ATOM2_CH05_SEL0_CH05, TRI1CH07_ATOM2_CH06_SEL0_CH06, TRI1CH07_ATOM2_CH07_SEL0_CH07, TRI1CH07_ATOM3_CH04_SEL0_CH08, TRI1CH07_ATOM3_CH05_SEL0_CH09, TRI1CH07_ATOM3_CH06_SEL0_CH10, TRI1CH07_ATOM3_CH07_SEL0_CH11, TRI1CH07_ATOM5_CH06_SEL0_CH12, TRI1CH07_ATOM5_CH07_SEL0_CH13, TRI1CH07_ATOM6_CH07_SEL0_CH14, TRI1CH08_TOM02_CH06_SEL0_CH00, TRI1CH08_TOM02_CH07_SEL0_CH01, TRI1CH08_TOM02_CH13_SEL0_CH02, TRI1CH08_TOM02_CH14_SEL0_CH03, TRI1CH08_ATOM2_CH04_SEL0_CH04, TRI1CH08_ATOM2_CH05_SEL0_CH05, TRI1CH08_ATOM2_CH06_SEL0_CH06, TRI1CH08_ATOM2_CH07_SEL0_CH07, TRI1CH08_ATOM3_CH04_SEL0_CH08, TRI1CH08_ATOM3_CH05_SEL0_CH09, TRI1CH08_ATOM3_CH06_SEL0_CH10, TRI1CH08_ATOM3_CH07_SEL0_CH11, TRI1CH08_ATOM5_CH06_SEL0_CH12, TRI1CH08_ATOM5_CH07_SEL0_CH13, TRI1CH08_ATOM6_CH07_SEL0_CH14, TRI1CH09_TOM02_CH06_SEL0_CH00, TRI1CH09_TOM02_CH07_SEL0_CH01, TRI1CH09_TOM02_CH13_SEL0_CH02, TRI1CH09_TOM02_CH14_SEL0_CH03, TRI1CH09_ATOM2_CH04_SEL0_CH04, TRI1CH09_ATOM2_CH05_SEL0_CH05, TRI1CH09_ATOM2_CH06_SEL0_CH06, TRI1CH09_ATOM2_CH07_SEL0_CH07, TRI1CH09_ATOM3_CH04_SEL0_CH08, TRI1CH09_ATOM3_CH05_SEL0_CH09, TRI1CH09_ATOM3_CH06_SEL0_CH10, TRI1CH09_ATOM3_CH07_SEL0_CH11, TRI1CH09_ATOM5_CH06_SEL0_CH12, TRI1CH09_ATOM5_CH07_SEL0_CH13, TRI1CH09_ATOM6_CH07_SEL0_CH14, TRI2CH00_TOM01_CH07_SEL0_CH00, TRI2CH00_TOM01_CH14_SEL0_CH01, TRI2CH00_TOM03_CH07_SEL0_CH02, TRI2CH00_TOM03_CH14_SEL0_CH03, TRI2CH00_TOM04_CH07_SEL0_CH04, TRI2CH00_TOM04_CH14_SEL0_CH05, TRI2CH00_ATOM7_CH06_SEL0_CH08, TRI2CH00_ATOM7_CH07_SEL0_CH09, TRI2CH01_TOM01_CH07_SEL0_CH00, TRI2CH01_TOM01_CH14_SEL0_CH01, TRI2CH01_TOM03_CH07_SEL0_CH02, TRI2CH01_TOM03_CH14_SEL0_CH03, TRI2CH01_TOM04_CH07_SEL0_CH04, TRI2CH01_TOM04_CH14_SEL0_CH05, TRI2CH01_ATOM7_CH06_SEL0_CH08, TRI2CH01_ATOM7_CH07_SEL0_CH09, TRI2CH02_TOM01_CH07_SEL0_CH00, TRI2CH02_TOM01_CH14_SEL0_CH01, TRI2CH02_TOM03_CH07_SEL0_CH02, TRI2CH02_TOM03_CH14_SEL0_CH03, TRI2CH02_TOM04_CH07_SEL0_CH04, TRI2CH02_TOM04_CH14_SEL0_CH05, TRI2CH02_ATOM7_CH06_SEL0_CH08, TRI2CH02_ATOM7_CH07_SEL0_CH09, TRI2CH03_TOM01_CH07_SEL0_CH00, TRI2CH03_TOM01_CH14_SEL0_CH01, TRI2CH03_TOM03_CH07_SEL0_CH02, TRI2CH03_TOM03_CH14_SEL0_CH03, TRI2CH03_TOM04_CH07_SEL0_CH04, TRI2CH03_TOM04_CH14_SEL0_CH05, TRI2CH03_ATOM7_CH06_SEL0_CH08, TRI2CH03_ATOM7_CH07_SEL0_CH09, TRI2CH04_TOM01_CH07_SEL0_CH00, TRI2CH04_TOM01_CH14_SEL0_CH01, TRI2CH04_TOM03_CH07_SEL0_CH02, TRI2CH04_TOM03_CH14_SEL0_CH03, TRI2CH04_TOM04_CH07_SEL0_CH04, TRI2CH04_TOM04_CH14_SEL0_CH05, TRI2CH04_ATOM7_CH06_SEL0_CH08, TRI2CH04_ATOM7_CH07_SEL0_CH09, TRI2CH05_TOM01_CH07_SEL0_CH00, TRI2CH05_TOM01_CH14_SEL0_CH01, TRI2CH05_TOM03_CH07_SEL0_CH02, TRI2CH05_TOM03_CH14_SEL0_CH03, TRI2CH05_TOM04_CH07_SEL0_CH04, TRI2CH05_TOM04_CH14_SEL0_CH05, TRI2CH05_ATOM7_CH06_SEL0_CH08, TRI2CH05_ATOM7_CH07_SEL0_CH09, TRI2CH06_TOM01_CH07_SEL0_CH00, TRI2CH06_TOM01_CH14_SEL0_CH01, TRI2CH06_TOM03_CH07_SEL0_CH02, TRI2CH06_TOM03_CH14_SEL0_CH03, TRI2CH06_TOM04_CH07_SEL0_CH04, TRI2CH06_TOM04_CH14_SEL0_CH05, TRI2CH06_ATOM7_CH06_SEL0_CH08, TRI2CH06_ATOM7_CH07_SEL0_CH09, TRI2CH07_TOM01_CH07_SEL0_CH00, TRI2CH07_TOM01_CH14_SEL0_CH01, TRI2CH07_TOM03_CH07_SEL0_CH02, TRI2CH07_TOM03_CH14_SEL0_CH03, TRI2CH07_TOM04_CH07_SEL0_CH04, TRI2CH07_TOM04_CH14_SEL0_CH05, TRI2CH07_ATOM7_CH06_SEL0_CH08, TRI2CH07_ATOM7_CH07_SEL0_CH09, TRI2CH08_TOM01_CH07_SEL0_CH00, TRI2CH08_TOM01_CH14_SEL0_CH01, TRI2CH08_TOM03_CH07_SEL0_CH02, TRI2CH08_TOM03_CH14_SEL0_CH03, TRI2CH08_TOM04_CH07_SEL0_CH04, TRI2CH08_TOM04_CH14_SEL0_CH05, TRI2CH08_ATOM7_CH06_SEL0_CH08, TRI2CH08_ATOM7_CH07_SEL0_CH09, TRI2CH09_TOM01_CH07_SEL0_CH00, TRI2CH09_TOM01_CH14_SEL0_CH01, TRI2CH09_TOM03_CH07_SEL0_CH02, TRI2CH09_TOM03_CH14_SEL0_CH03, TRI2CH09_TOM04_CH07_SEL0_CH04, TRI2CH09_TOM04_CH14_SEL0_CH05, TRI2CH09_ATOM7_CH06_SEL0_CH08, TRI2CH09_ATOM7_CH07_SEL0_CH09, TRI3CH00_TOM01_CH06_SEL0_CH00, TRI3CH01_TOM01_CH06_SEL0_CH00, TRI3CH02_TOM01_CH06_SEL0_CH00, TRI3CH03_TOM01_CH06_SEL0_CH00, TRI3CH04_TOM01_CH06_SEL0_CH00, TRI3CH05_TOM01_CH06_SEL0_CH00, TRI3CH06_TOM01_CH06_SEL0_CH00, TRI3CH07_TOM01_CH06_SEL0_CH00, TRI3CH08_TOM01_CH06_SEL0_CH00, TRI3CH09_TOM01_CH06_SEL0_CH00}, origin=ChipowerTech, post-build-variant-value=true, set at post-build, default-value=TRIXCHXX_NO_TRIGGER_SELX_CH0F  # This Specifies the TOM/ATOM channel that will be used as GTM Trigger for dsadc. This configuration is to set DSADCOUTMUX*
        container Msc [3..3]: requires-index=true  # This container contains the General Configuration for Msc
          integer HwId: 0..2, scope=ECU, origin=ChipowerTech, set at pre-compile, default-value=0  # Id of the MSC.
          container MscDataBit [16..16]: requires-index=true  # This Specifies the Set channels that can be used as input of MSC
            integer BitId: 0..15, scope=ECU, origin=ChipowerTech, set at pre-compile, default-value=0  # Id of the MSC level2 Set channel.
            enumeration MscDataBitLowConfiguration: {SETX_NO_USED, SET0_TOM00_CH00_00, SET0_TOM00_CH01_01, SET0_TOM00_CH02_02, SET0_TOM00_CH03_03, SET0_TOM00_CH04_04, SET0_TOM00_CH05_05, SET0_TOM00_CH06_06, SET0_TOM00_CH07_07, SET0_TOM00_CH08_08, SET0_TOM00_CH09_09, SET0_TOM00_CH10_10, SET0_TOM00_CH11_11, SET0_TOM00_CH12_12, SET0_TOM00_CH13_13, SET0_TOM00_CH14_14, SET0_TOM00_CH15_15, SET0_ATOM0_CH00_16, SET0_ATOM0_CH01_17, SET0_ATOM0_CH02_18, SET0_ATOM0_CH03_19, SET0_ATOM0_CH04_20, SET0_ATOM0_CH05_21, SET0_ATOM0_CH06_22, SET0_ATOM0_CH07_23, SET0_ATOM2_CH00_24, SET0_ATOM2_CH01_25, SET0_ATOM2_CH02_26, SET0_ATOM2_CH03_27, SET0_ATOM2_CH04_28, SET0_ATOM2_CH05_29, SET0_ATOM2_CH06_30, SET0_ATOM2_CH07_31, SET1_TOM01_CH00_00, SET1_TOM01_CH01_01, SET1_TOM01_CH02_02, SET1_TOM01_CH03_03, SET1_TOM01_CH04_04, SET1_TOM01_CH05_05, SET1_TOM01_CH06_06, SET1_TOM01_CH07_07, SET1_TOM01_CH08_08, SET1_TOM01_CH09_09, SET1_TOM01_CH10_10, SET1_TOM01_CH11_11, SET1_TOM01_CH12_12, SET1_TOM01_CH13_13, SET1_TOM01_CH14_14, SET1_TOM01_CH15_15, SET1_ATOM1_CH00_16, SET1_ATOM1_CH01_17, SET1_ATOM1_CH02_18, SET1_ATOM1_CH03_19, SET1_ATOM1_CH04_20, SET1_ATOM1_CH05_21, SET1_ATOM1_CH06_22, SET1_ATOM1_CH07_23, SET1_ATOM3_CH00_24, SET1_ATOM3_CH01_25, SET1_ATOM3_CH02_26, SET1_ATOM3_CH03_27, SET1_ATOM3_CH04_28, SET1_ATOM3_CH05_29, SET1_ATOM3_CH06_30, SET1_ATOM3_CH07_31, SET2_ATOM3_CH00_24, SET2_ATOM3_CH01_25, SET2_ATOM3_CH02_26, SET2_ATOM3_CH03_27, SET2_ATOM3_CH04_28, SET2_ATOM3_CH05_29, SET2_ATOM3_CH06_30, SET2_ATOM3_CH07_31, SET3_ATOM0_CH00_00, SET3_ATOM0_CH01_01, SET3_ATOM0_CH02_02, SET3_ATOM0_CH03_03, SET3_ATOM0_CH04_04, SET3_ATOM0_CH05_05, SET3_ATOM0_CH06_06, SET3_ATOM0_CH07_07, SET3_ATOM1_CH00_08, SET3_ATOM1_CH01_09, SET3_ATOM1_CH02_10, SET3_ATOM1_CH03_11, SET3_ATOM1_CH04_12, SET3_ATOM1_CH05_13, SET3_ATOM1_CH06_14, SET3_ATOM1_CH07_15, SET3_ATOM2_CH00_16, SET3_ATOM2_CH01_17, SET3_ATOM2_CH02_18, SET3_ATOM2_CH03_19, SET3_ATOM2_CH04_20, SET3_ATOM2_CH05_21, SET3_ATOM2_CH06_22, SET3_ATOM2_CH07_23, SET4_TOM03_CH00_00, SET4_TOM03_CH01_01, SET4_TOM03_CH02_02, SET4_TOM03_CH03_03, SET4_TOM03_CH04_04, SET4_TOM03_CH05_05, SET4_TOM03_CH06_06, SET4_TOM03_CH07_07, SET4_TOM03_CH08_08, SET4_TOM03_CH09_09, SET4_TOM03_CH10_10, SET4_TOM03_CH11_11, SET4_TOM03_CH12_12, SET4_TOM03_CH13_13, SET4_TOM03_CH14_14, SET4_TOM03_CH15_15, SET4_ATOM5_CH00_16, SET4_ATOM5_CH01_17, SET4_ATOM5_CH02_18, SET4_ATOM5_CH03_19, SET4_ATOM5_CH04_20, SET4_ATOM5_CH05_21, SET4_ATOM5_CH06_22, SET4_ATOM5_CH07_23, SET4_ATOM6_CH00_24, SET4_ATOM6_CH01_25, SET4_ATOM6_CH02_26, SET4_ATOM6_CH03_27, SET4_ATOM6_CH04_28, SET4_ATOM6_CH05_29, SET4_ATOM6_CH06_30, SET4_ATOM6_CH07_31, SET5_ATOM4_CH00_00, SET5_ATOM4_CH01_01, SET5_ATOM4_CH02_02, SET5_ATOM4_CH03_03, SET5_ATOM4_CH04_05, SET5_ATOM4_CH05_05, SET5_ATOM4_CH06_06, SET5_ATOM4_CH07_07, SET5_ATOM6_CH00_08, SET5_ATOM6_CH01_09, SET5_ATOM6_CH02_10, SET5_ATOM6_CH03_11, SET5_ATOM6_CH04_12, SET5_ATOM6_CH05_13, SET5_ATOM6_CH06_14, SET5_ATOM6_CH07_15, SET5_ATOM7_CH00_16, SET5_ATOM7_CH01_17, SET5_ATOM7_CH02_18, SET5_ATOM7_CH03_19, SET5_ATOM7_CH04_20, SET5_ATOM7_CH05_21, SET5_ATOM7_CH06_22, SET5_ATOM7_CH07_23, SET6_TOM04_CH00_00, SET6_TOM04_CH01_01, SET6_TOM04_CH02_02, SET6_TOM04_CH03_03, SET6_TOM04_CH04_04, SET6_TOM04_CH05_05, SET6_TOM04_CH06_06, SET6_TOM04_CH07_07, SET6_TOM04_CH08_08, SET6_TOM04_CH09_09, SET6_TOM04_CH10_10, SET6_TOM04_CH11_11, SET6_TOM04_CH12_12, SET6_TOM04_CH13_13, SET6_TOM04_CH14_14, SET6_TOM04_CH15_15, SET6_ATOM7_CH00_16, SET6_ATOM7_CH01_17, SET6_ATOM7_CH02_18, SET6_ATOM7_CH03_19, SET6_ATOM7_CH04_20, SET6_ATOM7_CH05_21, SET6_ATOM7_CH06_22, SET6_ATOM7_CH07_23, SET6_ATOM5_CH00_24, SET6_ATOM5_CH01_25, SET6_ATOM5_CH02_26, SET6_ATOM5_CH03_27, SET6_ATOM5_CH04_28, SET6_ATOM5_CH05_29, SET6_ATOM5_CH06_30, SET6_ATOM5_CH07_31}, origin=ChipowerTech, post-build-variant-value=true, set at post-build, default-value=SETX_NO_USED  # This Specifies the Setx channels that can be used as input of MSC
            enumeration MscDataBitHighConfiguration: {SETX_NO_USED, SET0_TOM00_CH00_00, SET0_TOM00_CH01_01, SET0_TOM00_CH02_02, SET0_TOM00_CH03_03, SET0_TOM00_CH04_04, SET0_TOM00_CH05_05, SET0_TOM00_CH06_06, SET0_TOM00_CH07_07, SET0_TOM00_CH08_08, SET0_TOM00_CH09_09, SET0_TOM00_CH10_10, SET0_TOM00_CH11_11, SET0_TOM00_CH12_12, SET0_TOM00_CH13_13, SET0_TOM00_CH14_14, SET0_TOM00_CH15_15, SET0_ATOM0_CH00_16, SET0_ATOM0_CH01_17, SET0_ATOM0_CH02_18, SET0_ATOM0_CH03_19, SET0_ATOM0_CH04_20, SET0_ATOM0_CH05_21, SET0_ATOM0_CH06_22, SET0_ATOM0_CH07_23, SET0_ATOM2_CH00_24, SET0_ATOM2_CH01_25, SET0_ATOM2_CH02_26, SET0_ATOM2_CH03_27, SET0_ATOM2_CH04_28, SET0_ATOM2_CH05_29, SET0_ATOM2_CH06_30, SET0_ATOM2_CH07_31, SET1_TOM01_CH00_00, SET1_TOM01_CH01_01, SET1_TOM01_CH02_02, SET1_TOM01_CH03_03, SET1_TOM01_CH04_04, SET1_TOM01_CH05_05, SET1_TOM01_CH06_06, SET1_TOM01_CH07_07, SET1_TOM01_CH08_08, SET1_TOM01_CH09_09, SET1_TOM01_CH10_10, SET1_TOM01_CH11_11, SET1_TOM01_CH12_12, SET1_TOM01_CH13_13, SET1_TOM01_CH14_14, SET1_TOM01_CH15_15, SET1_ATOM1_CH00_16, SET1_ATOM1_CH01_17, SET1_ATOM1_CH02_18, SET1_ATOM1_CH03_19, SET1_ATOM1_CH04_20, SET1_ATOM1_CH05_21, SET1_ATOM1_CH06_22, SET1_ATOM1_CH07_23, SET1_ATOM3_CH00_24, SET1_ATOM3_CH01_25, SET1_ATOM3_CH02_26, SET1_ATOM3_CH03_27, SET1_ATOM3_CH04_28, SET1_ATOM3_CH05_29, SET1_ATOM3_CH06_30, SET1_ATOM3_CH07_31, SET2_ATOM3_CH00_24, SET2_ATOM3_CH01_25, SET2_ATOM3_CH02_26, SET2_ATOM3_CH03_27, SET2_ATOM3_CH04_28, SET2_ATOM3_CH05_29, SET2_ATOM3_CH06_30, SET2_ATOM3_CH07_31, SET3_ATOM0_CH00_00, SET3_ATOM0_CH01_01, SET3_ATOM0_CH02_02, SET3_ATOM0_CH03_03, SET3_ATOM0_CH04_04, SET3_ATOM0_CH05_05, SET3_ATOM0_CH06_06, SET3_ATOM0_CH07_07, SET3_ATOM1_CH00_08, SET3_ATOM1_CH01_09, SET3_ATOM1_CH02_10, SET3_ATOM1_CH03_11, SET3_ATOM1_CH04_12, SET3_ATOM1_CH05_13, SET3_ATOM1_CH06_14, SET3_ATOM1_CH07_15, SET3_ATOM2_CH00_16, SET3_ATOM2_CH01_17, SET3_ATOM2_CH02_18, SET3_ATOM2_CH03_19, SET3_ATOM2_CH04_20, SET3_ATOM2_CH05_21, SET3_ATOM2_CH06_22, SET3_ATOM2_CH07_23, SET4_TOM03_CH00_00, SET4_TOM03_CH01_01, SET4_TOM03_CH02_02, SET4_TOM03_CH03_03, SET4_TOM03_CH04_04, SET4_TOM03_CH05_05, SET4_TOM03_CH06_06, SET4_TOM03_CH07_07, SET4_TOM03_CH08_08, SET4_TOM03_CH09_09, SET4_TOM03_CH10_10, SET4_TOM03_CH11_11, SET4_TOM03_CH12_12, SET4_TOM03_CH13_13, SET4_TOM03_CH14_14, SET4_TOM03_CH15_15, SET4_ATOM5_CH00_16, SET4_ATOM5_CH01_17, SET4_ATOM5_CH02_18, SET4_ATOM5_CH03_19, SET4_ATOM5_CH04_20, SET4_ATOM5_CH05_21, SET4_ATOM5_CH06_22, SET4_ATOM5_CH07_23, SET4_ATOM6_CH00_24, SET4_ATOM6_CH01_25, SET4_ATOM6_CH02_26, SET4_ATOM6_CH03_27, SET4_ATOM6_CH04_28, SET4_ATOM6_CH05_29, SET4_ATOM6_CH06_30, SET4_ATOM6_CH07_31, SET5_ATOM4_CH00_00, SET5_ATOM4_CH01_01, SET5_ATOM4_CH02_02, SET5_ATOM4_CH03_03, SET5_ATOM4_CH04_05, SET5_ATOM4_CH05_05, SET5_ATOM4_CH06_06, SET5_ATOM4_CH07_07, SET5_ATOM6_CH00_08, SET5_ATOM6_CH01_09, SET5_ATOM6_CH02_10, SET5_ATOM6_CH03_11, SET5_ATOM6_CH04_12, SET5_ATOM6_CH05_13, SET5_ATOM6_CH06_14, SET5_ATOM6_CH07_15, SET5_ATOM7_CH00_16, SET5_ATOM7_CH01_17, SET5_ATOM7_CH02_18, SET5_ATOM7_CH03_19, SET5_ATOM7_CH04_20, SET5_ATOM7_CH05_21, SET5_ATOM7_CH06_22, SET5_ATOM7_CH07_23, SET6_TOM04_CH00_00, SET6_TOM04_CH01_01, SET6_TOM04_CH02_02, SET6_TOM04_CH03_03, SET6_TOM04_CH04_04, SET6_TOM04_CH05_05, SET6_TOM04_CH06_06, SET6_TOM04_CH07_07, SET6_TOM04_CH08_08, SET6_TOM04_CH09_09, SET6_TOM04_CH10_10, SET6_TOM04_CH11_11, SET6_TOM04_CH12_12, SET6_TOM04_CH13_13, SET6_TOM04_CH14_14, SET6_TOM04_CH15_15, SET6_ATOM7_CH00_16, SET6_ATOM7_CH01_17, SET6_ATOM7_CH02_18, SET6_ATOM7_CH03_19, SET6_ATOM7_CH04_20, SET6_ATOM7_CH05_21, SET6_ATOM7_CH06_22, SET6_ATOM7_CH07_23, SET6_ATOM5_CH00_24, SET6_ATOM5_CH01_25, SET6_ATOM5_CH02_26, SET6_ATOM5_CH03_27, SET6_ATOM5_CH04_28, SET6_ATOM5_CH05_29, SET6_ATOM5_CH06_30, SET6_ATOM5_CH07_31}, origin=ChipowerTech, post-build-variant-value=true, set at post-build, default-value=SETX_NO_USED  # This Specifies the Setx channels that can be used as input of MSC
        container Dma [8..8]: requires-index=true  # This Specifies the TOM/ATOM channels that can be used as tirgger of DMA
          integer DmaRequestId: 0..7, scope=ECU, origin=ChipowerTech, set at pre-compile, default-value=0  # Id of the GtmToDma Register id.
          enumeration TriggerSource: {MUXN_63_NO_DMA_TRIGGER, MUX0_00_GTM_TIM00_IRQ0, MUX0_01_GTM_TIM00_IRQ1, MUX0_02_GTM_TIM00_IRQ2, MUX0_03_GTM_TIM00_IRQ3, MUX0_04_GTM_TIM00_IRQ4, MUX0_05_GTM_TIM00_IRQ5, MUX0_06_GTM_TIM00_IRQ6, MUX0_07_GTM_TIM00_IRQ7, MUX0_08_GTM_TOM00_IRQ0, MUX0_09_GTM_TOM00_IRQ1, MUX0_10_GTM_TOM00_IRQ2, MUX0_11_GTM_TOM00_IRQ3, MUX0_12_GTM_TOM00_IRQ4, MUX0_13_GTM_TOM00_IRQ5, MUX0_14_GTM_TOM00_IRQ6, MUX0_15_GTM_TOM00_IRQ7, MUX0_16_GTM_ATOM0_IRQ0, MUX0_17_GTM_ATOM0_IRQ1, MUX0_18_GTM_ATOM0_IRQ2, MUX0_19_GTM_ATOM0_IRQ3, MUX1_00_GTM_TIM01_IRQ0, MUX1_01_GTM_TIM01_IRQ1, MUX1_02_GTM_TIM01_IRQ2, MUX1_03_GTM_TIM01_IRQ3, MUX1_04_GTM_TIM01_IRQ4, MUX1_05_GTM_TIM01_IRQ5, MUX1_06_GTM_TIM01_IRQ6, MUX1_07_GTM_TIM01_IRQ7, MUX1_08_GTM_TOM01_IRQ0, MUX1_09_GTM_TOM01_IRQ1, MUX1_10_GTM_TOM01_IRQ2, MUX1_11_GTM_TOM01_IRQ3, MUX1_12_GTM_TOM01_IRQ4, MUX1_13_GTM_TOM01_IRQ5, MUX1_14_GTM_TOM01_IRQ6, MUX1_15_GTM_TOM01_IRQ7, MUX1_16_GTM_ATOM1_IRQ0, MUX1_17_GTM_ATOM1_IRQ1, MUX1_18_GTM_ATOM1_IRQ2, MUX1_19_GTM_ATOM1_IRQ3, MUX2_00_GTM_TIM02_IRQ0, MUX2_01_GTM_TIM02_IRQ1, MUX2_02_GTM_TIM02_IRQ2, MUX2_03_GTM_TIM02_IRQ3, MUX2_04_GTM_TIM02_IRQ4, MUX2_05_GTM_TIM02_IRQ5, MUX2_06_GTM_TIM02_IRQ6, MUX2_07_GTM_TIM02_IRQ7, MUX2_08_GTM_TOM02_IRQ0, MUX2_09_GTM_TOM02_IRQ1, MUX2_10_GTM_TOM02_IRQ2, MUX2_11_GTM_TOM02_IRQ3, MUX2_12_GTM_TOM02_IRQ4, MUX2_13_GTM_TOM02_IRQ5, MUX2_14_GTM_TOM02_IRQ6, MUX2_15_GTM_TOM02_IRQ7, MUX2_16_GTM_ATOM2_IRQ0, MUX2_17_GTM_ATOM2_IRQ1, MUX2_18_GTM_ATOM2_IRQ2, MUX2_19_GTM_ATOM2_IRQ3, MUX3_00_GTM_TIM03_IRQ0, MUX3_01_GTM_TIM03_IRQ1, MUX3_02_GTM_TIM03_IRQ2, MUX3_03_GTM_TIM03_IRQ3, MUX3_04_GTM_TIM03_IRQ4, MUX3_05_GTM_TIM03_IRQ5, MUX3_06_GTM_TIM03_IRQ6, MUX3_07_GTM_TIM03_IRQ7, MUX3_08_GTM_TOM03_IRQ0, MUX3_09_GTM_TOM03_IRQ1, MUX3_10_GTM_TOM03_IRQ2, MUX3_11_GTM_TOM03_IRQ3, MUX3_12_GTM_TOM03_IRQ4, MUX3_13_GTM_TOM03_IRQ5, MUX3_14_GTM_TOM03_IRQ6, MUX3_15_GTM_TOM03_IRQ7, MUX3_16_GTM_ATOM3_IRQ0, MUX3_17_GTM_ATOM3_IRQ1, MUX3_18_GTM_ATOM3_IRQ2, MUX3_19_GTM_ATOM3_IRQ3, MUX4_00_GTM_TIM04_IRQ0, MUX4_01_GTM_TIM04_IRQ1, MUX4_02_GTM_TIM04_IRQ2, MUX4_03_GTM_TIM04_IRQ3, MUX4_04_GTM_TIM04_IRQ4, MUX4_05_GTM_TIM04_IRQ5, MUX4_06_GTM_TIM04_IRQ6, MUX4_07_GTM_TIM04_IRQ7, MUX4_08_GTM_TOM04_IRQ0, MUX4_09_GTM_TOM04_IRQ1, MUX4_10_GTM_TOM04_IRQ2, MUX4_11_GTM_TOM04_IRQ3, MUX4_12_GTM_TOM04_IRQ4, MUX4_13_GTM_TOM04_IRQ5, MUX4_14_GTM_TOM04_IRQ6, MUX4_15_GTM_TOM04_IRQ7, MUX4_16_GTM_ATOM4_IRQ0, MUX4_17_GTM_ATOM4_IRQ1, MUX4_18_GTM_ATOM4_IRQ2, MUX4_19_GTM_ATOM4_IRQ3, MUX5_00_GTM_TIM05_IRQ0, MUX5_01_GTM_TIM05_IRQ1, MUX5_02_GTM_TIM05_IRQ2, MUX5_03_GTM_TIM05_IRQ3, MUX5_04_GTM_TIM05_IRQ4, MUX5_05_GTM_TIM05_IRQ5, MUX5_06_GTM_TIM05_IRQ6, MUX5_07_GTM_TIM05_IRQ7, MUX5_16_GTM_ATOM5_IRQ0, MUX5_17_GTM_ATOM5_IRQ1, MUX5_18_GTM_ATOM5_IRQ2, MUX5_19_GTM_ATOM5_IRQ3, MUX6_00_GTM_TIM06_IRQ0, MUX6_01_GTM_TIM06_IRQ1, MUX6_02_GTM_TIM06_IRQ2, MUX6_03_GTM_TIM06_IRQ3, MUX6_04_GTM_TIM06_IRQ4, MUX6_05_GTM_TIM06_IRQ5, MUX6_06_GTM_TIM06_IRQ6, MUX6_07_GTM_TIM06_IRQ7, MUX6_16_GTM_ATOM6_IRQ0, MUX6_17_GTM_ATOM6_IRQ1, MUX6_18_GTM_ATOM6_IRQ2, MUX6_19_GTM_ATOM6_IRQ3, MUX7_00_GTM_TIM07_IRQ0, MUX7_01_GTM_TIM07_IRQ1, MUX7_02_GTM_TIM07_IRQ2, MUX7_03_GTM_TIM07_IRQ3, MUX7_04_GTM_TIM07_IRQ4, MUX7_05_GTM_TIM07_IRQ5, MUX7_06_GTM_TIM07_IRQ6, MUX7_07_GTM_TIM07_IRQ7, MUX7_16_GTM_ATOM7_IRQ0, MUX7_17_GTM_ATOM7_IRQ1, MUX7_18_GTM_ATOM7_IRQ2, MUX7_19_GTM_ATOM7_IRQ3}, origin=ChipowerTech, post-build-variant-value=true, set at post-build, default-value=MUXN_63_NO_DMA_TRIGGER  # This Specifies the TOM/ATOM channel that will be used as input of DmaRequest.
        container GtmOutput [0.0..144]: multiplicity set at post-build, post-build-variant-multiplicity=true, requires-index=true  # This container contains the configuration (parameters) in case the Trigger SIGNALS.
          enumeration GtmTimerClockSelect: {CMUFXCLK0, CMUFXCLK1, CMUFXCLK2, CMUFXCLK3, CMUFXCLK4}, origin=ChipowerTech, post-build-variant-value=true, set at post-build, default-value=CMUFXCLK0  # This parameter decides the Clock Source for TOM/ATOM timer.For ATOM channel the available clocksrcs are CMU_CLK0,CMU_CLK1,CMU_CLK2,CMU_CLK3,CMU_CLK4,CMU_CLK5,CMU_CLK6,CMU_CLK7. For TOM channel the available clocksrcs are CMUFXCLK0 (CMU_FXCLK) CMUFXCLK1 (CMU_FXCLK/16) CMUFXCLK2 (CMU_FXCLK/256) CMUFXCLK3 (CMU_FXCLK/4096) CMUFXCLK4 (CMU_FXCLK/65536)
          integer GtmTimerTimePeriod: 0..65536000, origin=ChipowerTech, post-build-variant-value=true, set at post-build, default-value=20000  # This parameter is used for selecting the time period of the GTM timer in micro seconds.
          integer GtmTimerCM0Ticks: 0..16777215, origin=ChipowerTech, post-build-variant-value=true, set at post-build, default-value=0  # This parameter specifies the Period Compare value (CM0) for the TOM/ATOM Channel in ticks. Only valid if GtmTimerTimePeriod is 0.
          choice reference GtmTimerUsed: scope=ECU, origin=ChipowerTech, post-build-variant-value=true, set at post-build, destination=[GtmAtomChannel, GtmTomChannel]  # This parameter lists all the GTM timer channels (TOM/ATOM).
          reference GtmMcuClockReference: origin=ChipowerTech, post-build-variant-value=true, set at post-build, destination=CmuClockReferencePoint  # This parameter defines GTM ATOM/TOM channle clock(hz) This parameter is reference from MCU GTM Cmu clock, configure clock first in MCU Container
      container GtmResourceAllocationConf: multiplicity set at post-build  # This container is used to represent the usage of GTM resources by other modules. Users can allocate GTM resources to individual modules. No error is reported when not configured.
        container GtmTim [8..8]: requires-index=true  # This container contains the TIM Configuration for GTM
          container GtmTimChannel [8..8]: requires-index=true  # This container contains the TIM Channel Configuration
            integer ModuleId: 0..7, scope=ECU, origin=ChipowerTech, set at pre-compile, default-value=0  # Id of the TIM Cluster.
            integer ChannelId: 0..7, scope=ECU, origin=ChipowerTech, set at pre-compile, default-value=0  # Id of the TIM channel.
            enumeration GtmTimChannel: {GTM_TIM_CHANNEL_NOT_USED, GTM_TIM_CHANNEL_USED_BY_ICU}, origin=ChipowerTech, post-build-variant-value=true, set at post-build, default-value=GTM_TIM_CHANNEL_NOT_USED  # This decides as to if this Channel is used for ICU or not be used. GTM_TIM_CHANNEL_NOT_USED: Specifies that this Channel is not configured by any module (unused). GTM_TIM_CHANNEL_USED_BY_ICU: Specifies that this Channel is configured by ICU module.
        container GtmTom [5..5]: requires-index=true  # This container contains the TOM Configuration for GTM
          container GtmTomChannel [16..16]: requires-index=true  # This container contains the TOM Channel Configuration
            integer ModuleId: 0..4, scope=ECU, origin=ChipowerTech, set at pre-compile, default-value=0  # Id of the TOM Cluster.
            integer ChannelId: 0..15, scope=ECU, origin=ChipowerTech, set at pre-compile, default-value=0  # Id of the TOM channel.
            enumeration GtmTomChannel: {GTM_TOM_CHANNEL_NOT_USED, GTM_TOM_CHANNEL_USED_BY_MCU, GTM_TOM_CHANNEL_USED_BY_PWM, GTM_TOM_CHANNEL_USED_BY_GPT}, origin=ChipowerTech, post-build-variant-value=true, set at post-build, default-value=GTM_TOM_CHANNEL_NOT_USED  # This decides as to if this Channel is used or will it not be used. GTM_TOM_CHANNEL_NOT_USED: Specifies that this Channel is not configured by any module (unused). GTM_TOM_CHANNEL_USED_BY_MCU: Specifies that this Channel is configured by GTM MCU module. GTM_TOM_CHANNEL_USED_BY_PWM: Specifies that this Channel is configured by PWM module. GTM_TOM_CHANNEL_USED_BY_GPT: Specifies that this Channel is configured by GPT module.
        container GtmAtom [8..8]: requires-index=true  # This container contains the ATOM Configuration for GTM
          container GtmAtomChannel [8..8]: requires-index=true  # This container contains the ATOM Channel Configuration
            integer ModuleId: 0..7, scope=ECU, origin=ChipowerTech, set at pre-compile, default-value=0  # Id of the ATOM Cluster.
            integer ChannelId: 0..7, scope=ECU, origin=ChipowerTech, set at pre-compile, default-value=0  # Id of the ATOM channel.
            enumeration GtmAtomChannel: {GTM_ATOM_CHANNEL_NOT_USED, GTM_ATOM_CHANNEL_USED_BY_MCU, GTM_ATOM_CHANNEL_USED_BY_GPT, GTM_ATOM_CHANNEL_USED_BY_PWM, GTM_ATOM_CHANNEL_USED_BY_OCU}, origin=ChipowerTech, post-build-variant-value=true, set at post-build, default-value=GTM_ATOM_CHANNEL_NOT_USED  # This decides as to if this Channel is used or will it not be used. GTM_ATOM_CHANNEL_NOT_USED: Specifies that this Channel is not configured by any module (unused). GTM_ATOM_CHANNEL_USED_BY_MCU: Specifies that this Channel is configured by MCU module. GTM_ATOM_CHANNEL_USED_BY_GPT: Specifies that this Channel is configured by GPT module. GTM_ATOM_CHANNEL_USED_BY_OCU: Specifies that this Channel is configured by OCU module. GTM_ATOM_CHANNEL_USED_BY_PWM: Specifies that this Channel is configured by PWM module.
    container CommonPublishedInformation  # Common container, aggregated by all modules. It contains published information about vendor and versions.
      integer ArReleaseMajorVersion: 4..4, origin=ChipowerTech, set at published-information, default-value=4  # Major version number of AUTOSAR specification on which the appropriate implementation is based on.
      integer ArReleaseMinorVersion: 2..4, origin=ChipowerTech, set at published-information, default-value=4  # Minor version number of AUTOSAR specification on which the appropriate implementation is based on.
      integer ArReleaseRevisionVersion: 0..2, origin=ChipowerTech, set at published-information, default-value=0  # Revision version number of AUTOSAR specification on which the appropriate implementation is based on.
      integer ModuleId: 101..101, origin=ChipowerTech, set at published-information, default-value=101  # Module ID of this module from Module List. Note: Implementation Specific Parameter
      integer SwMajorVersion: 0..255, origin=ChipowerTech, set at published-information, default-value=1  # Major version number of the vendor specific implementation of the module. The numbering is vendor specific. Note: Implementation Specific Parameter
      integer SwMinorVersion: 0..255, origin=ChipowerTech, set at published-information, default-value=0  # Minor version number of the vendor specific implementation of the module. The numbering is vendor specific. Note: Implementation Specific Parameter
      integer SwPatchVersion: 0..255, origin=ChipowerTech, set at published-information, default-value=0  # Patch level version number of the vendor specific implementation of the module. The numbering is vendor specific. Note: Implementation Specific Parameter
      integer VendorId: 175..175, origin=ChipowerTech, set at published-information, default-value=175  # Vendor ID of the dedicated implementation of this module according to the AUTOSAR vendor list. Note: Implementation Specific Parameter
