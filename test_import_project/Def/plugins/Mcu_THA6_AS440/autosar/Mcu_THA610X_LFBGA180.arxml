AUTOSAR XML (schema 00046)
package /THA6_AS440_FuSa
  ecuc definition collection Mcu_EcuParameterDefinition: module=Mcu
  module definition Mcu [0..1]: post-build-variant-support=true, refined-module-def=Mcu, variants post-build  # Configuration of the Mcu (Microcontroller Unit) module.
    container McuGeneralConfiguration  # This container contains the configuration (parameters) of the MCU driver.
      boolean McuDevErrorDetect: set at pre-compile, default-value=false  # Switches the Default Error Tracer (Det) detection and notification ON or OFF.
      boolean McuSafetyErrorDetect: origin=ChipowerTech, set at pre-compile, default-value=true  # Switches the Safety Error detection ON or OFF.
      boolean McuGetRamStateApi: set at pre-compile, default-value=false  # Pre-processor switch to enable/disable the API Mcu_GetRamState.
      boolean McuClearColdResetStatusApi: origin=Chipower, set at pre-compile, default-value=false  # Pre-processor switch to enable/disable the API Mcu_ClearColdResetStatus..
      boolean McuInitClock: set at pre-compile, default-value=true  # If this parameter is set to FALSE, the clock initialization has to be disabled from the MCU driver. This concept applies when there are some write once clock registers and a bootloader is present. If this parameter is set to TRUE, the MCU driver is responsible of the clock initialization.
      boolean McuNoPll: set at pre-compile, default-value=false  # This parameter shall be set True, if the H/W does not have a PLL or the PLL circuitry is enabled after the power on without S/W intervention. In this case MCU_DistributePllClock has to be disabled and MCU_GetPllStatus has to return MCU_PLL_STATUS_UNDEFINED. Otherwise this parameters has to be set False
      boolean McuPerformResetApi: set at pre-compile, default-value=false  # Pre-processor switch to enable / disable the use of the function Mcu_PerformReset()
      boolean McuVersionInfoApi: set at pre-compile, default-value=false  # Pre-processor switch to enable / disable the API to read out the modules version information.
      reference McuEcucPartitionRef [0..*]: scope=ECU, multiplicity set at pre-compile, post-build-variant-multiplicity=true, post-build-variant-value=true, set at pre-compile, destination=EcucPartition  # Maps the MCU driver to zero or multiple ECUC partition to make the driver API available in this partition. Tags: atp.Status=draft
    container McuModuleConfiguration  # This container contains the configuration (parameters) of the MCU driver
      enumeration McuClockSrcFailureNotification: {DISABLED, ENABLED}, post-build-variant-value=true, set at post-build, default-value=DISABLED  # Enables/Disables clock failure notification. In case this feature is not supported by HW the setting should be disabled.
      integer McuNumberOfMcuModes: 1..255, set at pre-compile, default-value=1  # This parameter shall represent the number of Modes available for the MCU.
      integer McuRamSectors: 0..4294967295, post-build-variant-value=true, set at post-build, default-value=0  # This parameter shall represent the number of Ram available for the MCU. This parameter is disabled and is included here for completeness. calculation Formula = Number of configured McuRamSectorSettingConf.
      integer McuResetSetting [0..1]: 1..255, multiplicity set at pre-compile, set at pre-compile, default-value=1  # This parameter relates to the MCU specific reset configuration. This applies to the function Mcu_PerformReset, which performs a microcontroller reset using the hardware feature of the microcontroller. This parameter is disabled and is included here for completeness.
      container McuResetConfig  # This container contains the configuration (parameters) of the reset settings
        enumeration McuSWResetConf: {RCC_RSTTYPE_NONE, RCC_RSTTYPE_SYS, RCC_RSTTYPE_APP}, origin=ChipowerTech, post-build-variant-value=true, set at post-build, default-value=RCC_RSTTYPE_APP  # This parameter defines the response of SW reset request. RCC_RSTTYPE_NONE : No reset request is triggered. RCC_RSTTYPE_SYS : System reset is triggered. RCC_RSTTYPE_APP: Application reset request is triggered.
        enumeration McuESR0ResetConf: {RCC_RSTTYPE_NONE, RCC_RSTTYPE_SYS, RCC_RSTTYPE_APP}, origin=ChipowerTech, post-build-variant-value=true, set at post-build, default-value=RCC_RSTTYPE_APP  # This parameter defines the response of ESR0 reset request. RCC_RSTTYPE_NONE : No reset request is triggered. RCC_RSTTYPE_SYS : System reset is triggered. RCC_RSTTYPE_APP: Application reset request is triggered.
        enumeration McuESR1ResetConf: {RCC_RSTTYPE_NONE, RCC_RSTTYPE_APP}, origin=ChipowerTech, post-build-variant-value=true, set at post-build, default-value=RCC_RSTTYPE_NONE  # This parameter defines the response of ESR1 reset request. RCC_RSTTYPE_NONE : No reset request is triggered. RCC_RSTTYPE_SYS : System reset is triggered. RCC_RSTTYPE_APP: Application reset request is triggered.
        enumeration McuSACResetConf: {RCC_RSTTYPE_NONE, RCC_RSTTYPE_SYS, RCC_RSTTYPE_APP}, origin=ChipowerTech, post-build-variant-value=true, set at post-build, default-value=RCC_RSTTYPE_NONE  # This parameter defines the response of SAC reset request. RCC_RSTTYPE_NONE : No reset request is triggered. RCC_RSTTYPE_SYS : System reset is triggered. RCC_RSTTYPE_APP: Application reset request is triggered.
        enumeration McuIWDGResetConf: {RCC_RSTTYPE_NONE, RCC_RSTTYPE_SYS, RCC_RSTTYPE_APP}, origin=ChipowerTech, post-build-variant-value=true, set at post-build, default-value=RCC_RSTTYPE_NONE  # This parameter defines the response of IWDG reset request. RCC_RSTTYPE_NONE : No reset request is triggered. RCC_RSTTYPE_SYS : System reset is triggered. RCC_RSTTYPE_APP: Application reset request is triggered.
        enumeration McuCPU0REQResetConf: {RCC_RSTTYPE_NONE, RCC_RSTTYPE_SYS, RCC_RSTTYPE_APP}, origin=ChipowerTech, post-build-variant-value=true, set at post-build, default-value=RCC_RSTTYPE_NONE  # This parameter defines the response of CPU0REQ reset request. RCC_RSTTYPE_NONE : No reset request is triggered. RCC_RSTTYPE_SYS : System reset is triggered. RCC_RSTTYPE_APP: Application reset request is triggered.
        enumeration McuCPU1REQResetConf: {RCC_RSTTYPE_NONE, RCC_RSTTYPE_SYS, RCC_RSTTYPE_APP}, origin=ChipowerTech, post-build-variant-value=true, set at post-build, default-value=RCC_RSTTYPE_NONE  # This parameter defines the response of CPU1REQ reset request. RCC_RSTTYPE_NONE : No reset request is triggered. RCC_RSTTYPE_SYS : System reset is triggered. RCC_RSTTYPE_APP: Application reset request is triggered.
        integer McuResetTimeoutCnt [0..1]: 1..4096, multiplicity set at pre-compile, origin=ChipowerTech, set at pre-compile, default-value=400  # This parameter is the Counter delay of Reset setting. Set the Timeout counter value, the default value is 0x190, and the time length is 100us.Note: The counter clock is 4Mhz and the configuration range is 1 to 0x1000
      container McuClockSettingConfig [1..*]: multiplicity set at pre-compile  # This container contains the configuration (parameters) for the Clock settings of the MCU. Please see MCU031 for more information on the MCU clock settings.
        integer McuClockSettingId: 0..255, set at pre-compile, default-value=0  # The Id of this McuClockSettingConfig to be used as argument for the API call "Mcu_InitClock".
        container McuSysPllClk_Configuration
          enumeration McuSysPllSource: {RCC_PLLCLOCKSOURCE_HSE, RCC_PLLCLOCKSOURCE_HSI}, origin=ChipowerTech, post-build-variant-value=true, set at post-build, default-value=RCC_PLLCLOCKSOURCE_HSE  # Choose the source of SysPll.
          float McuHSIClkFrequency: 1000.0..2.0E8, origin=ChipowerTech, set at post-build, default-value=1.0E8  # The item is indicate that Mcu basic frequency which is from HSI.Then the clock is set to FREF if it is used.
          float McuHSEClkFrequency: 1.6E7..4.0E7, origin=ChipowerTech, post-build-variant-value=true, set at post-build, default-value=2.0E7  # The item is indicate that Mcu basic frequency which is from HSE.Then the clock is set to FREF if it is used.
          enumeration McuSysPllMode: {RCC_PLLMODE_INTEGER, RCC_PLLMODE_DECIMAL}, origin=ChipowerTech, post-build-variant-value=true, set at post-build, default-value=RCC_PLLMODE_INTEGER  # Choose the mode of SysPll.
          integer McuSysPllRefDiv: 1..63, origin=ChipowerTech, post-build-variant-value=true, set at post-build, default-value=2  # Set the RefDiv coefficient of SysPll.
          integer McuSysPllPostDiv1: 1..7, origin=ChipowerTech, post-build-variant-value=true, set at post-build, default-value=1  # Set the PostDiv1 coefficient of SysPll.
          integer McuSysPllPostDiv2: 1..7, origin=ChipowerTech, post-build-variant-value=true, set at post-build, default-value=1  # Set the PostDiv2 coefficient of SysPll.
          integer McuSysPllFBDiv: 16..2400, origin=ChipowerTech, post-build-variant-value=true, set at post-build, default-value=60  # Set the FBDiv coefficient of SysPll.
          integer McuSysPllFRAC: 0..16777215, origin=ChipowerTech, post-build-variant-value=true, set at post-build, default-value=0  # Set the FRAC coefficient of SysPll. it is used in DECIMAL Mode.
          float McuSysPllFrequency: 1000.0..3.0E8, origin=ChipowerTech, post-build-variant-value=true, set at post-build, default-value=3.0E8  # The System Pll mode clock frequency. SysPllClk =(FREF/REFDIV)*(FBDIV/(POSTDIV1*POSTDIV2*2))
        container McuPerPllClk_Configuration
          enumeration McuPerPllSource: {RCC_PLLCLOCKSOURCE_HSE, RCC_PLLCLOCKSOURCE_HSI}, origin=ChipowerTech, post-build-variant-value=true, set at post-build, default-value=RCC_PLLCLOCKSOURCE_HSE  # Choose the source of PerPll.
          enumeration McuPerPllMode: {RCC_PLLMODE_INTEGER, RCC_PLLMODE_DECIMAL}, origin=ChipowerTech, post-build-variant-value=true, set at post-build, default-value=RCC_PLLMODE_INTEGER  # Choose the mode of PerPll.
          integer McuPerPllRefDiv: 1..63, origin=ChipowerTech, post-build-variant-value=true, set at post-build, default-value=2  # Set the RefDiv coefficient of PerPll.
          integer McuPerPllPostDiv1: 1..7, origin=ChipowerTech, post-build-variant-value=true, set at post-build, default-value=2  # Set the PostDiv1 coefficient of PerPll.
          integer McuPerPllPostDiv2: 1..7, origin=ChipowerTech, post-build-variant-value=true, set at post-build, default-value=1  # Set the PostDiv2 coefficient of PerPll.
          integer McuPerPllFBDiv: 16..2400, origin=ChipowerTech, post-build-variant-value=true, set at post-build, default-value=80  # Set the FBDiv coefficient of SysPll.
          integer McuPerPllFRAC: 0..16777215, origin=ChipowerTech, post-build-variant-value=true, set at post-build, default-value=0  # Set the FRAC coefficient of PerPll. it is used in DECIMAL Mode
          float McuPerPllFrequency: 1000.0..2.0E8, origin=ChipowerTech, post-build-variant-value=true, set at post-build, default-value=2.0E8  # The Peripheral Pll mode clock frequency. PerPllClk =(FREF/REFDIV)*(FBDIV/(POSTDIV1*POSTDIV2*2))
        container McuSysClkDiv_Configuration
          enumeration McuSysClockSource: {RCC_CPUCLOCKSOURCE_SYSPLL, RCC_CPUCLOCKSOURCE_HSE, RCC_CPUCLOCKSOURCE_HSI}, origin=ChipowerTech, post-build-variant-value=true, set at post-build, default-value=RCC_CPUCLOCKSOURCE_SYSPLL  # Choose the source of SysClock. ()
          integer CpuClkDiv: 0..255, origin=ChipowerTech, post-build-variant-value=true, set at post-build, default-value=0  # Set division paramater of CpuClk
          float McuCpuClkFrequency: 1000.0..3.0E8, origin=ChipowerTech, post-build-variant-value=true, set at post-build, default-value=3.0E8  # The Cpu clock frequency. The expression is CpuClk=McuSysClockSource/(CpuClkDiv+1).
          integer SysClkDiv: 0..7, origin=ChipowerTech, post-build-variant-value=true, set at post-build, default-value=1  # Set the SysClkDiv coefficient of Clock.()
          float McuSysClkFrequency: 2.0E7..1.5E8, origin=ChipowerTech, post-build-variant-value=true, set at post-build, default-value=1.5E8  # The SysClk clock frequency. The expression is SysClk= McuCpuClkFrequency/(SysClkDiv +1).
          integer AxiDiv: 0..63, origin=ChipowerTech, post-build-variant-value=true, set at post-build, default-value=1  # Set the AxiDiv coefficient of Clock.()
          float McuAXIClkFrequency: 0.0..1.5E8, origin=ChipowerTech, post-build-variant-value=true, set at post-build, default-value=1.5E8  # The AXI clock frequency( AxiClk and Geth CLOCK). The expression is AxiClk=McuCpuClkFrequency/ (AxiDiv+1).
          integer AhbDiv: 0..511, origin=ChipowerTech, post-build-variant-value=true, set at post-build, default-value=2  # Set the AhbDiv coefficient of Clock.()
          float McuAHBClkFrequency: 0.0..1.0E8, origin=ChipowerTech, post-build-variant-value=true, set at post-build, default-value=1.0E8  # The Ahb and Apb clock frequency. The expression is AhbClk=McuCpuClkFrequency/ (AhbDiv+1).
        container McuGTMClk_Configuration  # McuGTMClk Configuration
          enumeration GTMClockSource: {RCC_MODULECLOCKSOURCE_HSI, RCC_MODULECLOCKSOURCE_PERPLL, RCC_MODULECLOCKSOURCE_HSE}, origin=ChipowerTech, post-build-variant-value=true, set at post-build, default-value=RCC_MODULECLOCKSOURCE_PERPLL  # Choose the clock source of GTM.(HSI,HSE,PerPllClk/2.)
          integer GTMClockDiv: 0..31, origin=ChipowerTech, post-build-variant-value=true, set at post-build, default-value=1  # Set the GTMClockDiv coefficient of Clock. ()
          float McuGTMClkFrequency: 0.0..1.0E8, origin=ChipowerTech, post-build-variant-value=true, set at post-build, default-value=1.0E8  # The GTM clock frequency. The expression is GtmClk=GTMClockSource/(GTMClockDiv+1).
        container McuMSCClk_Configuration  # McuMSCClk Configuration
          enumeration MSCClockSource: {RCC_MODULECLOCKSOURCE_HSI, RCC_MODULECLOCKSOURCE_PERPLL, RCC_MODULECLOCKSOURCE_HSE}, origin=ChipowerTech, post-build-variant-value=true, set at post-build, default-value=RCC_MODULECLOCKSOURCE_PERPLL  # Choose the clock source of MSC(HSI,HSE,PerPllClk/2.)
        container McuESPIClk_Configuration  # McuESPIClk Configuration
          enumeration ESPIClockSource: {RCC_MODULECLOCKSOURCE_HSI, RCC_MODULECLOCKSOURCE_PERPLL, RCC_MODULECLOCKSOURCE_HSE}, origin=ChipowerTech, post-build-variant-value=true, set at post-build, default-value=RCC_MODULECLOCKSOURCE_PERPLL  # Choose the clock source of ESPI.(HSI,HSE,PerPllClk/2.)
          integer ESPIClockDiv: 0..31, origin=ChipowerTech, post-build-variant-value=true, set at post-build, default-value=0  # Set the ESPIClockDiv coefficient of Clock.( )
          float McuESPIClkFrequency: 0.0..2.0E8, origin=ChipowerTech, post-build-variant-value=true, set at post-build, default-value=2.0E8  # The ESPI clock frequency. The expression is EspiClk=ESPIClockSource/(ESPIClockDiv+1).
        container McuWDTClk_Configuration  # McuWDTClk Configuration
          enumeration CpuWDTClockSource: {RCC_MODULECLOCKSOURCE_HSI, RCC_MODULECLOCKSOURCE_PERPLL, RCC_MODULECLOCKSOURCE_HSE}, origin=ChipowerTech, post-build-variant-value=true, set at post-build, default-value=RCC_MODULECLOCKSOURCE_PERPLL  # Choose the clock source of WDT internal CPU.(HSI,HSE,PerPllClk/2.)
          integer CpuWDTClockDiv: 0..31, origin=ChipowerTech, post-build-variant-value=true, set at post-build, default-value=3  # Set the CpuWDTClockDiv coefficient of Clock.()
          float McuCPU_WDTClkFrequency: 0.0..5.0E7, origin=ChipowerTech, post-build-variant-value=true, set at post-build, default-value=5.0E7  # The CPU_WDT clock frequency. The expression is WdtClk =CpuWDTClockSource/(CpuWDTClockDiv+1).
        container McuCanClk_Configuration  # McuCanClk Configuration
          enumeration CANClockSource: {RCC_MODULECLOCKSOURCE_HSI, RCC_MODULECLOCKSOURCE_PERPLL, RCC_MODULECLOCKSOURCE_HSE}, origin=ChipowerTech, post-build-variant-value=true, set at post-build, default-value=RCC_MODULECLOCKSOURCE_PERPLL  # Choose the clock source of CAN.((HSI,HSE,PerPllClk))
          integer CANClockDiv: 0..63, origin=ChipowerTech, post-build-variant-value=true, set at post-build, default-value=4  # Set the CANClockDiv coefficient of Clock.()Note: .
          float McuCAN_PEClkFrequency: 0.0..8.0E7, origin=ChipowerTech, post-build-variant-value=true, set at post-build, default-value=8.0E7  # The CAN_PE clock frequency. The expression is CAN_PE_CLK=CANClockSource/(CANClockDiv+1).
        container McuDMAClk_Configuration  # McuDMAClk Configuration
          boolean DMA0_CLKEN: origin=ChipowerTech, post-build-variant-value=true, set at post-build, default-value=true  # This parameter specifies the clock of DMA0 is enable or not. it is as same as AXI clock
          boolean DMA{1..3}_CLKEN: origin=ChipowerTech, post-build-variant-value=true, set at post-build, default-value=true  # This parameter specifies the clock of DMA{1..3} is enable or not.it is as same as AXI clock
        container McuSarAdcClk_Configuration  # SarAdcClk Configuration
          enumeration SarAdcClockSource: {RCC_MODULECLOCKSOURCE_HSI, RCC_MODULECLOCKSOURCE_PERPLL, RCC_MODULECLOCKSOURCE_HSE}, origin=ChipowerTech, post-build-variant-value=true, set at post-build, default-value=RCC_MODULECLOCKSOURCE_PERPLL  # Choose the clock source of SarAdc.(HSI,HSE,PerPllClk/2.)
        container McuBaseTimerClk_Configuration  # McuBaseTimer Configration
          enumeration BaseTimer0ClockSource: {RCC_MODULECLOCKSOURCE_HSI, RCC_MODULECLOCKSOURCE_PERPLL, RCC_MODULECLOCKSOURCE_HSE}, origin=ChipowerTech, post-build-variant-value=true, set at post-build, default-value=RCC_MODULECLOCKSOURCE_PERPLL  # Choose the clock source of BaseTimer .(HSI,HSE,PerPllClk/2.)
          integer BaseTimer0ClockDiv: 3..65535, origin=ChipowerTech, post-build-variant-value=true, set at post-build, default-value=3  # Set the ClockDiv coefficient of BaseTimer Clock.(BaceTimerXCLK=BaseTimerXClockSource/(BaseTimerXClockDiv+1))
          float BaseTimer0Frequency: 0.0..5.0E7, origin=ChipowerTech, post-build-variant-value=true, set at post-build, default-value=5.0E7  # The BaseTimer clock frequency. The expression is BaceTimerCLK=BaseTimerClockSource/(BaseTimerClockDiv+1).
          enumeration BaseTimer1ClockSource: {RCC_MODULECLOCKSOURCE_HSI, RCC_MODULECLOCKSOURCE_PERPLL, RCC_MODULECLOCKSOURCE_HSE}, origin=ChipowerTech, post-build-variant-value=true, set at post-build, default-value=RCC_MODULECLOCKSOURCE_PERPLL  # Choose the clock source of BaseTimer .(HSI,HSE,PerPllClk/2.)
          integer BaseTimer1ClockDiv: 3..65535, origin=ChipowerTech, post-build-variant-value=true, set at post-build, default-value=3  # Set the ClockDiv coefficient of BaseTimer Clock.(BaceTimerXCLK=BaseTimerXClockSource/(BaseTimerXClockDiv+1))
          float BaseTimer1Frequency: 0.0..5.0E7, origin=ChipowerTech, post-build-variant-value=true, set at post-build, default-value=5.0E7  # The BaseTimer clock frequency. The expression is BaceTimerCLK=BaseTimerClockSource/(BaseTimerClockDiv+1).
          enumeration BaseTimer2ClockSource: {RCC_MODULECLOCKSOURCE_HSI, RCC_MODULECLOCKSOURCE_PERPLL, RCC_MODULECLOCKSOURCE_HSE}, origin=ChipowerTech, post-build-variant-value=true, set at post-build, default-value=RCC_MODULECLOCKSOURCE_PERPLL  # Choose the clock source of BaseTimer .(HSI,HSE,PerPllClk/2.)
          integer BaseTimer2ClockDiv: 3..65535, origin=ChipowerTech, post-build-variant-value=true, set at post-build, default-value=3  # Set the ClockDiv coefficient of BaseTimer Clock.(BaceTimerXCLK=BaseTimerXClockSource/(BaseTimerXClockDiv+1))
          float BaseTimer2Frequency: 0.0..5.0E7, origin=ChipowerTech, post-build-variant-value=true, set at post-build, default-value=5.0E7  # The BaseTimer clock frequency. The expression is BaceTimerCLK=BaseTimerClockSource/(BaseTimerClockDiv+1).
          enumeration BaseTimer3ClockSource: {RCC_MODULECLOCKSOURCE_HSI, RCC_MODULECLOCKSOURCE_PERPLL, RCC_MODULECLOCKSOURCE_HSE}, origin=ChipowerTech, post-build-variant-value=true, set at post-build, default-value=RCC_MODULECLOCKSOURCE_PERPLL  # Choose the clock source of BaseTimer .(HSI,HSE,PerPllClk/2.)
          integer BaseTimer3ClockDiv: 3..65535, origin=ChipowerTech, post-build-variant-value=true, set at post-build, default-value=3  # Set the ClockDiv coefficient of BaseTimer Clock.(BaceTimerXCLK=BaseTimerXClockSource/(BaseTimerXClockDiv+1))
          float BaseTimer3Frequency: 0.0..5.0E7, origin=ChipowerTech, post-build-variant-value=true, set at post-build, default-value=5.0E7  # The BaseTimer clock frequency. The expression is BaceTimerCLK=BaseTimerClockSource/(BaseTimerClockDiv+1).
          enumeration BaseTimer4ClockSource: {RCC_MODULECLOCKSOURCE_HSI, RCC_MODULECLOCKSOURCE_PERPLL, RCC_MODULECLOCKSOURCE_HSE}, origin=ChipowerTech, post-build-variant-value=true, set at post-build, default-value=RCC_MODULECLOCKSOURCE_PERPLL  # Choose the clock source of BaseTimer .(HSI,HSE,PerPllClk/2.)
          integer BaseTimer4ClockDiv: 3..65535, origin=ChipowerTech, post-build-variant-value=true, set at post-build, default-value=3  # Set the ClockDiv coefficient of BaseTimer Clock.(BaceTimerXCLK=BaseTimerXClockSource/(BaseTimerXClockDiv+1))
          float BaseTimer4Frequency: 0.0..5.0E7, origin=ChipowerTech, post-build-variant-value=true, set at post-build, default-value=5.0E7  # The BaseTimer clock frequency. The expression is BaceTimerCLK=BaseTimerClockSource/(BaseTimerClockDiv+1).
          enumeration BaseTimer5ClockSource: {RCC_MODULECLOCKSOURCE_HSI, RCC_MODULECLOCKSOURCE_PERPLL, RCC_MODULECLOCKSOURCE_HSE}, origin=ChipowerTech, post-build-variant-value=true, set at post-build, default-value=RCC_MODULECLOCKSOURCE_PERPLL  # Choose the clock source of BaseTimer .(HSI,HSE,PerPllClk/2.)
          integer BaseTimer5ClockDiv: 3..65535, origin=ChipowerTech, post-build-variant-value=true, set at post-build, default-value=3  # Set the ClockDiv coefficient of BaseTimer Clock.(BaceTimerXCLK=BaseTimerXClockSource/(BaseTimerXClockDiv+1))
          float BaseTimer5Frequency: 0.0..5.0E7, origin=ChipowerTech, post-build-variant-value=true, set at post-build, default-value=5.0E7  # The BaseTimer clock frequency. The expression is BaceTimerCLK=BaseTimerClockSource/(BaseTimerClockDiv+1).
        container Mcu_Dsadc_Rdc_Clk_Configuration  # McuDsadcClk Configuration
          enumeration ClockSource: {RCC_MODULECLOCKSOURCE_HSI, RCC_MODULECLOCKSOURCE_PERPLL, RCC_MODULECLOCKSOURCE_HSE}, origin=ChipowerTech, post-build-variant-value=true, set at post-build, default-value=RCC_MODULECLOCKSOURCE_PERPLL  # Choose the clock source of DSADC or RDC.((HSI,HSE,PerPllClk))
          integer DSADCClockDiv: 0..63, origin=ChipowerTech, post-build-variant-value=true, set at post-build, default-value=24  # Set the DSADCClockDiv coefficient of Clock.()Note: .
          float McuDSADC_ClkFrequency: 0.0..8.0E7, origin=ChipowerTech, post-build-variant-value=true, set at post-build, default-value=0.0  # The DSADC clock frequency. The expression is DSADC_CLK=ClockSource/(DSADCClockDiv+1).
          integer RDCClockDiv: 0..63, origin=ChipowerTech, post-build-variant-value=true, set at post-build, default-value=19  # Set the RDCClockDiv coefficient of Clock.()Note: .
          float McuRdc_ClkFrequency: 0.0..8.0E7, origin=ChipowerTech, post-build-variant-value=true, set at post-build, default-value=0.0  # The Rdc clock frequency. The expression is RDC_CLK=ClockSource/(RDCClockDiv+1).
        container McuClockReferencePoint [1..*]: multiplicity set at post-build, post-build-variant-multiplicity=true  # This container defines a reference point in the Mcu Clock tree. It defines the frequency which then can be used by other modules as an input value. Lower multiplicity is 1, as even in the simplest case (only one frequency is used), there is one frequency to be defined.
          enumeration McuClockReferenceSelect: {RCC_MODULECLOCKSOURCE_HSI, RCC_MODULECLOCKSOURCE_HSE, TEST_CLK, SYSPLL_REF_CLK, CPU_CLK, SYS_CLK, AXI_CLK, APB_AHB_CLK, APB_STB_CLK, ASI_CLK, STM_CLK, GTM_CLK, ESPI_CLK, WDT_CLK, CAN_CLK, MSC_CLK, BASE_TIMER0_CLK, BASE_TIMER1_CLK, BASE_TIMER2_CLK, BASE_TIMER3_CLK, BASE_TIMER4_CLK, BASE_TIMER5_CLK, SAR_ADC_CLK, DSADC_CLK, RDC_CLK}, scope=ECU, origin=ChipowerTech, post-build-variant-value=true, set at post-build, default-value=RCC_MODULECLOCKSOURCE_HSI  # This is the frequency for the specific instance of the McuClockReferencePoint container. It shall be given in Hz.
          float McuClockReferencePointFrequency: 0.0..INF, scope=ECU, post-build-variant-value=true, set at post-build, default-value=0.0  # This is the frequency for the specific instance of the McuClockReferencePoint container. It shall be given in Hz.
      container McuDemEventParameterRefs [0..1]: multiplicity set at pre-compile  # Container for the references to DemEventParameter elements which shall be invoked using the API Dem_ReportErrorStatus API in case the corresponding error occurs. The EventId is taken from the referenced DemEventParameter's DemEventId symbolic name. The standardized errors are provided in the container and can be extended by vendor specific error references.
        reference MCU_E_CLOCK_FAILURE [0..1]: multiplicity set at pre-compile, set at pre-compile, requires-symbolic-name-value=true, destination=DemEventParameter  # Reference to configured DEM event to report "Clock source failure".
      container McuModeSettingConf [1..2]: multiplicity set at pre-compile, requires-index=true  # This container contains the configuration (parameters) for the Mode setting of the MCU. Please see MCU035 for more information on the MCU mode settings.
        integer McuMode: 0..1, set at pre-compile, symbolic-name-value=true, default-value=0  # The parameter represents the MCU Mode settings. 0 : IDLE mode is selected. 1 : STANDBY mode is selected.
        container McuStdbySettingConf
          container McuStdbyWakeupSource
            boolean ESR0: origin=ChipowerTech, post-build-variant-value=true, set at post-build, default-value=false  # ESR0 as wake-up source for standby mode.
            enumeration ESR0Edge: {RISING, FALLING, RISINGFALLING}, origin=ChipowerTech, post-build-variant-value=true, set at post-build, default-value=FALLING  # Define PWRC Standby Domain wake-up pin edge for standby mode
            boolean ESR1: origin=ChipowerTech, post-build-variant-value=true, set at post-build, default-value=false  # ESR1 as wake-up source for standby mode.
            enumeration ESR1Edge: {RISING, FALLING, RISINGFALLING}, origin=ChipowerTech, post-build-variant-value=true, set at post-build, default-value=FALLING  # Define PWRC Standby Domain wake-up pin edge for standby mode
            boolean PINA: origin=ChipowerTech, post-build-variant-value=true, set at post-build, default-value=false  # PINA as wake-up source for standby mode.
            enumeration PINAEdge: {RISING, FALLING, RISINGFALLING}, origin=ChipowerTech, post-build-variant-value=true, set at post-build, default-value=FALLING  # Define PWRC Standby Domain wake-up pin edge for standby mode
            boolean PINB: origin=ChipowerTech, post-build-variant-value=true, set at post-build, default-value=false  # PINB as wake-up source for standby mode.
            enumeration PINBEdge: {RISING, FALLING, RISINGFALLING}, origin=ChipowerTech, post-build-variant-value=true, set at post-build, default-value=FALLING  # Define PWRC Standby Domain wake-up pin edge for standby mode
            boolean PORST: origin=ChipowerTech, post-build-variant-value=true, set at post-build, default-value=false  # PORST as wake-up source for standby mode.
            enumeration PORSTEdge: {RISING, FALLING, RISINGFALLING}, origin=ChipowerTech, post-build-variant-value=true, set at post-build, default-value=FALLING  # Define PWRC Standby Domain wake-up pin edge for standby mode
            boolean VEXT: origin=ChipowerTech, post-build-variant-value=true, set at post-build, default-value=false  # VEXT as wake-up source for standby mode.
            enumeration VEXTEdge: {RISING, FALLING, RISINGFALLING}, origin=ChipowerTech, post-build-variant-value=true, set at post-build, default-value=FALLING  # Define PWRC Standby Domain wake-up pin edge for standby mode
            boolean P33_00: origin=ChipowerTech, post-build-variant-value=true, set at post-build, default-value=false  # P33_00 as wake-up source for standby mode.
            enumeration P33_00Edge: {RISING, FALLING, RISINGFALLING}, origin=ChipowerTech, post-build-variant-value=true, set at post-build, default-value=FALLING  # Define PWRC Standby Domain wake-up pin edge for standby mode
            boolean P33_01: origin=ChipowerTech, post-build-variant-value=true, set at post-build, default-value=false  # P33_01 as wake-up source for standby mode.
            enumeration P33_01Edge: {RISING, FALLING, RISINGFALLING}, origin=ChipowerTech, post-build-variant-value=true, set at post-build, default-value=FALLING  # Define PWRC Standby Domain wake-up pin edge for standby mode
            boolean P33_02: origin=ChipowerTech, post-build-variant-value=true, set at post-build, default-value=false  # P33_02 as wake-up source for standby mode.
            enumeration P33_02Edge: {RISING, FALLING, RISINGFALLING}, origin=ChipowerTech, post-build-variant-value=true, set at post-build, default-value=FALLING  # Define PWRC Standby Domain wake-up pin edge for standby mode
            boolean P33_03: origin=ChipowerTech, post-build-variant-value=true, set at post-build, default-value=false  # P33_03 as wake-up source for standby mode.
            enumeration P33_03Edge: {RISING, FALLING, RISINGFALLING}, origin=ChipowerTech, post-build-variant-value=true, set at post-build, default-value=FALLING  # Define PWRC Standby Domain wake-up pin edge for standby mode
            boolean P33_04: origin=ChipowerTech, post-build-variant-value=true, set at post-build, default-value=false  # P33_04 as wake-up source for standby mode.
            enumeration P33_04Edge: {RISING, FALLING, RISINGFALLING}, origin=ChipowerTech, post-build-variant-value=true, set at post-build, default-value=FALLING  # Define PWRC Standby Domain wake-up pin edge for standby mode
            boolean P33_05: origin=ChipowerTech, post-build-variant-value=true, set at post-build, default-value=false  # P33_05 as wake-up source for standby mode.
            enumeration P33_05Edge: {RISING, FALLING, RISINGFALLING}, origin=ChipowerTech, post-build-variant-value=true, set at post-build, default-value=FALLING  # Define PWRC Standby Domain wake-up pin edge for standby mode
            boolean P33_06: origin=ChipowerTech, post-build-variant-value=true, set at post-build, default-value=false  # P33_06 as wake-up source for standby mode.
            enumeration P33_06Edge: {RISING, FALLING, RISINGFALLING}, origin=ChipowerTech, post-build-variant-value=true, set at post-build, default-value=FALLING  # Define PWRC Standby Domain wake-up pin edge for standby mode
            boolean P33_07: origin=ChipowerTech, post-build-variant-value=true, set at post-build, default-value=false  # P33_07 as wake-up source for standby mode.
            enumeration P33_07Edge: {RISING, FALLING, RISINGFALLING}, origin=ChipowerTech, post-build-variant-value=true, set at post-build, default-value=FALLING  # Define PWRC Standby Domain wake-up pin edge for standby mode
            boolean P33_08: origin=ChipowerTech, post-build-variant-value=true, set at post-build, default-value=false  # P33_08 as wake-up source for standby mode.
            enumeration P33_08Edge: {RISING, FALLING, RISINGFALLING}, origin=ChipowerTech, post-build-variant-value=true, set at post-build, default-value=FALLING  # Define PWRC Standby Domain wake-up pin edge for standby mode
            boolean P33_09: origin=ChipowerTech, post-build-variant-value=true, set at post-build, default-value=false  # P33_09 as wake-up source for standby mode.
            enumeration P33_09Edge: {RISING, FALLING, RISINGFALLING}, origin=ChipowerTech, post-build-variant-value=true, set at post-build, default-value=FALLING  # Define PWRC Standby Domain wake-up pin edge for standby mode
            boolean P33_10: origin=ChipowerTech, post-build-variant-value=true, set at post-build, default-value=false  # P33_10 as wake-up source for standby mode.
            enumeration P33_10Edge: {RISING, FALLING, RISINGFALLING}, origin=ChipowerTech, post-build-variant-value=true, set at post-build, default-value=FALLING  # Define PWRC Standby Domain wake-up pin edge for standby mode
            boolean P33_11: origin=ChipowerTech, post-build-variant-value=true, set at post-build, default-value=false  # P33_11 as wake-up source for standby mode.
            enumeration P33_11Edge: {RISING, FALLING, RISINGFALLING}, origin=ChipowerTech, post-build-variant-value=true, set at post-build, default-value=FALLING  # Define PWRC Standby Domain wake-up pin edge for standby mode
            boolean P33_13: origin=ChipowerTech, post-build-variant-value=true, set at post-build, default-value=false  # P33_13 as wake-up source for standby mode.
            enumeration P33_13Edge: {RISING, FALLING, RISINGFALLING}, origin=ChipowerTech, post-build-variant-value=true, set at post-build, default-value=FALLING  # Define PWRC Standby Domain wake-up pin edge for standby mode
            boolean P33_14: origin=ChipowerTech, post-build-variant-value=true, set at post-build, default-value=false  # P33_14 as wake-up source for standby mode.
            enumeration P33_14Edge: {RISING, FALLING, RISINGFALLING}, origin=ChipowerTech, post-build-variant-value=true, set at post-build, default-value=FALLING  # Define PWRC Standby Domain wake-up pin edge for standby mode
            boolean P33_15: origin=ChipowerTech, post-build-variant-value=true, set at post-build, default-value=false  # P33_15 as wake-up source for standby mode.
            enumeration P33_15Edge: {RISING, FALLING, RISINGFALLING}, origin=ChipowerTech, post-build-variant-value=true, set at post-build, default-value=FALLING  # Define PWRC Standby Domain wake-up pin edge for standby mode
            boolean P34_01: origin=ChipowerTech, post-build-variant-value=true, set at post-build, default-value=false  # P34_01 as wake-up source for standby mode.
            enumeration P34_01Edge: {RISING, FALLING, RISINGFALLING}, origin=ChipowerTech, post-build-variant-value=true, set at post-build, default-value=FALLING  # Define PWRC Standby Domain wake-up pin edge for standby mode
            boolean P34_02: origin=ChipowerTech, post-build-variant-value=true, set at post-build, default-value=false  # P34_02 as wake-up source for standby mode.
            enumeration P34_02Edge: {RISING, FALLING, RISINGFALLING}, origin=ChipowerTech, post-build-variant-value=true, set at post-build, default-value=FALLING  # Define PWRC Standby Domain wake-up pin edge for standby mode
            boolean P34_03: origin=ChipowerTech, post-build-variant-value=true, set at post-build, default-value=false  # P34_03 as wake-up source for standby mode.
            enumeration P34_03Edge: {RISING, FALLING, RISINGFALLING}, origin=ChipowerTech, post-build-variant-value=true, set at post-build, default-value=FALLING  # Define PWRC Standby Domain wake-up pin edge for standby mode
            boolean P34_04: origin=ChipowerTech, post-build-variant-value=true, set at post-build, default-value=false  # P34_04 as wake-up source for standby mode.
            enumeration P34_04Edge: {RISING, FALLING, RISINGFALLING}, origin=ChipowerTech, post-build-variant-value=true, set at post-build, default-value=FALLING  # Define PWRC Standby Domain wake-up pin edge for standby mode
            boolean P34_05: origin=ChipowerTech, post-build-variant-value=true, set at post-build, default-value=false  # P34_05 as wake-up source for standby mode.
            enumeration P34_05Edge: {RISING, FALLING, RISINGFALLING}, origin=ChipowerTech, post-build-variant-value=true, set at post-build, default-value=FALLING  # Define PWRC Standby Domain wake-up pin edge for standby mode
      container McuRamSectorSettingConf [0..*]: multiplicity set at pre-compile  # This container contains the configuration (parameters) for the RAM Sector setting. Please see MCU030 for more information on RAM sec-tor settings.
        integer McuRamDefaultValue: 0..255, post-build-variant-value=true, set at post-build, default-value=0  # This parameter shall represent the Data pre-setting to be initialized
        integer McuRamSectionBaseAddress: 0..4294967295, post-build-variant-value=true, set at post-build, default-value=2097152  # This parameter shall represent the MCU RAM section base address. This address requires 16 byte alignment
        integer McuRamSectionSize: 4..4294967295, post-build-variant-value=true, set at post-build, default-value=8192  # This parameter represents the MCU RAM Section size in bytes.
        integer McuRamSectionWriteSize: 0..4294967295, post-build-variant-value=true, set at post-build, default-value=8  # This parameter shall define the size in bytes of data which can be written into RAM at once.
    container McuPublishedInformation  # Container holding all MCU specific published information parameters
      container McuResetReasonConf [14..14]: multiplicity set at pre-compile, requires-index=true  # This container contains the configuration for the different type of reset reason that can be retrieved from Mcu_GetResetReason Api.
        integer McuResetReason: 0..255, scope=ECU, set at published-information, symbolic-name-value=true, default-value=0  # The parameter represents the different type of reset that a Micro supports. This parameter is referenced by the parameter EcuMResetReason in the ECU State manager module.
    container GtmConfiguration [1..*]: multiplicity set at post-build, post-build-variant-multiplicity=true  # This container contains the configuration parameters of the GTM driver.
      container GtmGeneral  # This container contains the General Configuration for GTM
        integer CMUGlobalClkDivNumerator: 0..16777215, origin=ChipowerTech, post-build-variant-value=true, set at post-build, default-value=1  # This parameter specifies the Numerator value for the CMU Global Clock Divider. This modifies GTM_CMU_GCLK_NUM [GCLK_NUM]. Global Clock = System Clock * ( CMUGlobalClkDivDenominator/ CMUGlobalClkDivNumerator).
        integer CMUGlobalClkDivDenominator: 0..16777215, origin=ChipowerTech, post-build-variant-value=true, set at post-build, default-value=1  # This parameter specifies the Denominator value for the CMU Global Clock Divider. Global Clock = System Clock * ( CMUGlobalClkDivDenominator/ CMUGlobalClkDivNumerator). This value should be configured lesser than Numerator value.
        integer CMUClusterClockCfg: 0..16777215, origin=ChipowerTech, post-build-variant-value=true, set at post-build, default-value=11184805  # This parameter (enable \ disable \ enabled with clock divider 2) the cluster clock..
        boolean GTM_TBU_Support: origin=ChipowerTech, post-build-variant-value=true, set at post-build, default-value=false  # This parameter specifies the TBU module used or not.
      container Cmu: multiplicity set at post-build  # This container contains the Clock Configuration for GTM
        container CmuConfigurableClock  # This container contains the Configurable Clock Configuration for GTM
          boolean CmuEnableConfigurableClk0: origin=ChipowerTech, post-build-variant-value=true, set at post-build, default-value=false  # Enables/Disables the Configurable Clock 0 of GTM. This modifies GTM_CMU_CLK_EN[EN_CLK0]
          integer CmuConfigurableClk0Div: 0..16777215, origin=ChipowerTech, post-build-variant-value=true, set at post-build, default-value=0  # This parameter specifies the Divider value for the configurable Clock 0. This modifies GTM_CMU_CLK_0_CTRL[CLK_CNT]. Hence the final clock frequency will be, Gtm frequency (after Global prescaler) /(Divider value configured here + 1)
          boolean CmuEnableConfigurableClk1: origin=ChipowerTech, post-build-variant-value=true, set at post-build, default-value=false  # Enables the Configurable Clock 1 of GTM. This modifies GTM_CMU_CLK_EN[EN_CLK1].
          integer CmuConfigurableClk1Div: 0..16777215, origin=ChipowerTech, post-build-variant-value=true, set at post-build, default-value=0  # This parameter specifies the Divider value for the configurable Clock 1. This modifies GTM_CMU_CLK_1_CTRL[CLK_CNT] Hence the final clock frequency will be, Gtm frequency (after Global prescaler) /(Divider value configured here + 1)
          boolean CmuEnableConfigurableClk2: origin=ChipowerTech, post-build-variant-value=true, set at post-build, default-value=false  # Enables the Configurable Clock 2 of GTM. This modifies GTM_CMU_CLK_EN[EN_CLK2].
          integer CmuConfigurableClk2Div: 0..16777215, origin=ChipowerTech, post-build-variant-value=true, set at post-build, default-value=0  # This parameter specifies the Divider value for the configurable Clock 2. This modifies GTM_CMU_CLK_2_CTRL[CLK_CNT] Hence the final clock frequency will be, Gtm frequency (after Global prescaler) /(Divider value configured here + 1)
          boolean CmuEnableConfigurableClk3: origin=ChipowerTech, post-build-variant-value=true, set at post-build, default-value=false  # Enables the Configurable Clock 3 of GTM. This modifies GTM_CMU_CLK_EN[EN_CLK3].
          integer CmuConfigurableClk3Div: 0..16777215, origin=ChipowerTech, post-build-variant-value=true, set at post-build, default-value=0  # This parameter specifies the Divider value for the configurable Clock 3. This modifies GTM_CMU_CLK_3_CTRL[CLK_CNT]. Hence the final clock frequency will be, Gtm frequency (after Global prescaler) /(Divider value configured here + 1)
          boolean CmuEnableConfigurableClk4: origin=ChipowerTech, post-build-variant-value=true, set at post-build, default-value=false  # Enables the Configurable Clock 4 of GTM. This modifies GTM_CMU_CLK_EN[EN_CLK4].
          integer CmuConfigurableClk4Div: 0..16777215, origin=ChipowerTech, post-build-variant-value=true, set at post-build, default-value=0  # This parameter specifies the Divider value for the configurable Clock 4. This modifies GTM_CMU_CLK_4_CTRL[CLK_CNT]. Hence the final clock frequency will be, Gtm frequency (after Global prescaler) /(Divider value configured here + 1)
          boolean CmuEnableConfigurableClk5: origin=ChipowerTech, post-build-variant-value=true, set at post-build, default-value=false  # Enables the Configurable Clock 5 of GTM. This modifies GTM_CMU_CLK_EN[EN_CLK5].
          integer CmuConfigurableClk5Div: 0..16777215, origin=ChipowerTech, post-build-variant-value=true, set at post-build, default-value=0  # This parameter specifies the Divider value for the configurable Clock 5. This modifies GTM_CMU_CLK_5_CTRL[CLK_CNT]. Hence the final clock frequency will be, Gtm frequency (after Global prescaler) /(Divider value configured here + 1)
          boolean CmuEnableConfigurableClk6: origin=ChipowerTech, post-build-variant-value=true, set at post-build, default-value=false  # Enables the Configurable Clock 6 of GTM. This modifies GTM_CMU_CLK_EN[EN_CLK6].
          enumeration CmuClk6SourceSelect: {CMU_CLK_6_DIVIDER, CMU_SUB_INC2_SIGNAL}, origin=ChipowerTech, post-build-variant-value=true, set at post-build, default-value=CMU_CLK_6_DIVIDER  # Clock Source select for CMU Clock6. This modifies GTM_CMU_CLK_6_CTRL[CLK6_SEL] CMU_CLK_6_DIVIDER: Use Global Clock prescaled using Clock 6 Divider as CMU Clock 6 CMU_SUB_INC2_SIGNAL: Use Sub_Inc2 as the CMU Clock 6
          integer CmuConfigurableClk6Div: 0..16777215, origin=ChipowerTech, post-build-variant-value=true, set at post-build, default-value=0  # This parameter specifies the Divider value for the configurable Clock 6. This modifies GTM_CMU_CLK_6_CTRL[CLK_CNT]. Hence the final clock frequency will be, Signal chosen by CmuClk6SourceSelect /(Divider value configured here + 1)
          boolean CmuEnableConfigurableClk7: origin=ChipowerTech, post-build-variant-value=true, set at post-build, default-value=false  # Enables the Configurable Clock 7 of GTM. This modifies GTM_CMU_CLK_EN[EN_CLK7].
          enumeration CmuClk7SourceSelect: {CMU_CLK_7_DIVIDER, CMU_SUB_INC1_SIGNAL}, origin=ChipowerTech, post-build-variant-value=true, set at post-build, default-value=CMU_CLK_7_DIVIDER  # Clock Source select for CMU Clock7. This modifies GTM_CMU_CLK_7_CTRL[CLK7_SEL] CMU_CLK_7_DIVIDER: Use Global Clock prescaled using Clock 7 Divider as CMU Clock 7 CMU_SUB_INC2_SIGNAL: Use Sub_Inc2 as the CMU Clock 7.
          integer CmuConfigurableClk7Div: 0..16777215, origin=ChipowerTech, post-build-variant-value=true, set at post-build, default-value=0  # This parameter specifies the Divider value for the configurable Clock 7. This modifies GTM_CMU_CLK_7_CTRL[CLK_CNT]. Hence the final clock frequency will be, Signal chosen by CmuClk6SourceSelect /(Divider value configured here + 1)
        container CmuFixedClock  # This container contains the Fixed Clock Configuration for GTM
          boolean CmuEnableAllFixedClocks: origin=ChipowerTech, post-build-variant-value=true, set at post-build, default-value=false  # Enables/Disables the Fixed Clocks of GTM. This modifies GTM_CMU_CLK_EN[EN_FXCLK]. CMU provides 5 Fixed Clocks with the following Prescale values respectively; 1, 16, 256, 4096, 65536. Hence the final clock frequency will be, Gtm frequency (after Global prescaler) /Fixed Clock Prescale value
          enumeration CmuFxdClkSourceSelect: {GTM_CMU_GCLK_EN, GTM_CMU_CLK0, GTM_CMU_CLK1, GTM_CMU_CLK2, GTM_CMU_CLK3, GTM_CMU_CLK4, GTM_CMU_CLK5, GTM_CMU_CLK6, GTM_CMU_CLK7}, origin=ChipowerTech, post-build-variant-value=true, set at post-build, default-value=GTM_CMU_GCLK_EN  # Clock Source select for Fixed Clock. This modifies CMU_CLK_EN [FXCLK_SEL] GTM_CMU_GCLK_EN: Use Global Clock as input for Fixed Clock. GTM_CMU_CLK0: Use Clock 0 as the clock source for Fixed Clock GTM_CMU_CLK1: Use Clock 1 as the clock source for Fixed Clock GTM_CMU_CLK2: Use Clock 2 as the clock source for Fixed Clock GTM_CMU_CLK3: Use Clock 3 as the clock source for Fixed Clock GTM_CMU_CLK4: Use Clock 4 as the clock source for Fixed Clock GTM_CMU_CLK5: Use Clock 5 as the clock source for Fixed Clock GTM_CMU_CLK6: Use Clock 6 as the clock source for Fixed Clock GTM_CMU_CLK7: Use Clock 7 as the clock source for Fixed Clock Default: GTM_CMU_GCLK_EN
          float CmuFxdClkFrequency: 0.0..1.0E8, origin=ChipowerTech, post-build-variant-value=true, set at post-build, default-value=0.0  # The Cmu Fixed clock frequency.
        container CmuExternalClock  # This container contains the External Clock Configuration for GTM
          boolean CmuEnableExternalClk0: origin=ChipowerTech, post-build-variant-value=true, set at post-build, default-value=false  # Enables/Disables the External Clock 0 of GTM. This sets GTM_CMU_CLK_EN[EN_ECLK0].
          integer CmuExternalClk0Numerator: 0..16777215, origin=ChipowerTech, post-build-variant-value=true, set at post-build, default-value=1  # This parameter specifies the Numerator value for the External Clock Divider0. This modifies GTM_CMU_ECLK_0_NUM [ECLK_NUM]. Final Clock value = System clock Frequency/(2 *( CmuExternalClk0Numerator/ CmuExternalClk0Denominator))
          integer CmuExternalClk0Denominator: 0..16777215, origin=ChipowerTech, post-build-variant-value=true, set at post-build, default-value=1  # This parameter specifies the Denominator value for the External Clock Divider0. This modifies GTM_CMU_ECLK_0_DEN[ECLK_DEN]. Final Clock value = System clock Frequency/(2 *( CmuExternalClk0Numerator/ CmuExternalClk0Denominator))
          boolean CmuEnableExternalClk1: origin=ChipowerTech, post-build-variant-value=true, set at post-build, default-value=false  # Enables/Disables the External Clock 1 of GTM. This sets GTM_CMU_CLK_EN[EN_ECLK1].
          integer CmuExternalClk1Numerator: 0..16777215, origin=ChipowerTech, post-build-variant-value=true, set at post-build, default-value=1  # This parameter specifies the Numerator value for the External Clock Divider1. This modifies GTM_CMU_ECLK_1_NUM[ECLK_NUM]. Final Clock value = System clock Frequency/(2 *( CmuExternalClk1Numerator/ CmuExternalClk1Denominator))
          integer CmuExternalClk1Denominator: 0..16777215, origin=ChipowerTech, post-build-variant-value=true, set at post-build, default-value=1  # This parameter specifies the Denominator value for the External Clock Divider1. This modifies GTM_CMU_ECLK_1_DEN[ECLK_DEN]. Final Clock value = System clock Frequency/(2 *( CmuExternalClk1Numerator/ CmuExternalClk1Denominator))
          boolean CmuEnableExternalClk2: origin=ChipowerTech, post-build-variant-value=true, set at post-build, default-value=false  # Enables/Disables the External Clock 2 of GTM. This sets GTM_CMU_CLK_EN.
          integer CmuExternalClk2Numerator: 0..16777215, origin=ChipowerTech, post-build-variant-value=true, set at post-build, default-value=1  # This parameter specifies the Numerator value for the External Clock Divider2. This modifies GTM_CMU_ECLK_2_NUM[ECLK_NUM]. Final Clock value = System clock Frequency/(2 *( CmuExternalClk2Numerator/ CmuExternalClk2Denominator))
          integer CmuExternalClk2Denominator: 0..16777215, origin=ChipowerTech, post-build-variant-value=true, set at post-build, default-value=1  # This parameter specifies the Denominator value for the External Clock Divider2. This modifies GTM_CMU_ECLK_2_DEN[ECLK_DEN]. Final Clock value = System clock Frequency/(2 *( CmuExternalClk2Numerator/ CmuExternalClk2Denominator))
        container CmuClockReferencePoint [0..*]: multiplicity set at post-build, post-build-variant-multiplicity=true  # This container defines a reference point in the Cmu Clock tree. It defines the frequency which then can be used by other modules as an input value. Lower multiplicity is 1, as even in the simplest case (only one frequency is used), there is one frequency to be defined.
          enumeration McuClockReferenceSelect: {CMU_CLK0, CMU_CLK1, CMU_CLK2, CMU_CLK3, CMU_CLK4, CMU_CLK5, CMU_CLK6, CMU_CLK7, CMU_ECLK0, CMU_ECLK1, CMU_ECLK2, CMU_FXCLK}, scope=ECU, origin=ChipowerTech, post-build-variant-value=true, set at post-build, default-value=CMU_CLK0  # This is the frequency for the specific instance of the McuClockReferencePoint container. It shall be given in Hz.
          float CmuClockReferencePointFrequency: 0.0..1.0E8, scope=ECU, origin=ChipowerTech, post-build-variant-value=true, set at post-build, default-value=0.0  # This is the frequency for the specific instance of the McuClockReferencePoint container. It shall be given in Hz.
      container Tbu: multiplicity set at post-build  # This container provides the TBU configuration.
        container TbuChannel [3..3]: requires-index=true  # This container provides the TBU Channel configuration.
          integer TbuChannelID: 0..255, scope=ECU, origin=ChipowerTech, set at pre-compile, symbolic-name-value=true, default-value=0  # This parameter provides the channel ID which is unique in a given TBU Driver. The value for this parameter starts with 0 and continue without any gaps.
          boolean TbuEnableChannel: origin=ChipowerTech, post-build-variant-value=true, set at post-build, default-value=false  # Enables the TBU Channel.
          enumeration TbuChannelModeSelect: {GTM_TBU_MODE_FREERUNNING, GTM_TBU_MODE_FORWARDBACKWARD}, origin=ChipowerTech, post-build-variant-value=true, set at post-build, default-value=GTM_TBU_MODE_FREERUNNING  # This decides the Mode for the TBU Channel. This is only applicable for TBU Channel 1 and 2 FOR-ALL: GTM_TBU_MODE_FREERUNNING: Free Running Mode chosen FOR-ALL: GTM_TBU_MODE_FORWARDBACKWARD: Forward Backward Counter mode chosen
          enumeration TbuChannelClockSource: {GTM_CMU_CLK_0, GTM_CMU_CLK_1, GTM_CMU_CLK_2, GTM_CMU_CLK_3, GTM_CMU_CLK_4, GTM_CMU_CLK_5, GTM_CMU_CLK_6, GTM_CMU_CLK_7}, origin=ChipowerTech, post-build-variant-value=true, set at post-build, default-value=GTM_CMU_CLK_0  # value="EN: This decides the Clock Source for the TBU Channel FOR-ALL: GTM_CMU_CLK_0: Configurable Clock0 is chosen FOR-ALL: GTM_CMU_CLK_1: Configurable Clock1 is chosen FOR-ALL: GTM_CMU_CLK_2: Configurable Clock2 is chosen FOR-ALL: GTM_CMU_CLK_3: Configurable Clock3 is chosen FOR-ALL: GTM_CMU_CLK_4: Configurable Clock4 is chosen FOR-ALL: GTM_CMU_CLK_5: Configurable Clock5 is chosen FOR-ALL: GTM_CMU_CLK_6: Configurable Clock6 is chosen FOR-ALL: GTM_CMU_CLK_7: Configurable Clock7 is chosen
          enumeration TbuChannelResolution: {GTM_TBU_TS0_BIT_LOWER, GTM_TBU_TS0_BIT_UPPER}, origin=ChipowerTech, post-build-variant-value=true, set at post-build, default-value=GTM_TBU_TS0_BIT_LOWER  # This decides the resolution for the TBU Channel. This is only applicable for TBU Channel 0 GTM_TBU_TS0_BIT_LOWER: Choose Lower 24 Bits of TBU GTM_TBU_TS0_BIT_UPPER: Choose Higher 24 Bits of TBU
          integer TbuTimebaseValue: 0..16777215, origin=ChipowerTech, post-build-variant-value=true, set at post-build, default-value=0  # This parameter specifies the Timebase value for the TBU Channel
      container Tom [2..2]: requires-index=true  # This container contains the TOM Configuration for GTM
        container TomChannel [16..16]: requires-index=true  # This container contains the TOM Channel configuration
          container TomChannelOutput  # This container contains the TOM Channel Output configuration
            boolean GTM_Tom_Negative_Support: origin=ChipowerTech, post-build-variant-value=true, set at post-build, default-value=false  # This parameter specifies the Tom negative module used or not.
            integer TomId: 0..1, scope=ECU, origin=ChipowerTech, set at pre-compile, default-value=0  # Id of the TOM Cluster.
            integer ChannelId: 0..15, scope=ECU, origin=ChipowerTech, set at pre-compile, default-value=0  # Id of the TOM channel.
            enumeration TomChannelNegativePortPinSelect: {TOMXXCHXX_NO_USED_TOM_CHANNEL, TOM0CH00N_TOUT091_SEL4_PORT13_PIN00, TOM0CH00N_TOUT009_SEL4_PORT00_PIN00, TOM0CH00N_TOUT017_SEL4_PORT00_PIN08, TOM0CH00N_TOUT034_SEL4_PORT33_PIN12, TOM0CH00N_TOUT025_SEL4_PORT33_PIN03, TOM0CH00N_TOUT061_SEL5_PORT20_PIN03, TOM0CH00N_TOUT072_SEL4_PORT10_PIN04, TOM0CH00N_TOUT072_SEL4_PORT15_PIN01, TOM0CH00N_TOUT007_SEL4_PORT02_PIN07, TOM0CH01N_TOUT030_SEL4_PORT33_PIN08, TOM0CH01N_TOUT107_SEL4_PORT10_PIN05, TOM0CH01N_TOUT057_SEL4_PORT21_PIN06, TOM0CH01N_TOUT073_SEL4_PORT10_PIN07, TOM0CH01N_TOUT073_SEL4_PORT15_PIN02, TOM0CH01N_TOUT004_SEL4_PORT02_PIN04, TOM0CH01N_TOUT010_SEL4_PORT00_PIN01, TOM0CH01N_TOUT014_SEL4_PORT00_PIN05, TOM0CH01N_TOUT022_SEL4_PORT33_PIN00, TOM0CH01N_TOUT092_SEL4_PORT13_PIN01, TOM0CH02N_TOUT058_SEL4_PORT21_PIN07, TOM0CH02N_TOUT023_SEL4_PORT33_PIN01, TOM0CH02N_TOUT108_SEL4_PORT10_PIN06, TOM0CH02N_TOUT011_SEL4_PORT00_PIN02, TOM0CH02N_TOUT015_SEL4_PORT00_PIN06, TOM0CH02N_TOUT093_SEL4_PORT13_PIN02, TOM0CH02N_TOUT074_SEL4_PORT15_PIN03, TOM0CH02N_TOUT074_SEL4_PORT10_PIN08, TOM0CH02N_TOUT005_SEL4_PORT02_PIN05, TOM0CH03N_TOUT075_SEL4_PORT15_PIN04, TOM0CH03N_TOUT042_SEL6_PORT23_PIN01, TOM0CH03N_TOUT059_SEL4_PORT20_PIN00, TOM0CH03N_TOUT094_SEL4_PORT13_PIN03, TOM0CH03N_TOUT024_SEL4_PORT33_PIN02, TOM0CH03N_TOUT012_SEL4_PORT00_PIN03, TOM0CH03N_TOUT006_SEL4_PORT02_PIN06, TOM0CH03N_TOUT016_SEL4_PORT00_PIN07, TOM0CH04N_TOUT010_SEL6_PORT00_PIN01, TOM0CH04N_TOUT056_SEL4_PORT21_PIN05, TOM0CH04N_TOUT073_SEL6_PORT10_PIN07, TOM0CH04N_TOUT073_SEL6_PORT15_PIN02, TOM0CH04N_TOUT008_SEL6_PORT02_PIN08, TOM0CH04N_TOUT001_SEL6_PORT02_PIN01, TOM0CH04N_TOUT096_SEL6_PORT11_PIN03, TOM0CH04N_TOUT065_SEL5_PORT20_PIN09, TOM0CH04N_TOUT095_SEL5_PORT11_PIN02, TOM0CH04N_TOUT054_SEL6_PORT21_PIN03, TOM0CH04N_TOUT029_SEL4_PORT33_PIN07, TOM0CH05N_TOUT032_SEL4_PORT33_PIN10, TOM0CH05N_TOUT097_SEL5_PORT11_PIN06, TOM0CH05N_TOUT056_SEL6_PORT21_PIN05, TOM0CH05N_TOUT076_SEL6_PORT15_PIN05, TOM0CH05N_TOUT077_SEL5_PORT15_PIN06, TOM0CH05N_TOUT053_SEL4_PORT21_PIN02, TOM0CH05N_TOUT067_SEL5_PORT20_PIN01, TOM0CH05N_TOUT067_SEL5_PORT20_PIN11, TOM0CH05N_TOUT028_SEL6_PORT33_PIN06, TOM0CH05N_TOUT012_SEL6_PORT00_PIN03, TOM0CH05N_TOUT003_SEL6_PORT02_PIN03, TOM0CH05N_TOUT026_SEL4_PORT33_PIN04, TOM0CH06N_TOUT031_SEL4_PORT33_PIN09, TOM0CH06N_TOUT082_SEL4_PORT14_PIN02, TOM0CH06N_TOUT049_SEL6_PORT22_PIN02, TOM0CH06N_TOUT030_SEL6_PORT33_PIN08, TOM0CH06N_TOUT005_SEL6_PORT02_PIN05, TOM0CH06N_TOUT069_SEL5_PORT20_PIN13, TOM0CH06N_TOUT069_SEL5_PORT14_PIN08, TOM0CH06N_TOUT099_SEL5_PORT11_PIN10, TOM0CH06N_TOUT027_SEL4_PORT33_PIN05, TOM0CH06N_TOUT086_SEL4_PORT14_PIN06, TOM0CH06N_TOUT014_SEL6_PORT00_PIN05, TOM0CH06N_TOUT091_SEL6_PORT13_PIN00, TOM0CH06N_TOUT078_SEL5_PORT15_PIN07, TOM0CH06N_TOUT097_SEL6_PORT11_PIN06, TOM0CH06N_TOUT054_SEL4_PORT21_PIN03, TOM0CH07N_TOUT084_SEL4_PORT14_PIN04, TOM0CH07N_TOUT016_SEL6_PORT00_PIN07, TOM0CH07N_TOUT079_SEL5_PORT15_PIN08, TOM0CH07N_TOUT093_SEL6_PORT13_PIN02, TOM0CH07N_TOUT071_SEL6_PORT15_PIN00, TOM0CH07N_TOUT071_SEL6_PORT14_PIN10, TOM0CH07N_TOUT032_SEL6_PORT33_PIN10, TOM0CH07N_TOUT033_SEL4_PORT33_PIN11, TOM0CH07N_TOUT055_SEL4_PORT21_PIN04, TOM0CH07N_TOUT007_SEL6_PORT02_PIN07, TOM0CH07N_TOUT100_SEL5_PORT11_PIN11, TOM0CH07N_TOUT042_SEL4_PORT23_PIN01, TOM0CH07N_TOUT028_SEL4_PORT33_PIN06, TOM1CH00N_TOUT025_SEL5_PORT33_PIN03, TOM1CH00N_TOUT017_SEL5_PORT00_PIN08, TOM1CH00N_TOUT007_SEL5_PORT02_PIN07, TOM1CH00N_TOUT034_SEL5_PORT33_PIN12, TOM1CH00N_TOUT075_SEL5_PORT15_PIN04, TOM1CH01N_TOUT022_SEL5_PORT33_PIN00, TOM1CH01N_TOUT004_SEL5_PORT02_PIN04, TOM1CH01N_TOUT030_SEL5_PORT33_PIN08, TOM1CH01N_TOUT072_SEL5_PORT10_PIN04, TOM1CH01N_TOUT072_SEL5_PORT15_PIN01, TOM1CH01N_TOUT014_SEL5_PORT00_PIN05, TOM1CH02N_TOUT005_SEL5_PORT02_PIN05, TOM1CH02N_TOUT015_SEL5_PORT00_PIN06, TOM1CH02N_TOUT023_SEL5_PORT33_PIN01, TOM1CH02N_TOUT073_SEL5_PORT10_PIN07, TOM1CH02N_TOUT073_SEL5_PORT15_PIN02, TOM1CH03N_TOUT074_SEL5_PORT15_PIN03, TOM1CH03N_TOUT074_SEL5_PORT10_PIN08, TOM1CH03N_TOUT006_SEL5_PORT02_PIN06, TOM1CH03N_TOUT024_SEL5_PORT33_PIN02, TOM1CH03N_TOUT016_SEL5_PORT00_PIN07, TOM1CH04N_TOUT010_SEL7_PORT00_PIN01, TOM1CH04N_TOUT054_SEL7_PORT21_PIN03, TOM1CH04N_TOUT071_SEL5_PORT15_PIN00, TOM1CH04N_TOUT071_SEL5_PORT14_PIN10, TOM1CH04N_TOUT021_SEL5_PORT00_PIN12, TOM1CH04N_TOUT073_SEL7_PORT10_PIN07, TOM1CH04N_TOUT073_SEL7_PORT15_PIN02, TOM1CH04N_TOUT095_SEL7_PORT11_PIN02, TOM1CH04N_TOUT065_SEL6_PORT20_PIN09, TOM1CH04N_TOUT029_SEL5_PORT33_PIN07, TOM1CH04N_TOUT008_SEL7_PORT02_PIN08, TOM1CH04N_TOUT013_SEL5_PORT00_PIN04, TOM1CH04N_TOUT001_SEL7_PORT02_PIN01, TOM1CH05N_TOUT012_SEL7_PORT00_PIN03, TOM1CH05N_TOUT077_SEL6_PORT15_PIN06, TOM1CH05N_TOUT026_SEL5_PORT33_PIN04, TOM1CH05N_TOUT076_SEL7_PORT15_PIN05, TOM1CH05N_TOUT032_SEL5_PORT33_PIN10, TOM1CH05N_TOUT009_SEL5_PORT00_PIN00, TOM1CH05N_TOUT097_SEL7_PORT11_PIN06, TOM1CH05N_TOUT018_SEL5_PORT00_PIN09, TOM1CH05N_TOUT067_SEL6_PORT20_PIN01, TOM1CH05N_TOUT067_SEL6_PORT20_PIN11, TOM1CH05N_TOUT003_SEL7_PORT02_PIN03, TOM1CH05N_TOUT056_SEL7_PORT21_PIN05, TOM1CH05N_TOUT028_SEL7_PORT33_PIN06, TOM1CH06N_TOUT082_SEL5_PORT14_PIN02, TOM1CH06N_TOUT010_SEL5_PORT00_PIN01, TOM1CH06N_TOUT069_SEL6_PORT20_PIN13, TOM1CH06N_TOUT069_SEL6_PORT14_PIN08, TOM1CH06N_TOUT099_SEL7_PORT11_PIN10, TOM1CH06N_TOUT005_SEL7_PORT02_PIN05, TOM1CH06N_TOUT091_SEL7_PORT13_PIN00, TOM1CH06N_TOUT031_SEL5_PORT33_PIN09, TOM1CH06N_TOUT030_SEL7_PORT33_PIN08, TOM1CH06N_TOUT011_SEL5_PORT00_PIN02, TOM1CH06N_TOUT027_SEL5_PORT33_PIN05, TOM1CH06N_TOUT049_SEL7_PORT22_PIN02, TOM1CH06N_TOUT078_SEL6_PORT15_PIN07, TOM1CH06N_TOUT014_SEL7_PORT00_PIN05, TOM1CH07N_TOUT007_SEL7_PORT02_PIN07, TOM1CH07N_TOUT093_SEL7_PORT13_PIN02, TOM1CH07N_TOUT032_SEL7_PORT33_PIN10, TOM1CH07N_TOUT012_SEL5_PORT00_PIN03, TOM1CH07N_TOUT079_SEL6_PORT15_PIN08, TOM1CH07N_TOUT016_SEL7_PORT00_PIN07, TOM1CH07N_TOUT100_SEL7_PORT11_PIN11, TOM1CH07N_TOUT084_SEL5_PORT14_PIN04, TOM1CH07N_TOUT042_SEL5_PORT23_PIN01, TOM1CH07N_TOUT028_SEL5_PORT33_PIN06, TOM1CH07N_TOUT071_SEL7_PORT15_PIN00, TOM1CH07N_TOUT071_SEL7_PORT14_PIN10, TOM1CH07N_TOUT033_SEL5_PORT33_PIN11}, origin=ChipowerTech, post-build-variant-value=true, set at post-build, default-value=TOMXXCHXX_NO_USED_TOM_CHANNEL  # This decides the output port and pin for the TOM Channel. This parameter is not applicable in case of configuration using bmd. While using Bmd, GtmToutConfiguration should be configured for Port assignment.
            enumeration TomChannelPortPinSelect: {TOMXXCHXX_NO_USED_TOM_CHANNEL, TOM00CH00_TOUT032_SEL0_PORT33_PIN10, TOM00CH00_TOUT026_SEL0_PORT33_PIN04, TOM00CH00_TOUT053_SEL0_PORT21_PIN02, TOM00CH00_TOUT018_SEL0_PORT00_PIN09, TOM00CH00_TOUT077_SEL0_PORT15_PIN06, TOM00CH00_TOUT000_SEL4_PORT02_PIN00, TOM00CH00_TOUT085_SEL0_PORT14_PIN05, TOM00CH00_TOUT076_SEL0_PORT15_PIN05, TOM00CH10_TOUT012_SEL0_PORT00_PIN03, TOM00CH10_TOUT002_SEL0_PORT02_PIN02, TOM00CH10_TOUT096_SEL0_PORT11_PIN03, TOM00CH01_TOUT001_SEL4_PORT02_PIN01, TOM00CH01_TOUT054_SEL0_PORT21_PIN03, TOM00CH01_TOUT086_SEL0_PORT14_PIN06, TOM00CH01_TOUT027_SEL0_PORT33_PIN05, TOM00CH01_TOUT031_SEL0_PORT33_PIN09, TOM00CH01_TOUT103_SEL0_PORT10_PIN01, TOM00CH01_TOUT078_SEL0_PORT15_PIN07, TOM00CH11_TOUT003_SEL0_PORT02_PIN03, TOM00CH11_TOUT013_SEL0_PORT00_PIN04, TOM00CH11_TOUT097_SEL0_PORT11_PIN06, TOM00CH11_TOUT049_SEL0_PORT22_PIN02, TOM00CH12_TOUT098_SEL0_PORT11_PIN09, TOM00CH12_TOUT050_SEL0_PORT22_PIN03, TOM00CH12_TOUT004_SEL0_PORT02_PIN04, TOM00CH12_TOUT014_SEL0_PORT00_PIN05, TOM00CH13_TOUT005_SEL0_PORT02_PIN05, TOM00CH13_TOUT099_SEL0_PORT11_PIN10, TOM00CH13_TOUT015_SEL0_PORT00_PIN06, TOM00CH14_TOUT006_SEL0_PORT02_PIN06, TOM00CH14_TOUT100_SEL0_PORT11_PIN11, TOM00CH14_TOUT016_SEL0_PORT00_PIN07, TOM00CH15_TOUT101_SEL0_PORT11_PIN12, TOM00CH15_TOUT017_SEL0_PORT00_PIN08, TOM00CH15_TOUT007_SEL0_PORT02_PIN07, TOM00CH15_TOUT042_SEL1_PORT23_PIN01, TOM00CH02_TOUT107_SEL0_PORT10_PIN05, TOM00CH02_TOUT002_SEL4_PORT02_PIN02, TOM00CH02_TOUT033_SEL0_PORT33_PIN11, TOM00CH02_TOUT079_SEL0_PORT15_PIN08, TOM00CH02_TOUT028_SEL0_PORT33_PIN06, TOM00CH02_TOUT104_SEL0_PORT10_PIN02, TOM00CH02_TOUT055_SEL0_PORT21_PIN04, TOM00CH03_TOUT071_SEL4_PORT15_PIN00, TOM00CH03_TOUT071_SEL4_PORT14_PIN10, TOM00CH03_TOUT105_SEL0_PORT10_PIN03, TOM00CH03_TOUT003_SEL4_PORT02_PIN03, TOM00CH03_TOUT108_SEL0_PORT10_PIN06, TOM00CH03_TOUT056_SEL0_PORT21_PIN05, TOM00CH03_TOUT021_SEL0_PORT00_PIN12, TOM00CH03_TOUT080_SEL0_PORT14_PIN00, TOM00CH03_TOUT029_SEL0_PORT33_PIN07, TOM00CH04_TOUT124_SEL5_PORT11_PIN08, TOM00CH04_TOUT094_SEL6_PORT13_PIN03, TOM00CH04_TOUT030_SEL0_PORT33_PIN08, TOM00CH04_TOUT053_SEL6_PORT21_PIN02, TOM00CH04_TOUT064_SEL5_PORT20_PIN08, TOM00CH04_TOUT009_SEL6_PORT00_PIN00, TOM00CH04_TOUT072_SEL6_PORT10_PIN04, TOM00CH04_TOUT072_SEL6_PORT15_PIN01, TOM00CH04_TOUT000_SEL6_PORT02_PIN00, TOM00CH04_TOUT022_SEL0_PORT33_PIN00, TOM00CH04_TOUT081_SEL0_PORT14_PIN01, TOM00CH04_TOUT057_SEL0_PORT21_PIN06, TOM00CH05_TOUT055_SEL6_PORT21_PIN04, TOM00CH05_TOUT091_SEL0_PORT13_PIN00, TOM00CH05_TOUT066_SEL5_PORT20_PIN10, TOM00CH05_TOUT023_SEL0_PORT33_PIN01, TOM00CH05_TOUT074_SEL6_PORT15_PIN03, TOM00CH05_TOUT074_SEL6_PORT10_PIN08, TOM00CH05_TOUT058_SEL0_PORT21_PIN07, TOM00CH05_TOUT027_SEL6_PORT33_PIN05, TOM00CH05_TOUT082_SEL0_PORT14_PIN02, TOM00CH05_TOUT096_SEL5_PORT11_PIN03, TOM00CH05_TOUT002_SEL6_PORT02_PIN02, TOM00CH05_TOUT011_SEL6_PORT00_PIN02, TOM00CH06_TOUT068_SEL5_PORT20_PIN12, TOM00CH06_TOUT068_SEL5_PORT14_PIN07, TOM00CH06_TOUT083_SEL0_PORT14_PIN03, TOM00CH06_TOUT080_SEL4_PORT14_PIN00, TOM00CH06_TOUT059_SEL0_PORT20_PIN00, TOM00CH06_TOUT048_SEL6_PORT22_PIN01, TOM00CH06_TOUT092_SEL0_PORT13_PIN01, TOM00CH06_TOUT004_SEL6_PORT02_PIN04, TOM00CH06_TOUT029_SEL6_PORT33_PIN07, TOM00CH06_TOUT098_SEL5_PORT11_PIN09, TOM00CH06_TOUT042_SEL0_PORT23_PIN01, TOM00CH06_TOUT013_SEL6_PORT00_PIN04, TOM00CH06_TOUT024_SEL0_PORT33_PIN02, TOM00CH07_TOUT092_SEL6_PORT13_PIN01, TOM00CH07_TOUT101_SEL5_PORT11_PIN12, TOM00CH07_TOUT050_SEL6_PORT22_PIN03, TOM00CH07_TOUT025_SEL0_PORT33_PIN03, TOM00CH07_TOUT093_SEL0_PORT13_PIN02, TOM00CH07_TOUT081_SEL4_PORT14_PIN01, TOM00CH07_TOUT031_SEL6_PORT33_PIN09, TOM00CH07_TOUT070_SEL5_PORT14_PIN09, TOM00CH07_TOUT070_SEL5_PORT20_PIN14, TOM00CH07_TOUT084_SEL0_PORT14_PIN04, TOM00CH07_TOUT006_SEL6_PORT02_PIN06, TOM00CH07_TOUT015_SEL6_PORT00_PIN06, TOM00CH08_TOUT000_SEL0_PORT02_PIN00, TOM00CH08_TOUT009_SEL0_PORT00_PIN00, TOM00CH08_TOUT048_SEL0_PORT22_PIN01, TOM00CH08_TOUT008_SEL0_PORT02_PIN08, TOM00CH08_TOUT095_SEL0_PORT11_PIN02, TOM00CH08_TOUT094_SEL0_PORT13_PIN03, TOM00CH09_TOUT001_SEL0_PORT02_PIN01, TOM00CH09_TOUT010_SEL0_PORT00_PIN01, TOM00CH09_TOUT047_SEL0_PORT22_PIN00, TOM00CH09_TOUT011_SEL0_PORT00_PIN02, TOM01CH00_TOUT077_SEL1_PORT15_PIN06, TOM01CH00_TOUT076_SEL1_PORT15_PIN05, TOM01CH00_TOUT068_SEL0_PORT20_PIN12, TOM01CH00_TOUT068_SEL0_PORT14_PIN07, TOM01CH00_TOUT009_SEL1_PORT00_PIN00, TOM01CH00_TOUT032_SEL1_PORT33_PIN10, TOM01CH00_TOUT008_SEL1_PORT02_PIN08, TOM01CH00_TOUT085_SEL1_PORT14_PIN05, TOM01CH00_TOUT026_SEL1_PORT33_PIN04, TOM01CH00_TOUT000_SEL5_PORT02_PIN00, TOM01CH00_TOUT018_SEL1_PORT00_PIN09, TOM01CH01_TOUT069_SEL0_PORT20_PIN13, TOM01CH01_TOUT069_SEL0_PORT14_PIN08, TOM01CH01_TOUT027_SEL1_PORT33_PIN05, TOM01CH01_TOUT031_SEL1_PORT33_PIN09, TOM01CH01_TOUT010_SEL1_PORT00_PIN01, TOM01CH01_TOUT011_SEL1_PORT00_PIN02, TOM01CH01_TOUT086_SEL1_PORT14_PIN06, TOM01CH01_TOUT078_SEL1_PORT15_PIN07, TOM01CH01_TOUT001_SEL5_PORT02_PIN01, TOM01CH10_TOUT002_SEL1_PORT02_PIN02, TOM01CH10_TOUT062_SEL0_PORT20_PIN06, TOM01CH11_TOUT003_SEL1_PORT02_PIN03, TOM01CH11_TOUT063_SEL0_PORT20_PIN07, TOM01CH12_TOUT034_SEL0_PORT33_PIN12, TOM01CH12_TOUT004_SEL1_PORT02_PIN04, TOM01CH12_TOUT061_SEL0_PORT20_PIN03, TOM01CH13_TOUT065_SEL0_PORT20_PIN09, TOM01CH13_TOUT005_SEL1_PORT02_PIN05, TOM01CH14_TOUT066_SEL0_PORT20_PIN10, TOM01CH14_TOUT006_SEL1_PORT02_PIN06, TOM01CH15_TOUT007_SEL1_PORT02_PIN07, TOM01CH15_TOUT067_SEL0_PORT20_PIN01, TOM01CH15_TOUT067_SEL0_PORT20_PIN11, TOM01CH02_TOUT002_SEL5_PORT02_PIN02, TOM01CH02_TOUT079_SEL1_PORT15_PIN08, TOM01CH02_TOUT012_SEL1_PORT00_PIN03, TOM01CH02_TOUT028_SEL1_PORT33_PIN06, TOM01CH02_TOUT070_SEL0_PORT14_PIN09, TOM01CH02_TOUT070_SEL0_PORT20_PIN14, TOM01CH02_TOUT033_SEL1_PORT33_PIN11, TOM01CH03_TOUT029_SEL1_PORT33_PIN07, TOM01CH03_TOUT013_SEL1_PORT00_PIN04, TOM01CH03_TOUT080_SEL1_PORT14_PIN00, TOM01CH03_TOUT003_SEL5_PORT02_PIN03, TOM01CH03_TOUT071_SEL0_PORT15_PIN00, TOM01CH03_TOUT071_SEL0_PORT14_PIN10, TOM01CH03_TOUT021_SEL1_PORT00_PIN12, TOM01CH04_TOUT124_SEL7_PORT11_PIN08, TOM01CH04_TOUT000_SEL7_PORT02_PIN00, TOM01CH04_TOUT030_SEL1_PORT33_PIN08, TOM01CH04_TOUT072_SEL7_PORT10_PIN04, TOM01CH04_TOUT072_SEL7_PORT15_PIN01, TOM01CH04_TOUT053_SEL7_PORT21_PIN02, TOM01CH04_TOUT072_SEL0_PORT10_PIN04, TOM01CH04_TOUT072_SEL0_PORT15_PIN01, TOM01CH04_TOUT014_SEL1_PORT00_PIN05, TOM01CH04_TOUT064_SEL6_PORT20_PIN08, TOM01CH04_TOUT094_SEL7_PORT13_PIN03, TOM01CH04_TOUT081_SEL1_PORT14_PIN01, TOM01CH04_TOUT009_SEL7_PORT00_PIN00, TOM01CH04_TOUT022_SEL1_PORT33_PIN00, TOM01CH05_TOUT082_SEL1_PORT14_PIN02, TOM01CH05_TOUT023_SEL1_PORT33_PIN01, TOM01CH05_TOUT015_SEL1_PORT00_PIN06, TOM01CH05_TOUT066_SEL6_PORT20_PIN10, TOM01CH05_TOUT096_SEL7_PORT11_PIN03, TOM01CH05_TOUT027_SEL7_PORT33_PIN05, TOM01CH05_TOUT074_SEL7_PORT15_PIN03, TOM01CH05_TOUT074_SEL7_PORT10_PIN08, TOM01CH05_TOUT073_SEL0_PORT10_PIN07, TOM01CH05_TOUT073_SEL0_PORT15_PIN02, TOM01CH05_TOUT002_SEL7_PORT02_PIN02, TOM01CH05_TOUT055_SEL7_PORT21_PIN04, TOM01CH05_TOUT011_SEL7_PORT00_PIN02, TOM01CH06_TOUT048_SEL7_PORT22_PIN01, TOM01CH06_TOUT004_SEL7_PORT02_PIN04, TOM01CH06_TOUT098_SEL7_PORT11_PIN09, TOM01CH06_TOUT029_SEL7_PORT33_PIN07, TOM01CH06_TOUT016_SEL1_PORT00_PIN07, TOM01CH06_TOUT013_SEL7_PORT00_PIN04, TOM01CH06_TOUT068_SEL6_PORT20_PIN12, TOM01CH06_TOUT068_SEL6_PORT14_PIN07, TOM01CH06_TOUT074_SEL0_PORT15_PIN03, TOM01CH06_TOUT074_SEL0_PORT10_PIN08, TOM01CH06_TOUT024_SEL1_PORT33_PIN02, TOM01CH06_TOUT083_SEL1_PORT14_PIN03, TOM01CH06_TOUT080_SEL5_PORT14_PIN00, TOM01CH07_TOUT064_SEL0_PORT20_PIN08, TOM01CH07_TOUT006_SEL7_PORT02_PIN06, TOM01CH07_TOUT075_SEL0_PORT15_PIN04, TOM01CH07_TOUT025_SEL1_PORT33_PIN03, TOM01CH07_TOUT015_SEL7_PORT00_PIN06, TOM01CH07_TOUT081_SEL5_PORT14_PIN01, TOM01CH07_TOUT017_SEL1_PORT00_PIN08, TOM01CH07_TOUT101_SEL7_PORT11_PIN12, TOM01CH07_TOUT031_SEL7_PORT33_PIN09, TOM01CH07_TOUT084_SEL1_PORT14_PIN04, TOM01CH07_TOUT070_SEL6_PORT14_PIN09, TOM01CH07_TOUT070_SEL6_PORT20_PIN14, TOM01CH07_TOUT050_SEL7_PORT22_PIN03, TOM01CH07_TOUT092_SEL7_PORT13_PIN01, TOM01CH08_TOUT000_SEL1_PORT02_PIN00, TOM01CH09_TOUT001_SEL1_PORT02_PIN01}, origin=ChipowerTech, post-build-variant-value=true, set at post-build, default-value=TOMXXCHXX_NO_USED_TOM_CHANNEL  # This decides the output port and pin for the TOM Channel. This parameter is not applicable in case of configuration using bmd. While using Bmd, GtmToutConfiguration should be configured for Port assignment.
      container Atom: requires-index=true  # This container contains the ATOM Configuration for GTM
        container AtomChannel [8..8]: requires-index=true  # This container contains the ATOM AGC Channel configuration
          container AtomChannelOutput  # This container contains the ATOM Channel Output configuration
            boolean GTM_Atom_Negative_Support: origin=ChipowerTech, post-build-variant-value=true, set at post-build, default-value=false  # This parameter specifies the Atom negative module used or not.
            integer AtomId: 0..0, scope=ECU, origin=ChipowerTech, set at pre-compile, default-value=0  # Id of the ATOM Cluster.
            integer ChannelId: 0..7, scope=ECU, origin=ChipowerTech, set at pre-compile, default-value=0  # Id of the ATOM channel.
            enumeration AtomChannelNegativePortPinSelect: {ATOMXCHXX_NO_USED_ATOM_CHANNEL, ATOM0CH0N_TOUT054_SEL8_PORT21_PIN03, ATOM0CH0N_TOUT017_SEL8_PORT00_PIN08, ATOM0CH0N_TOUT007_SEL8_PORT02_PIN07, ATOM0CH1N_TOUT061_SELA_PORT20_PIN03, ATOM0CH1N_TOUT057_SELA_PORT21_PIN06, ATOM0CH1N_TOUT055_SEL8_PORT21_PIN04, ATOM0CH1N_TOUT004_SEL8_PORT02_PIN04, ATOM0CH1N_TOUT050_SELA_PORT22_PIN03, ATOM0CH1N_TOUT053_SEL8_PORT21_PIN02, ATOM0CH1N_TOUT014_SEL8_PORT00_PIN05, ATOM0CH2N_TOUT058_SEL8_PORT21_PIN07, ATOM0CH2N_TOUT065_SELA_PORT20_PIN09, ATOM0CH2N_TOUT005_SEL8_PORT02_PIN05, ATOM0CH2N_TOUT015_SEL8_PORT00_PIN06, ATOM0CH2N_TOUT056_SEL8_PORT21_PIN05, ATOM0CH2N_TOUT023_SELA_PORT33_PIN01, ATOM0CH3N_TOUT066_SELA_PORT20_PIN10, ATOM0CH3N_TOUT042_SELA_PORT23_PIN01, ATOM0CH3N_TOUT006_SEL8_PORT02_PIN06, ATOM0CH3N_TOUT024_SELA_PORT33_PIN02, ATOM0CH3N_TOUT059_SELA_PORT20_PIN00, ATOM0CH3N_TOUT016_SEL8_PORT00_PIN07, ATOM0CH4N_TOUT013_SEL8_PORT00_PIN04, ATOM0CH4N_TOUT003_SEL8_PORT02_PIN03, ATOM0CH5N_TOUT026_SELA_PORT33_PIN04, ATOM0CH5N_TOUT009_SEL8_PORT00_PIN00, ATOM0CH5N_TOUT008_SEL8_PORT02_PIN08, ATOM0CH5N_TOUT000_SEL8_PORT02_PIN00, ATOM0CH6N_TOUT027_SELA_PORT33_PIN05, ATOM0CH6N_TOUT001_SEL8_PORT02_PIN01, ATOM0CH6N_TOUT010_SEL8_PORT00_PIN01, ATOM0CH6N_TOUT011_SEL8_PORT00_PIN02, ATOM0CH7N_TOUT002_SEL8_PORT02_PIN02, ATOM0CH7N_TOUT012_SEL8_PORT00_PIN03, ATOM0CH7N_TOUT028_SELA_PORT33_PIN06}, origin=ChipowerTech, post-build-variant-value=true, set at post-build, default-value=ATOMXCHXX_NO_USED_ATOM_CHANNEL  # This decides the output port and pin for the ATOM Channel. This parameter is not applicable in case of configuration using bmd. While using Bmd, GtmToutConfiguration should be configured for Port assignment.
            enumeration AtomChannelPortPinSelect: {ATOMXCHXX_NO_USED_ATOM_CHANNEL, ATOM0CH00_TOUT085_SEL2_PORT14_PIN05, ATOM0CH00_TOUT053_SEL2_PORT21_PIN02, ATOM0CH00_TOUT000_SEL2_PORT02_PIN00, ATOM0CH00_TOUT008_SEL2_PORT02_PIN08, ATOM0CH00_TOUT048_SEL2_PORT22_PIN01, ATOM0CH00_TOUT009_SEL2_PORT00_PIN00, ATOM0CH01_TOUT031_SEL2_PORT33_PIN09, ATOM0CH01_TOUT084_SEL2_PORT14_PIN04, ATOM0CH01_TOUT001_SEL2_PORT02_PIN01, ATOM0CH01_TOUT010_SEL2_PORT00_PIN01, ATOM0CH01_TOUT054_SEL2_PORT21_PIN03, ATOM0CH01_TOUT011_SEL2_PORT00_PIN02, ATOM0CH01_TOUT047_SEL2_PORT22_PIN00, ATOM0CH02_TOUT055_SEL2_PORT21_PIN04, ATOM0CH02_TOUT012_SEL2_PORT00_PIN03, ATOM0CH02_TOUT002_SEL2_PORT02_PIN02, ATOM0CH02_TOUT042_SEL8_PORT23_PIN01, ATOM0CH02_TOUT033_SEL2_PORT33_PIN11, ATOM0CH02_TOUT083_SEL2_PORT14_PIN03, ATOM0CH03_TOUT003_SEL2_PORT02_PIN03, ATOM0CH03_TOUT013_SEL2_PORT00_PIN04, ATOM0CH03_TOUT049_SEL2_PORT22_PIN02, ATOM0CH03_TOUT056_SEL2_PORT21_PIN05, ATOM0CH03_TOUT082_SEL2_PORT14_PIN02, ATOM0CH04_TOUT057_SEL2_PORT21_PIN06, ATOM0CH04_TOUT061_SEL2_PORT20_PIN03, ATOM0CH04_TOUT014_SEL2_PORT00_PIN05, ATOM0CH04_TOUT081_SEL2_PORT14_PIN01, ATOM0CH04_TOUT050_SEL2_PORT22_PIN03, ATOM0CH04_TOUT004_SEL2_PORT02_PIN04, ATOM0CH04_TOUT029_SELA_PORT33_PIN07, ATOM0CH05_TOUT015_SEL2_PORT00_PIN06, ATOM0CH05_TOUT005_SEL2_PORT02_PIN05, ATOM0CH05_TOUT023_SEL2_PORT33_PIN01, ATOM0CH05_TOUT058_SEL2_PORT21_PIN07, ATOM0CH06_TOUT006_SEL2_PORT02_PIN06, ATOM0CH06_TOUT042_SEL2_PORT23_PIN01, ATOM0CH06_TOUT024_SEL2_PORT33_PIN02, ATOM0CH06_TOUT059_SEL2_PORT20_PIN00, ATOM0CH06_TOUT016_SEL2_PORT00_PIN07, ATOM0CH07_TOUT025_SEL2_PORT33_PIN03, ATOM0CH07_TOUT007_SEL2_PORT02_PIN07, ATOM0CH07_TOUT064_SEL2_PORT20_PIN08, ATOM0CH07_TOUT017_SEL2_PORT00_PIN08}, origin=ChipowerTech, post-build-variant-value=true, set at post-build, default-value=ATOMXCHXX_NO_USED_ATOM_CHANNEL  # This decides the output port and pin for the ATOM Channel. This parameter is not applicable in case of configuration using BMD. In such a case, GtmToutConfiguration should be used instead.
      container Tim [2..2]: requires-index=true  # This container contains the TIM Configuration for GTM
        container TimChannel [8..8]: requires-index=true  # This container contains the TIM Channel Configuration
          container TimChannelGeneral  # This container contains the TIM Channel General Configuration
            integer TimId: 0..1, scope=ECU, origin=ChipowerTech, set at pre-compile, default-value=0  # Id of the TIM Cluster.
            integer ChannelId: 0..7, scope=ECU, origin=ChipowerTech, set at pre-compile, default-value=0  # Id of the TIM channel.
            enumeration TimChannelPortPinSelect: {TIM_CHANNEL_IS_NOUSED_SEL00, TIM0_CH0_PORT00_PIN09_SEL01, TIM0_CH0_PORT02_PIN00_SEL02, TIM0_CH0_PORT10_PIN07_SEL03, TIM0_CH0_PORT14_PIN05_SEL04, TIM0_CH0_PORT14_PIN07_SEL05, TIM0_CH0_PORT15_PIN06_SEL06, TIM0_CH0_PORT21_PIN02_SEL07, TIM0_CH0_PORT22_PIN01_SEL08, TIM0_CH0_PORT33_PIN10_SEL09, TIM0_CH0_PORT33_PIN04_SEL10, TIM0_CH1_PORT02_PIN01_SEL02, TIM0_CH1_PORT10_PIN01_SEL03, TIM0_CH1_PORT14_PIN06_SEL04, TIM0_CH1_PORT15_PIN07_SEL05, TIM0_CH1_PORT21_PIN03_SEL06, TIM0_CH1_PORT22_PIN00_SEL07, TIM0_CH1_PORT33_PIN05_SEL08, TIM0_CH1_PORT33_PIN09_SEL09, TIM0_CH2_PORT02_PIN02_SEL02, TIM0_CH2_PORT10_PIN02_SEL03, TIM0_CH2_PORT10_PIN05_SEL04, TIM0_CH2_PORT15_PIN08_SEL05, TIM0_CH2_PORT21_PIN04_SEL06, TIM0_CH2_PORT23_PIN05_SEL07, TIM0_CH2_PORT33_PIN11_SEL08, TIM0_CH2_PORT33_PIN06_SEL09, TIM0_CH3_PORT00_PIN12_SEL01, TIM0_CH3_PORT02_PIN03_SEL02, TIM0_CH3_PORT10_PIN03_SEL03, TIM0_CH3_PORT10_PIN06_SEL04, TIM0_CH3_PORT14_PIN00_SEL05, TIM0_CH3_PORT21_PIN05_SEL06, TIM0_CH3_PORT22_PIN02_SEL07, TIM0_CH3_PORT33_PIN07_SEL09, TIM0_CH4_PORT02_PIN04_SEL01, TIM0_CH4_PORT10_PIN00_SEL02, TIM0_CH4_PORT14_PIN01_SEL03, TIM0_CH4_PORT22_PIN03_SEL04, TIM0_CH4_PORT33_PIN00_SEL06, TIM0_CH4_PORT33_PIN08_SEL07, TIM0_CH4_PORT21_PIN06_SEL08, TIM0_CH5_PORT02_PIN05_SEL01, TIM0_CH5_PORT10_PIN08_SEL02, TIM0_CH5_PORT14_PIN02_SEL03, TIM0_CH5_PORT33_PIN01_SEL06, TIM0_CH5_PORT21_PIN07_SEL07, TIM0_CH6_PORT02_PIN06_SEL01, TIM0_CH6_PORT10_PIN04_SEL02, TIM0_CH6_PORT14_PIN03_SEL03, TIM0_CH6_PORT23_PIN01_SEL04, TIM0_CH6_PORT33_PIN02_SEL06, TIM0_CH6_PORT20_PIN00_SEL07, TIM0_CH7_PORT02_PIN07_SEL01, TIM0_CH7_PORT14_PIN04_SEL02, TIM0_CH7_PORT20_PIN08_SEL03, TIM0_CH7_PORT33_PIN03_SEL06, TIM0_CH7_PORT11_PIN15_SEL08, TIM1_CH0_PORT00_PIN09_SEL01, TIM1_CH0_PORT02_PIN00_SEL02, TIM1_CH0_PORT10_PIN07_SEL03, TIM1_CH0_PORT14_PIN05_SEL04, TIM1_CH0_PORT14_PIN07_SEL05, TIM1_CH0_PORT15_PIN06_SEL06, TIM1_CH0_PORT21_PIN02_SEL07, TIM1_CH0_PORT22_PIN01_SEL08, TIM1_CH0_PORT33_PIN10_SEL09, TIM1_CH0_PORT33_PIN04_SEL10, TIM1_CH1_PORT02_PIN01_SEL02, TIM1_CH1_PORT10_PIN01_SEL03, TIM1_CH1_PORT14_PIN06_SEL04, TIM1_CH1_PORT15_PIN07_SEL05, TIM1_CH1_PORT21_PIN03_SEL06, TIM1_CH1_PORT22_PIN00_SEL07, TIM1_CH1_PORT33_PIN05_SEL08, TIM1_CH1_PORT33_PIN09_SEL09, TIM1_CH2_PORT02_PIN02_SEL02, TIM1_CH2_PORT10_PIN02_SEL03, TIM1_CH2_PORT10_PIN05_SEL04, TIM1_CH2_PORT15_PIN08_SEL05, TIM1_CH2_PORT21_PIN04_SEL06, TIM1_CH2_PORT23_PIN05_SEL07, TIM1_CH2_PORT33_PIN11_SEL08, TIM1_CH2_PORT33_PIN06_SEL09, TIM1_CH3_PORT00_PIN12_SEL01, TIM1_CH3_PORT02_PIN03_SEL02, TIM1_CH3_PORT10_PIN03_SEL03, TIM1_CH3_PORT10_PIN06_SEL04, TIM1_CH3_PORT14_PIN00_SEL05, TIM1_CH3_PORT21_PIN05_SEL06, TIM1_CH3_PORT22_PIN02_SEL07, TIM1_CH3_PORT33_PIN07_SEL09, TIM1_CH4_PORT02_PIN04_SEL01, TIM1_CH4_PORT10_PIN00_SEL02, TIM1_CH4_PORT14_PIN01_SEL03, TIM1_CH4_PORT22_PIN03_SEL04, TIM1_CH4_PORT33_PIN00_SEL06, TIM1_CH4_PORT33_PIN08_SEL07, TIM1_CH4_PORT21_PIN06_SEL08, TIM1_CH4_PORT20_PIN00_SEL09, TIM1_CH5_PORT02_PIN05_SEL01, TIM1_CH5_PORT10_PIN08_SEL02, TIM1_CH5_PORT14_PIN02_SEL03, TIM1_CH5_PORT33_PIN01_SEL06, TIM1_CH5_PORT21_PIN07_SEL07, TIM1_CH5_PORT20_PIN07_SEL08, TIM1_CH6_PORT02_PIN06_SEL01, TIM1_CH6_PORT10_PIN04_SEL02, TIM1_CH6_PORT14_PIN03_SEL03, TIM1_CH6_PORT23_PIN01_SEL04, TIM1_CH6_PORT33_PIN02_SEL06, TIM1_CH6_PORT20_PIN00_SEL07, TIM1_CH7_PORT02_PIN07_SEL01, TIM1_CH7_PORT14_PIN04_SEL02, TIM1_CH7_PORT20_PIN08_SEL03, TIM1_CH7_PORT23_PIN03_SEL04, TIM1_CH7_PORT33_PIN03_SEL06}, origin=ChipowerTech, post-build-variant-value=true, set at post-build, default-value=TIM_CHANNEL_IS_NOUSED_SEL00  # This decides the input port and pin of the TIM Channel. This value is applicable for this channel only if TimChannelInputSelect is configured as 'INPUT_OF_CURRENT_TIM_CHANNEL'
      container GtmToPeripheral: multiplicity set at post-build  # This container defines the Connections between GTM and Peripheral Modules
        container SaradcSent [48..48]: requires-index=true  # This Specifies the TOM/ATOM channels that can be used as ADC/SENT Triggers
          integer ChannelId: 0..11, scope=ECU, origin=ChipowerTech, set at pre-compile, default-value=0  # Id of the Gtm to ADC or SENT Module ID, Only TRIXCHY_* (X:0 , Y:0~11) is used by Sent. THA6206: channelId0:Sent/SarAdc0 channelId1:Sent/SarAdc1 channelId2:Sent/SarAdc2 channelId3:Sent/SarAdc3 channelId4:Sent channelId5:Sent channelId6:Sent channelId7:Sent channelId8:Sent/SarAdc8 channelId9:Sent/SarAdc9 channelId10:Sent channelId11:Sent THA6412: channelId0:Sent/SarAdc0 channelId1:Sent/SarAdc1 channelId2:Sent/SarAdc2 channelId3:Sent/SarAdc3 channelId4:Sent/SarAdc4 channelId5:Sent/SarAdc5 channelId6:Sent/SarAdc6 channelId7:Sent/SarAdc7 channelId8:Sent/SarAdc8 channelId9:Sent/SarAdc9 channelId10:Sent/SarAdc10 channelId11:Sent/SarAdc11
          enumeration GtmTriggerSelect: {TRIXCHXX_NO_TRIGGER_SELX_CH00, TRI0CH00_TOM00_CH06_SEL0_CH01, TRI0CH00_TOM00_CH07_SEL0_CH02, TRI0CH00_TOM00_CH13_SEL0_CH03, TRI0CH00_TOM00_CH14_SEL0_CH04, TRI0CH00_ATOM0_CH04_SEL0_CH05, TRI0CH00_ATOM0_CH05_SEL0_CH06, TRI0CH00_ATOM0_CH06_SEL0_CH07, TRI0CH00_ATOM0_CH07_SEL0_CH08, TRI1CH00_TOM01_CH06_SEL0_CH01, TRI1CH00_TOM01_CH07_SEL0_CH02, TRI1CH00_TOM01_CH13_SEL0_CH03, TRI1CH00_TOM01_CH14_SEL0_CH04, TRI1CH00_TOM00_CH14_SEL0_CH09, TRI1CH00_TOM00_CH15_SEL0_CH10, TRI1CH00_ATOM0_CH04_SEL0_CH11, TRI1CH00_ATOM0_CH05_SEL0_CH12, TRI1CH00_ATOM0_CH06_SEL0_CH13, TRI1CH00_ATOM0_CH07_SEL0_CH14, TRI2CH00_TOM00_CH03_SEL0_CH01, TRI2CH00_TOM00_CH04_SEL0_CH02, TRI2CH00_TOM0_CH05N_SEL0_CH03, TRI2CH00_TOM0_CH06N_SEL0_CH04, TRI2CH00_TOM00_CH07_SEL0_CH05, TRI2CH00_TOM00_CH11_SEL0_CH06, TRI2CH00_TOM00_CH15_SEL0_CH07, TRI2CH00_TOM01_CH03_SEL0_CH08, TRI2CH00_TOM01_CH04_SEL0_CH09, TRI2CH00_TOM1_CH05N_SEL0_CH10, TRI2CH00_TOM1_CH06N_SEL0_CH11, TRI2CH00_TOM01_CH07_SEL0_CH12, TRI2CH00_TOM01_CH11_SEL0_CH13, TRI2CH00_TOM01_CH15_SEL0_CH14, TRI3CH00_ATOM0_CH03_SEL0_CH01, TRI3CH00_ATOM0_CH5N_SEL0_CH02, TRI0CH01_TOM00_CH06_SEL1_CH01, TRI0CH01_TOM00_CH07_SEL1_CH02, TRI0CH01_TOM00_CH13_SEL1_CH03, TRI0CH01_TOM00_CH14_SEL1_CH04, TRI0CH01_ATOM0_CH04_SEL1_CH05, TRI0CH01_ATOM0_CH05_SEL1_CH06, TRI0CH01_ATOM0_CH06_SEL1_CH07, TRI0CH01_ATOM0_CH07_SEL1_CH08, TRI1CH01_TOM01_CH06_SEL1_CH01, TRI1CH01_TOM01_CH07_SEL1_CH02, TRI1CH01_TOM01_CH13_SEL1_CH03, TRI1CH01_TOM01_CH14_SEL1_CH04, TRI1CH01_TOM00_CH14_SEL1_CH09, TRI1CH01_TOM00_CH15_SEL1_CH10, TRI1CH01_ATOM0_CH04_SEL1_CH11, TRI1CH01_ATOM0_CH05_SEL1_CH12, TRI1CH01_ATOM0_CH06_SEL1_CH13, TRI1CH01_ATOM0_CH07_SEL1_CH14, TRI2CH01_TOM00_CH03_SEL1_CH01, TRI2CH01_TOM00_CH04_SEL1_CH02, TRI2CH01_TOM0_CH05N_SEL1_CH03, TRI2CH01_TOM0_CH06N_SEL1_CH04, TRI2CH01_TOM00_CH07_SEL1_CH05, TRI2CH01_TOM00_CH11_SEL1_CH06, TRI2CH01_TOM00_CH15_SEL1_CH07, TRI2CH01_TOM01_CH03_SEL1_CH08, TRI2CH01_TOM01_CH04_SEL1_CH09, TRI2CH01_TOM1_CH05N_SEL1_CH10, TRI2CH01_TOM1_CH06N_SEL1_CH11, TRI2CH01_TOM01_CH07_SEL1_CH12, TRI2CH01_TOM01_CH11_SEL1_CH13, TRI2CH01_TOM01_CH15_SEL1_CH14, TRI3CH01_ATOM0_CH03_SEL1_CH01, TRI3CH01_ATOM0_CH5N_SEL1_CH02, TRI0CH02_TOM00_CH06_SEL2_CH01, TRI0CH02_TOM00_CH07_SEL2_CH02, TRI0CH02_TOM00_CH13_SEL2_CH03, TRI0CH02_TOM00_CH14_SEL2_CH04, TRI0CH02_ATOM0_CH04_SEL2_CH05, TRI0CH02_ATOM0_CH05_SEL2_CH06, TRI0CH02_ATOM0_CH06_SEL2_CH07, TRI0CH02_ATOM0_CH07_SEL2_CH08, TRI1CH02_TOM01_CH06_SEL2_CH01, TRI1CH02_TOM01_CH07_SEL2_CH02, TRI1CH02_TOM01_CH13_SEL2_CH03, TRI1CH02_TOM01_CH14_SEL2_CH04, TRI1CH02_TOM00_CH14_SEL2_CH09, TRI1CH02_TOM00_CH15_SEL2_CH10, TRI1CH02_ATOM0_CH04_SEL2_CH11, TRI1CH02_ATOM0_CH05_SEL2_CH12, TRI1CH02_ATOM0_CH06_SEL2_CH13, TRI1CH02_ATOM0_CH07_SEL2_CH14, TRI2CH02_TOM00_CH03_SEL2_CH01, TRI2CH02_TOM00_CH04_SEL2_CH02, TRI2CH02_TOM0_CH05N_SEL2_CH03, TRI2CH02_TOM0_CH06N_SEL2_CH04, TRI2CH02_TOM00_CH07_SEL2_CH05, TRI2CH02_TOM00_CH11_SEL2_CH06, TRI2CH02_TOM00_CH15_SEL2_CH07, TRI2CH02_TOM01_CH03_SEL2_CH08, TRI2CH02_TOM01_CH04_SEL2_CH09, TRI2CH02_TOM1_CH05N_SEL2_CH10, TRI2CH02_TOM1_CH06N_SEL2_CH11, TRI2CH02_TOM01_CH07_SEL2_CH12, TRI2CH02_TOM01_CH11_SEL2_CH13, TRI2CH02_TOM01_CH15_SEL2_CH14, TRI3CH02_ATOM0_CH03_SEL2_CH01, TRI3CH02_ATOM0_CH5N_SEL2_CH02, TRI0CH03_TOM00_CH06_SEL3_CH01, TRI0CH03_TOM00_CH07_SEL3_CH02, TRI0CH03_TOM00_CH13_SEL3_CH03, TRI0CH03_TOM00_CH14_SEL3_CH04, TRI0CH03_ATOM0_CH04_SEL3_CH05, TRI0CH03_ATOM0_CH05_SEL3_CH06, TRI0CH03_ATOM0_CH06_SEL3_CH07, TRI0CH03_ATOM0_CH07_SEL3_CH08, TRI0CH03_TOM01_CH06_SEL3_CH09, TRI0CH03_TOM01_CH07_SEL3_CH10, TRI1CH03_TOM01_CH06_SEL3_CH01, TRI1CH03_TOM01_CH07_SEL3_CH02, TRI1CH03_TOM01_CH13_SEL3_CH03, TRI1CH03_TOM01_CH14_SEL3_CH04, TRI1CH03_TOM01_CH14_SEL3_CH09, TRI1CH03_TOM01_CH15_SEL3_CH10, TRI2CH03_TOM00_CH03_SEL3_CH01, TRI2CH03_TOM00_CH04_SEL3_CH02, TRI2CH03_TOM0_CH05N_SEL3_CH03, TRI2CH03_TOM0_CH06N_SEL3_CH04, TRI2CH03_TOM00_CH07_SEL3_CH05, TRI2CH03_TOM00_CH11_SEL3_CH06, TRI2CH03_TOM00_CH15_SEL3_CH07, TRI2CH03_TOM01_CH03_SEL3_CH08, TRI2CH03_TOM01_CH04_SEL3_CH09, TRI2CH03_TOM1_CH05N_SEL3_CH10, TRI2CH03_TOM1_CH06N_SEL3_CH11, TRI2CH03_TOM01_CH07_SEL3_CH12, TRI2CH03_TOM01_CH11_SEL3_CH13, TRI2CH03_TOM01_CH15_SEL3_CH14, TRI3CH03_ATOM0_CH03_SEL3_CH01, TRI3CH03_ATOM0_CH5N_SEL3_CH02, TRI0CH04_TOM00_CH06_SEL4_CH01, TRI0CH04_TOM00_CH07_SEL4_CH02, TRI0CH04_TOM00_CH13_SEL4_CH03, TRI0CH04_TOM00_CH14_SEL4_CH04, TRI0CH04_ATOM0_CH04_SEL4_CH05, TRI0CH04_ATOM0_CH05_SEL4_CH06, TRI0CH04_ATOM0_CH06_SEL4_CH07, TRI0CH04_ATOM0_CH07_SEL4_CH08, TRI0CH04_TOM01_CH06_SEL4_CH09, TRI0CH04_TOM01_CH07_SEL4_CH10, TRI0CH05_TOM00_CH13_SEL5_CH03, TRI0CH05_TOM00_CH14_SEL5_CH04, TRI0CH05_TOM00_CH06_SEL5_CH09, TRI0CH05_TOM00_CH07_SEL5_CH10, TRI0CH05_ATOM0_CH04_SEL5_CH11, TRI0CH05_ATOM0_CH05_SEL5_CH12, TRI0CH05_ATOM0_CH06_SEL5_CH13, TRI0CH05_ATOM0_CH07_SEL5_CH14, TRI0CH06_TOM00_CH13_SEL6_CH03, TRI0CH06_TOM00_CH14_SEL6_CH04, TRI0CH06_TOM00_CH06_SEL6_CH09, TRI0CH06_TOM00_CH07_SEL6_CH10, TRI0CH06_ATOM0_CH04_SEL6_CH11, TRI0CH06_ATOM0_CH05_SEL6_CH12, TRI0CH06_ATOM0_CH06_SEL6_CH13, TRI0CH06_ATOM0_CH07_SEL6_CH14, TRI0CH07_TOM00_CH13_SEL7_CH03, TRI0CH07_TOM00_CH14_SEL7_CH04, TRI0CH07_TOM00_CH06_SEL7_CH09, TRI0CH07_TOM00_CH07_SEL7_CH10, TRI0CH07_ATOM0_CH04_SEL7_CH11, TRI0CH07_ATOM0_CH05_SEL7_CH12, TRI0CH07_ATOM0_CH06_SEL7_CH13, TRI0CH07_ATOM0_CH07_SEL7_CH14, TRI0CH08_TOM00_CH06_SEL8_CH01, TRI0CH08_TOM00_CH07_SEL8_CH02, TRI0CH08_TOM00_CH13_SEL8_CH03, TRI0CH08_TOM00_CH14_SEL8_CH04, TRI0CH08_ATOM0_CH04_SEL8_CH05, TRI0CH08_ATOM0_CH05_SEL8_CH06, TRI0CH08_ATOM0_CH06_SEL8_CH07, TRI0CH08_ATOM0_CH07_SEL8_CH08, TRI0CH08_TOM00_CH06_SEL8_CH09, TRI0CH08_TOM00_CH07_SEL8_CH10, TRI0CH08_TOM00_CH15_SEL8_CH15, TRI0CH09_TOM00_CH06_SEL9_CH01, TRI0CH09_TOM00_CH07_SEL9_CH02, TRI0CH09_TOM00_CH13_SEL9_CH03, TRI0CH09_TOM00_CH14_SEL9_CH04, TRI0CH09_ATOM0_CH04_SEL9_CH05, TRI0CH09_ATOM0_CH05_SEL9_CH06, TRI0CH09_ATOM0_CH06_SEL9_CH07, TRI0CH09_ATOM0_CH07_SEL9_CH08, TRI0CH09_TOM00_CH06_SEL9_CH09, TRI0CH09_TOM00_CH07_SEL9_CH10, TRI0CH09_TOM00_CH15_SEL9_CH15, TRI0CH10_TOM00_CH06_SELA_CH01, TRI0CH10_TOM00_CH07_SELA_CH02, TRI0CH10_TOM00_CH13_SELA_CH03, TRI0CH10_TOM00_CH14_SELA_CH04, TRI0CH10_ATOM0_CH04_SELA_CH05, TRI0CH10_ATOM0_CH05_SELA_CH06, TRI0CH10_ATOM0_CH06_SELA_CH07, TRI0CH10_ATOM0_CH07_SELA_CH08, TRI0CH10_TOM00_CH06_SELA_CH09, TRI0CH10_TOM00_CH07_SELA_CH10, TRI0CH10_TOM00_CH15_SELA_CH15, TRI0CH11_TOM00_CH06_SELB_CH01, TRI0CH11_TOM00_CH07_SELB_CH02, TRI0CH11_TOM00_CH13_SELB_CH03, TRI0CH11_TOM00_CH14_SELB_CH04, TRI0CH11_ATOM0_CH04_SELB_CH05, TRI0CH11_ATOM0_CH05_SELB_CH06, TRI0CH11_ATOM0_CH06_SELB_CH07, TRI0CH11_ATOM0_CH07_SELB_CH08, TRI0CH11_TOM00_CH06_SELB_CH09, TRI0CH11_TOM00_CH07_SELB_CH10, TRI0CH11_TOM00_CH15_SELB_CH15}, origin=ChipowerTech, post-build-variant-value=true, set at post-build, default-value=TRIXCHXX_NO_TRIGGER_SELX_CH00  # This Specifies the TOM/ATOM channel that will be used as GTM Trigger. This configuration is to set GTM_ADCTRGxOUTy
        container Dsadc [0..0]: requires-index=true  # This Specifies the TOM/ATOM channels that can be used as DSADC Triggers
          integer ChannelId: 0..255, scope=ECU, origin=ChipowerTech, set at pre-compile, default-value=0  # Id of the DSADC channel.
          enumeration GtmTriggerSelect: {TRIXCHXX_NO_TRIGGER_SELX_CH0F}, origin=ChipowerTech, post-build-variant-value=true, set at post-build, default-value=TRIXCHXX_NO_TRIGGER_SELX_CH0F  # This Specifies the TOM/ATOM channel that will be used as GTM Trigger for dsadc. This configuration is to set DSADCOUTMUX*
        container Msc [0..0]: requires-index=true  # This container contains the General Configuration for Msc
          integer HwId: 0..255, scope=ECU, origin=ChipowerTech, set at pre-compile, default-value=0  # Id of the MSC.
          container MscDataBit [0..0]: requires-index=true  # This Specifies the Set channels that can be used as input of MSC
            integer BitId: 0..255, scope=ECU, origin=ChipowerTech, set at pre-compile, default-value=0  # Id of the MSC level2 Set channel.
            enumeration MscDataBitLowConfiguration: {SETX_NO_USED}, origin=ChipowerTech, post-build-variant-value=true, set at post-build, default-value=SETX_NO_USED  # This Specifies the Setx channels that can be used as input of MSC
            enumeration MscDataBitHighConfiguration: {SETX_NO_USED}, origin=ChipowerTech, post-build-variant-value=true, set at post-build, default-value=SETX_NO_USED  # This Specifies the Setx channels that can be used as input of MSC
        container Dma [8..8]: requires-index=true  # This Specifies the TOM/ATOM channels that can be used as tirgger of DMA
          integer DmaRequestId: 0..7, scope=ECU, origin=ChipowerTech, set at pre-compile, default-value=0  # Id of the GtmToDma Register id.
          enumeration TriggerSource: {MUXN_63_NO_DMA_TRIGGER, MUX0_00_GTM_TIM00_IRQ0, MUX0_01_GTM_TIM00_IRQ1, MUX0_02_GTM_TIM00_IRQ2, MUX0_03_GTM_TIM00_IRQ3, MUX0_04_GTM_TIM00_IRQ4, MUX0_05_GTM_TIM00_IRQ5, MUX0_06_GTM_TIM00_IRQ6, MUX0_07_GTM_TIM00_IRQ7, MUX0_08_GTM_TOM00_IRQ0, MUX0_09_GTM_TOM00_IRQ1, MUX0_10_GTM_TOM00_IRQ2, MUX0_11_GTM_TOM00_IRQ3, MUX0_12_GTM_TOM00_IRQ4, MUX0_13_GTM_TOM00_IRQ5, MUX0_14_GTM_TOM00_IRQ6, MUX0_15_GTM_TOM00_IRQ7, MUX0_16_GTM_ATOM0_IRQ0, MUX0_17_GTM_ATOM0_IRQ1, MUX0_18_GTM_ATOM0_IRQ2, MUX0_19_GTM_ATOM0_IRQ3, MUX1_00_GTM_TIM01_IRQ0, MUX1_01_GTM_TIM01_IRQ1, MUX1_02_GTM_TIM01_IRQ2, MUX1_03_GTM_TIM01_IRQ3, MUX1_04_GTM_TIM01_IRQ4, MUX1_05_GTM_TIM01_IRQ5, MUX1_06_GTM_TIM01_IRQ6, MUX1_07_GTM_TIM01_IRQ7, MUX1_08_GTM_TOM01_IRQ0, MUX1_09_GTM_TOM01_IRQ1, MUX1_10_GTM_TOM01_IRQ2, MUX1_11_GTM_TOM01_IRQ3, MUX1_12_GTM_TOM01_IRQ4, MUX1_13_GTM_TOM01_IRQ5, MUX1_14_GTM_TOM01_IRQ6, MUX1_15_GTM_TOM01_IRQ7}, origin=ChipowerTech, post-build-variant-value=true, set at post-build, default-value=MUXN_63_NO_DMA_TRIGGER  # This Specifies the TOM/ATOM channel that will be used as input of DmaRequest.
        container GtmOutput [0.0..40]: multiplicity set at post-build, post-build-variant-multiplicity=true, requires-index=true  # This container contains the configuration (parameters) in case the Trigger SIGNALS.
          enumeration GtmTimerClockSelect: {CMUFXCLK0, CMUFXCLK1, CMUFXCLK2, CMUFXCLK3, CMUFXCLK4}, origin=ChipowerTech, post-build-variant-value=true, set at post-build, default-value=CMUFXCLK0  # This parameter decides the Clock Source for TOM/ATOM timer.For ATOM channel the available clocksrcs are CMU_CLK0,CMU_CLK1,CMU_CLK2,CMU_CLK3,CMU_CLK4,CMU_CLK5,CMU_CLK6,CMU_CLK7. For TOM channel the available clocksrcs are CMUFXCLK0 (CMU_FXCLK) CMUFXCLK1 (CMU_FXCLK/16) CMUFXCLK2 (CMU_FXCLK/256) CMUFXCLK3 (CMU_FXCLK/4096) CMUFXCLK4 (CMU_FXCLK/65536)
          integer GtmTimerTimePeriod: 0..65536000, origin=ChipowerTech, post-build-variant-value=true, set at post-build, default-value=20000  # This parameter is used for selecting the time period of the GTM timer in micro seconds.
          integer GtmTimerCM0Ticks: 0..16777215, origin=ChipowerTech, post-build-variant-value=true, set at post-build, default-value=0  # This parameter specifies the Period Compare value (CM0) for the TOM/ATOM Channel in ticks. Only valid if GtmTimerTimePeriod is 0.
          choice reference GtmTimerUsed: scope=ECU, origin=ChipowerTech, post-build-variant-value=true, set at post-build, destination=[GtmAtomChannel, GtmTomChannel]  # This parameter lists all the GTM timer channels (TOM/ATOM).
          reference GtmMcuClockReference: origin=ChipowerTech, post-build-variant-value=true, set at post-build, destination=CmuClockReferencePoint  # This parameter defines GTM ATOM/TOM channle clock(hz) This parameter is reference from MCU GTM Cmu clock, configure clock first in MCU Container
      container GtmResourceAllocationConf: multiplicity set at post-build  # This container is used to represent the usage of GTM resources by other modules. Users can allocate GTM resources to individual modules. No error is reported when not configured.
        container GtmTim [2..2]: requires-index=true  # This container contains the TIM Configuration for GTM
          container GtmTimChannel [8..8]: requires-index=true  # This container contains the TIM Channel Configuration
            integer ModuleId: 0..1, scope=ECU, origin=ChipowerTech, set at pre-compile, default-value=0  # Id of the TIM Cluster.
            integer ChannelId: 0..7, scope=ECU, origin=ChipowerTech, set at pre-compile, default-value=0  # Id of the TIM channel.
            enumeration GtmTimChannel: {GTM_TIM_CHANNEL_NOT_USED, GTM_TIM_CHANNEL_USED_BY_ICU}, origin=ChipowerTech, post-build-variant-value=true, set at post-build, default-value=GTM_TIM_CHANNEL_NOT_USED  # This decides as to if this Channel is used for ICU or not be used. GTM_TIM_CHANNEL_NOT_USED: Specifies that this Channel is not configured by any module (unused). GTM_TIM_CHANNEL_USED_BY_ICU: Specifies that this Channel is configured by ICU module.
        container GtmTom [2..2]: requires-index=true  # This container contains the TOM Configuration for GTM
          container GtmTomChannel [16..16]: requires-index=true  # This container contains the TOM Channel Configuration
            integer ModuleId: 0..1, scope=ECU, origin=ChipowerTech, set at pre-compile, default-value=0  # Id of the TOM Cluster.
            integer ChannelId: 0..15, scope=ECU, origin=ChipowerTech, set at pre-compile, default-value=0  # Id of the TOM channel.
            enumeration GtmTomChannel: {GTM_TOM_CHANNEL_NOT_USED, GTM_TOM_CHANNEL_USED_BY_MCU, GTM_TOM_CHANNEL_USED_BY_PWM, GTM_TOM_CHANNEL_USED_BY_GPT}, origin=ChipowerTech, post-build-variant-value=true, set at post-build, default-value=GTM_TOM_CHANNEL_NOT_USED  # This decides as to if this Channel is used or will it not be used. GTM_TOM_CHANNEL_NOT_USED: Specifies that this Channel is not configured by any module (unused). GTM_TOM_CHANNEL_USED_BY_MCU: Specifies that this Channel is configured by GTM MCU module. GTM_TOM_CHANNEL_USED_BY_PWM: Specifies that this Channel is configured by PWM module. GTM_TOM_CHANNEL_USED_BY_GPT: Specifies that this Channel is configured by GPT module.
        container GtmAtom: requires-index=true  # This container contains the ATOM Configuration for GTM
          container GtmAtomChannel [8..8]: requires-index=true  # This container contains the ATOM Channel Configuration
            integer ModuleId: 0..0, scope=ECU, origin=ChipowerTech, set at pre-compile, default-value=0  # Id of the ATOM Cluster.
            integer ChannelId: 0..7, scope=ECU, origin=ChipowerTech, set at pre-compile, default-value=0  # Id of the ATOM channel.
            enumeration GtmAtomChannel: {GTM_ATOM_CHANNEL_NOT_USED, GTM_ATOM_CHANNEL_USED_BY_MCU, GTM_ATOM_CHANNEL_USED_BY_GPT, GTM_ATOM_CHANNEL_USED_BY_PWM, GTM_ATOM_CHANNEL_USED_BY_OCU}, origin=ChipowerTech, post-build-variant-value=true, set at post-build, default-value=GTM_ATOM_CHANNEL_NOT_USED  # This decides as to if this Channel is used or will it not be used. GTM_ATOM_CHANNEL_NOT_USED: Specifies that this Channel is not configured by any module (unused). GTM_ATOM_CHANNEL_USED_BY_MCU: Specifies that this Channel is configured by MCU module. GTM_ATOM_CHANNEL_USED_BY_GPT: Specifies that this Channel is configured by GPT module. GTM_ATOM_CHANNEL_USED_BY_OCU: Specifies that this Channel is configured by OCU module. GTM_ATOM_CHANNEL_USED_BY_PWM: Specifies that this Channel is configured by PWM module.
    container CommonPublishedInformation  # Common container, aggregated by all modules. It contains published information about vendor and versions.
      integer ArReleaseMajorVersion: 4..4, origin=ChipowerTech, set at published-information, default-value=4  # Major version number of AUTOSAR specification on which the appropriate implementation is based on.
      integer ArReleaseMinorVersion: 2..4, origin=ChipowerTech, set at published-information, default-value=4  # Minor version number of AUTOSAR specification on which the appropriate implementation is based on.
      integer ArReleaseRevisionVersion: 0..2, origin=ChipowerTech, set at published-information, default-value=0  # Revision version number of AUTOSAR specification on which the appropriate implementation is based on.
      integer ModuleId: 101..101, origin=ChipowerTech, set at published-information, default-value=101  # Module ID of this module from Module List. Note: Implementation Specific Parameter
      integer SwMajorVersion: 0..255, origin=ChipowerTech, set at published-information, default-value=1  # Major version number of the vendor specific implementation of the module. The numbering is vendor specific. Note: Implementation Specific Parameter
      integer SwMinorVersion: 0..255, origin=ChipowerTech, set at published-information, default-value=0  # Minor version number of the vendor specific implementation of the module. The numbering is vendor specific. Note: Implementation Specific Parameter
      integer SwPatchVersion: 0..255, origin=ChipowerTech, set at published-information, default-value=0  # Patch level version number of the vendor specific implementation of the module. The numbering is vendor specific. Note: Implementation Specific Parameter
      integer VendorId: 175..175, origin=ChipowerTech, set at published-information, default-value=175  # Vendor ID of the dedicated implementation of this module according to the AUTOSAR vendor list. Note: Implementation Specific Parameter
