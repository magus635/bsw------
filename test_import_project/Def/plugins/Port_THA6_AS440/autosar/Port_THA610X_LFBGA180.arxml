AUTOSAR XML (schema 00046)
package /THA6_AS440_FuSa
  ecuc definition collection Port_EcuParameterDefinition: module=Port
  module definition Port [0..1]: post-build-variant-support=true, refined-module-def=Port, variants post-build  # Configuration of the Port module.
    container PortConfigSet  # ECUC_Port_00121: This container contains the configuration parameters and sub containers of the AUTOSAR Port module.
      container PortContainer [16..16]: requires-index=true  # ECUC_Port_00122: Container collecting the PortPins.
        integer PortNumber: 0..41, origin=ChipowerTech, set at pre-compile, default-value=0  # The number of specified Ports in this PortContainer.
        integer PortNumberOfPortPins: 1..65535, set at pre-compile, default-value=13  # ECUC_Port_00124: The number of specified PortPins in this PortContainer.
        container PortPin [1..16]: multiplicity set at pre-compile, requires-index=true  # ECUC_Port_00118: Configuration of the individual port pins.
          string PortPinSymbolicName: origin=ChipowerTech, set at pre-compile, default-value=P0.0  # Symbolic name of the Port Pin.
          boolean PortPinEnable: origin=ChipowerTech, set at pre-compile, default-value=false  # Enable configuration options under the current PortContainer. true: The current Port-Pin uses the configuration under PortContainer. false: The current Port-Pin uses the default configuration of driver. Port-Pin Default configuration: PortPinDirection = PORT_PIN_IN. PortPinPadLeve = PORT_PDR_AL_AUTOMOTIVE_LEVEL. PortPinPullMode = PORT_INPUTMODE_PULLUP. PortPinPadTriggerMode = PORT_SCHMIDT_LEVEL_MODE. RxMuxFunSelect = GPIO.
          integer PortPinId: 0..65535, set at pre-compile, symbolic-name-value=true, default-value=0  # ECUC_Port_00127: Port-Pin ID, This value will be assigned to the symbolic name derived from the port pin container short name.PortPinId = Port_Number * 16 + Pin_Number
          enumeration PortPinDirection: {PORT_PIN_IN, PORT_PIN_OUT, PORT_PIN_INOUT}, post-build-variant-value=true, set at post-build, default-value=PORT_PIN_IN  # ECUC_Port_00125: The initial direction of the pin (IN or OUT). If the direction is not changeable, the value configured here is fixed.The direction must match the pin mode. E.g. a pin used for an ADC must be configured to be an in port. Implementation Type: Port_PinDirectionType
          enumeration PortPinInitialMode: {ASI0_ATX, ASI10_ATX, ASI11_ATX, ASI1_ATX, ASI2_ATX, ASI3_ATX, ASI4_ATX, ASI5_ATX, ASI6_ATX, ASI7_ATX, ASI8_ATX, ASI9_ATX, CAN00_TXD, CAN01_TXD, CAN02_TXD, CAN10_TXD, CAN11_TXD, CAN12_TXD, ESPI0_MRST, ESPI0_MTSR, ESPI0_SCLK, ESPI0_SLSO0, ESPI0_SLSO1, ESPI0_SLSO13, ESPI0_SLSO2, ESPI0_SLSO3, ESPI0_SLSO4, ESPI0_SLSO5, ESPI0_SLSO6, ESPI0_SLSO7, ESPI0_SLSO8, ESPI0_SLSO9, ESPI1_MRST, ESPI1_MTSR, ESPI1_SCLK, ESPI1_SLSO0, ESPI1_SLSO1, ESPI1_SLSO2, ESPI1_SLSO3, ESPI1_SLSO4, ESPI1_SLSO5, ESPI1_SLSO6, ESPI1_SLSO7, ESPI1_SLSO9, ESPI2_MRST, ESPI2_MTSR, ESPI2_SCLK, ESPI2_SLSO0, ESPI2_SLSO1, ESPI2_SLSO10, ESPI2_SLSO11, ESPI2_SLSO12, ESPI2_SLSO2, ESPI2_SLSO3, ESPI2_SLSO5, ESPI2_SLSO7, ESPI2_SLSO8, ESPI2_SLSO9, ESPI3_MRST, ESPI3_MTSR, ESPI3_SCLK, ESPI3_SLSO0, ESPI3_SLSO1, ESPI3_SLSO12, ESPI3_SLSO2, ESPI3_SLSO3, ESPI3_SLSO4, ESPI3_SLSO5, ESPI3_SLSO6, ESPI3_SLSO7, ESPI3_SLSO8, ESPI4_MRST, ESPI4_MTSR, ESPI4_SCLK, ESPI4_SLSO0, ESPI4_SLSO1, ESPI4_SLSO2, ESPI4_SLSO3, ESPI4_SLSO4, ESPI4_SLSO5, ESPI5_MRST, ESPI5_MTSR, ESPI5_SCLK, ESPI5_SLSO0, ESPI5_SLSO1, ESPI5_SLSO2, ESPI5_SLSO3, ESPI5_SLSO4, ESPI5_SLSO5, ESPI5_SLSO6, ETH_MDC, ETH_MDIO, ETH_PPS, ETH_TXD0, ETH_TXD1, ETH_TXD2, ETH_TXD3, ETH_TXEN, ETH_TXER, GPIO, GTM_CLK0, GTM_CLK2, GTM_TOUT0, GTM_TOUT1, GTM_TOUT10, GTM_TOUT100, GTM_TOUT101, GTM_TOUT103, GTM_TOUT104, GTM_TOUT105, GTM_TOUT107, GTM_TOUT108, GTM_TOUT11, GTM_TOUT12, GTM_TOUT124, GTM_TOUT13, GTM_TOUT14, GTM_TOUT15, GTM_TOUT16, GTM_TOUT17, GTM_TOUT18, GTM_TOUT2, GTM_TOUT21, GTM_TOUT22, GTM_TOUT23, GTM_TOUT24, GTM_TOUT25, GTM_TOUT26, GTM_TOUT27, GTM_TOUT28, GTM_TOUT29, GTM_TOUT3, GTM_TOUT30, GTM_TOUT31, GTM_TOUT32, GTM_TOUT33, GTM_TOUT34, GTM_TOUT4, GTM_TOUT42, GTM_TOUT47, GTM_TOUT48, GTM_TOUT49, GTM_TOUT5, GTM_TOUT50, GTM_TOUT53, GTM_TOUT54, GTM_TOUT55, GTM_TOUT56, GTM_TOUT57, GTM_TOUT58, GTM_TOUT59, GTM_TOUT6, GTM_TOUT61, GTM_TOUT62, GTM_TOUT63, GTM_TOUT64, GTM_TOUT65, GTM_TOUT66, GTM_TOUT67, GTM_TOUT68, GTM_TOUT69, GTM_TOUT7, GTM_TOUT70, GTM_TOUT71, GTM_TOUT72, GTM_TOUT73, GTM_TOUT74, GTM_TOUT75, GTM_TOUT76, GTM_TOUT77, GTM_TOUT78, GTM_TOUT79, GTM_TOUT8, GTM_TOUT80, GTM_TOUT81, GTM_TOUT82, GTM_TOUT83, GTM_TOUT84, GTM_TOUT85, GTM_TOUT86, GTM_TOUT9, GTM_TOUT91, GTM_TOUT92, GTM_TOUT93, GTM_TOUT94, GTM_TOUT95, GTM_TOUT96, GTM_TOUT97, GTM_TOUT98, GTM_TOUT99, HRPWM_0, HRPWM_1, HRPWM_2, HRPWM_3, HRPWM_4, HRPWM_5, HRPWM_6, HRPWM_7, HSM_HSM1, HSM_HSM2, I2C0_IRQ, I2C0_SCL, I2C0_SDA, I2C1_IRQ, I2C1_SCL, I2C1_SDA, RCC_EXTCLK0, RCC_EXTCLK1, SAC_FSP0, SAC_FSP1, SENT_SPC0, SENT_SPC1, SENT_SPC2, SENT_SPC3, SENT_SPC4, SENT_SPC5, TDO, TIO_CHANNEL0_N_OUT, TIO_CHANNEL0_OUT, TIO_CHANNEL1_N_OUT, TIO_CHANNEL1_OUT, TIO_CHANNEL2_N_OUT, TIO_CHANNEL2_OUT, TIO_CHANNEL3_N_OUT, TIO_CHANNEL3_OUT, TIO_CHANNEL4_N_OUT, TIO_CHANNEL4_OUT, TIO_CHANNEL5_N_OUT, TIO_CHANNEL5_OUT, TIO_CHANNEL6_N_OUT, TIO_CHANNEL6_OUT, TIO_CHANNEL7_N_OUT, TIO_CHANNEL7_OUT, TRACE_CLK, TRACE_CTL, TRACE_DATA0, TRACE_DATA1, TRACE_DATA10, TRACE_DATA11, TRACE_DATA12, TRACE_DATA13, TRACE_DATA14, TRACE_DATA15, TRACE_DATA2, TRACE_DATA3, TRACE_DATA4, TRACE_DATA5, TRACE_DATA6, TRACE_DATA7, TRACE_DATA8, TRACE_DATA9, TRIG_INACK, TRIG_IO, TRIG_OUT}, post-build-variant-value=true, set at post-build, default-value=GPIO  # ECUC_Port_00128: Port pin mode from mode list for use with Port_Init() function
          enumeration PortPinLevelValue: {PORT_PIN_LEVEL_LOW, PORT_PIN_LEVEL_HIGH}, post-build-variant-value=true, set at post-build, default-value=PORT_PIN_LEVEL_LOW  # ECUC_Port_00129: Port Pin Level value from Port pin list.
          enumeration PortPinOutputPushMode: {PORT_OUTPUT_OPENDRAIN, PORT_OUTPUT_PUSHPULL}, origin=ChipowerTech, post-build-variant-value=true, set at post-build, default-value=PORT_OUTPUT_PUSHPULL  # Parameter to Select if output pin is Push_full or Open_Drain
          enumeration PortPinDriverStrength: {PORT_DRIVER_STRENGTH_LOW, PORT_DRIVER_STRENGTH_HIGH}, origin=ChipowerTech, post-build-variant-value=true, set at post-build, default-value=PORT_DRIVER_STRENGTH_LOW  # Parameter to Select Driver Strength
          boolean PortPinEnableSlewRate: origin=ChipowerTech, post-build-variant-value=true, set at post-build, default-value=false  # Parameter to Select if enable slew-rate mode in output strong drive mode, The slew-rate can reduce the IO output waveform oscillation to a certain extent, and the rising and falling edges of the waveform will be slowed down at the same time. This option is available, must set (PortPinDirection = PORT_PIN_OUT) and (PortPinDriverStrength = PORT_DRIVER_STRENGTH_HIGH).
          enumeration PortPinPadLevel: {PORT_PDR_AL_AUTOMOTIVE_LEVEL, PORT_PDR_TTL_AUTOMOTIVE_LEVEL, PORT_PDR_STTL_AUTOMOTIVE_LEVEL}, origin=ChipowerTech, post-build-variant-value=true, set at post-build, default-value=PORT_PDR_AL_AUTOMOTIVE_LEVEL  # Parameter to Select Pad Voltage Level
          enumeration PortPinPullMode: {PORT_INPUTMODE_NONE, PORT_INPUTMODE_PULLUP, PORT_INPUTMODE_PULLDOWN}, origin=ChipowerTech, post-build-variant-value=true, set at post-build, default-value=PORT_INPUTMODE_PULLUP  # Parameter to Select if input pin is Pull_Down or Pull_Up
          enumeration PortPinPadTriggerMode: {PORT_CMOS_LEVEL_MODE, PORT_SCHMIDT_LEVEL_MODE}, origin=ChipowerTech, post-build-variant-value=true, set at post-build, default-value=PORT_SCHMIDT_LEVEL_MODE  # Parameter to Select Pad level trigger mode
          enumeration RxMuxFunSelect: {ASI0_ARXA, ASI0_ARXB, ASI0_ARXC, ASI0_ARXD, ASI10_ARXA, ASI10_ARXB, ASI10_ARXC, ASI10_ARXD, ASI11_ARXE, ASI11_ARXF, ASI1_ARXA, ASI1_ARXB, ASI1_ARXC, ASI1_ARXD, ASI1_ARXE, ASI1_ARXG, ASI2_ARXA, ASI2_ARXB, ASI2_ARXD, ASI2_ARXE, ASI2_ARXG, ASI3_ARXA, ASI3_ARXC, ASI3_ARXE, ASI3_ARXF, ASI4_ARXA, ASI4_ARXB, ASI5_ARXA, ASI5_ARXB, ASI5_ARXC, ASI6_ARXE, ASI6_ARXF, ASI7_ARXE, ASI8_ARXC, ASI8_ARXD, ASI9_ARXE, ASI9_ARXF, CAN00_RXDA, CAN00_RXDB, CAN00_RXDD, CAN00_RXDE, CAN00_RXDG, CAN01_RXDA, CAN01_RXDB, CAN01_RXDC, CAN01_RXDD, CAN02_RXDA, CAN02_RXDB, CAN02_RXDC, CAN02_RXDE, CAN10_RXDA, CAN10_RXDD, CAN11_RXDA, CAN11_RXDB, CAN12_RXDA, CAN12_RXDD, EMGSTOP_PORT_A, EMGSTOP_PORT_B, ESPI0_MRSTA, ESPI0_MRSTB, ESPI0_MTSRA, ESPI0_MTSRB, ESPI0_SCLKA, ESPI0_SCLKB, ESPI0_SLSIA, ESPI0_SLSIB, ESPI0_SLSIC, ESPI1_MRSTA, ESPI1_MRSTB, ESPI1_MTSRA, ESPI1_MTSRB, ESPI1_SCLKA, ESPI1_SCLKB, ESPI1_SLSIA, ESPI2_MRSTA, ESPI2_MRSTB, ESPI2_MRSTC, ESPI2_MRSTE, ESPI2_MTSRA, ESPI2_MTSRB, ESPI2_SCLKA, ESPI2_SCLKB, ESPI2_SCLKC, ESPI2_SLSIA, ESPI2_SLSIB, ESPI2_SLSIC, ESPI2_SLSID, ESPI3_MRSTA, ESPI3_MRSTD, ESPI3_MTSRA, ESPI3_MTSRB, ESPI3_MTSRD, ESPI3_SCLKA, ESPI3_SCLKD, ESPI3_SLSIA, ESPI4_MRSTA, ESPI4_MRSTB, ESPI4_MTSRA, ESPI4_MTSRB, ESPI4_SCLKA, ESPI4_SCLKB, ESPI4_SCLKC, ESPI4_SLSIA, ESPI4_SLSIB, ESPI5_MRSTA, ESPI5_MRSTB, ESPI5_MTSRA, ESPI5_MTSRB, ESPI5_SCLKA, ESPI5_SCLKB, ESPI5_SCLKC, ESPI5_SLSIA, ESPI5_SLSIB, ETH_COLA, ETH_CRSA, ETH_CRSB, ETH_CRSDVA, ETH_CRSDVB, ETH_MDIOA, ETH_MDIOC, ETH_MDIOD, ETH_REFCLKA, ETH_RXCLKA, ETH_RXCLKB, ETH_RXCLKC, ETH_RXD0A, ETH_RXD1A, ETH_RXD2A, ETH_RXD3A, ETH_RXDVA, ETH_RXDVB, ETH_RXERA, ETH_RXERB, ETH_RXERC, ETH_TXCLKA, ETH_TXCLKB, E_REQ0_0, E_REQ1_0, E_REQ2_0, E_REQ2_1, E_REQ2_2, E_REQ3_0, E_REQ3_1, E_REQ3_2, E_REQ4_0, E_REQ4_3, E_REQ5_0, E_REQ6_0, E_REQ6_3, E_REQ7_0, E_REQ7_2, GPIO, GTM_DTMA0_0, GTM_DTMA0_1, GTM_DTMT0_0, GTM_DTMT0_1, GTM_DTMT0_2, GTM_DTMT1_1, GTM_DTMT1_2, GTM_TIM0_IN0_1, GTM_TIM0_IN0_10, GTM_TIM0_IN0_2, GTM_TIM0_IN0_4, GTM_TIM0_IN0_6, GTM_TIM0_IN0_7, GTM_TIM0_IN0_8, GTM_TIM0_IN0_9, GTM_TIM0_IN1_2, GTM_TIM0_IN1_3, GTM_TIM0_IN1_4, GTM_TIM0_IN1_5, GTM_TIM0_IN1_6, GTM_TIM0_IN1_7, GTM_TIM0_IN1_8, GTM_TIM0_IN1_9, GTM_TIM0_IN2_2, GTM_TIM0_IN2_3, GTM_TIM0_IN2_4, GTM_TIM0_IN2_5, GTM_TIM0_IN2_6, GTM_TIM0_IN2_8, GTM_TIM0_IN2_9, GTM_TIM0_IN3_1, GTM_TIM0_IN3_2, GTM_TIM0_IN3_3, GTM_TIM0_IN3_4, GTM_TIM0_IN3_5, GTM_TIM0_IN3_6, GTM_TIM0_IN3_7, GTM_TIM0_IN3_9, GTM_TIM0_IN4_1, GTM_TIM0_IN4_3, GTM_TIM0_IN4_4, GTM_TIM0_IN4_6, GTM_TIM0_IN4_7, GTM_TIM0_IN4_8, GTM_TIM0_IN5_1, GTM_TIM0_IN5_3, GTM_TIM0_IN5_6, GTM_TIM0_IN5_7, GTM_TIM0_IN6_1, GTM_TIM0_IN6_3, GTM_TIM0_IN6_4, GTM_TIM0_IN6_6, GTM_TIM0_IN6_7, GTM_TIM0_IN7_1, GTM_TIM0_IN7_2, GTM_TIM0_IN7_3, GTM_TIM0_IN7_6, GTM_TIM1_IN0_1, GTM_TIM1_IN0_10, GTM_TIM1_IN0_2, GTM_TIM1_IN0_4, GTM_TIM1_IN0_6, GTM_TIM1_IN0_7, GTM_TIM1_IN0_8, GTM_TIM1_IN0_9, GTM_TIM1_IN1_2, GTM_TIM1_IN1_3, GTM_TIM1_IN1_4, GTM_TIM1_IN1_5, GTM_TIM1_IN1_6, GTM_TIM1_IN1_7, GTM_TIM1_IN1_8, GTM_TIM1_IN1_9, GTM_TIM1_IN2_2, GTM_TIM1_IN2_3, GTM_TIM1_IN2_4, GTM_TIM1_IN2_5, GTM_TIM1_IN2_6, GTM_TIM1_IN2_8, GTM_TIM1_IN2_9, GTM_TIM1_IN3_1, GTM_TIM1_IN3_2, GTM_TIM1_IN3_3, GTM_TIM1_IN3_4, GTM_TIM1_IN3_5, GTM_TIM1_IN3_6, GTM_TIM1_IN3_7, GTM_TIM1_IN3_9, GTM_TIM1_IN4_1, GTM_TIM1_IN4_3, GTM_TIM1_IN4_4, GTM_TIM1_IN4_6, GTM_TIM1_IN4_7, GTM_TIM1_IN4_8, GTM_TIM1_IN4_9, GTM_TIM1_IN5_1, GTM_TIM1_IN5_3, GTM_TIM1_IN5_6, GTM_TIM1_IN5_7, GTM_TIM1_IN5_8, GTM_TIM1_IN6_1, GTM_TIM1_IN6_3, GTM_TIM1_IN6_4, GTM_TIM1_IN6_6, GTM_TIM1_IN6_7, GTM_TIM1_IN7_1, GTM_TIM1_IN7_2, GTM_TIM1_IN7_3, GTM_TIM1_IN7_6, HWCFG0IN, HWCFG1IN, HWCFG2IN, HWCFG3IN, HWCFG4IN, HWCFG5IN, HWCFG6IN, I2C0_SCLA, I2C0_SCLB, I2C0_SDAA, I2C0_SDAB, I2C1_SCLA, I2C1_SCLB, I2C1_SDAA, I2C1_SDAB, IOM_PIN_0, IOM_PIN_1, IOM_PIN_10, IOM_PIN_11, IOM_PIN_12, IOM_PIN_13, IOM_PIN_14, IOM_PIN_15, IOM_PIN_2, IOM_PIN_3, IOM_PIN_4, IOM_PIN_5, IOM_PIN_6, IOM_PIN_7, IOM_PIN_8, IOM_PIN_9, PINAWKP, PINBWKP, SAC_FSP0, SAC_FSP1, SARADC_G2CH0, SARADC_G2CH1, SARADC_G2CH4, SARADC_G2CH5, SARADC_G2CH6, SARADC_G2CH7, SENT_SENT0A, SENT_SENT0B, SENT_SENT0C, SENT_SENT1A, SENT_SENT1B, SENT_SENT1C, SENT_SENT2A, SENT_SENT2B, SENT_SENT2C, SENT_SENT3A, SENT_SENT3B, SENT_SENT3C, SENT_SENT4A, SENT_SENT4B, SENT_SENT4C, SENT_SENT5A, SENT_SENT5B, SENT_SENT5C, TDI, TESTMODE, TIO0_INPUT_CHANNEL, TIO1_INPUT_CHANNEL, TIO2_INPUT_CHANNEL, TIO3_INPUT_CHANNEL, TIO4_INPUT_CHANNEL, TIO5_INPUT_CHANNEL, TIO6_INPUT_CHANNEL, TIO7_INPUT_CHANNEL, TRIG_IN, TRIG_IO}, origin=ChipowerTech, post-build-variant-value=true, set at post-build, default-value=GPIO  # SeLect Pin Input mode for CAN/SPI/ADC/LIN/...
          enumeration PortPinMode: {PORT_PIN_MODE_ALL}, post-build-variant-value=true, set at post-build, default-value=PORT_PIN_MODE_ALL  # ECUC_Port_00130: Port pin mode from mode list.
          boolean PortPinDirectionChangeable: post-build-variant-value=true, set at post-build, default-value=false  # ECUC_Port_00126: Parameter to indicate if the direction is changeable on a Port-Pin during runtime. true: Port Pin direction changeable enabled. false: Port Pin direction changeable disabled.
          boolean PortPinModeChangeable: post-build-variant-value=true, set at post-build, default-value=false  # ECUC_Port_00134: Parameter to indicate if the mode is changeable on a Port-Pin during runtime. true: Port Pin mode changeable allowed. false: Port Pin mode changeable not permitted.
          boolean PortPinAnalogInputEnable: origin=ChipowerTech, post-build-variant-value=true, set at post-build, default-value=false  # Parameter to enable Pin's Analog Input(AI) function. This will also disable Pin's Digital function and Peripheral Control Function. e.g. Pin is multiplex as SARADC and its direction should controlled by ADC device at runtime.
          reference PortPinEcucPartitionRef [0..*]: scope=ECU, multiplicity set at pre-compile, post-build-variant-multiplicity=true, post-build-variant-value=true, set at pre-compile, destination=EcucPartition  # Maps the Port pin to zero a multiple ECUC partitions. The ECUC partitions referenced are a subset of the ECUC partitions where the Port driver is mapped to. Tags: atp.Status=draft.
        container PortLVDS [0..0]: multiplicity set at pre-compile  # Configure the LVDS function of the Port-Pin.
          enumeration PortLVDSPinPair: {Null}, origin=ChipowerTech, set at post-build, default-value=Null  # Parameter identifies the PortPin Pair supporting the LVDS feature.
          integer PortLVDSPairId: 0..671, origin=ChipowerTech, post-build-variant-value=true, set at post-build, default-value=0  # LVDS Pair Id. This value will be assigned to the symbolic name derived from the PortLVDS container short name.
          enumeration PortLVDSMode: {LVDS, SUB_LVDS}, origin=ChipowerTech, post-build-variant-value=true, set at post-build, default-value=LVDS  # Parameters define the mode of LVDS. LVDS: The common mode voltage in this mode is 1.2V. SUB_LVDS: The common mode voltage in this mode is 0.9V
          enumeration PortLVDSTerminationResistorEnable: {LVDS_RTERM_ENABLE, LVDS_RTERM_DISABLE}, origin=ChipowerTech, post-build-variant-value=true, set at post-build, default-value=LVDS_RTERM_DISABLE  # Parameter identifies the PortPin Pair internal termination resistor RTERM enable.
          enumeration PortLVDSTerminationResistorVal: {SUBLDVS_RTERM_83ohm, SUBLDVS_RTERM_87ohm, SUBLDVS_RTERM_92ohm, SUBLDVS_RTERM_97ohm, LDVS_RTERM_103ohm, LDVS_RTERM_109ohm, LDVS_RTERM_117ohm, LDVS_RTERM_125ohm}, origin=ChipowerTech, post-build-variant-value=true, set at post-build, default-value=LDVS_RTERM_103ohm  # Parameter identifies the PortPin Pair terminal resistance value. Note: LVDS LDVS_RTERM_103ohm LDVS_RTERM_109ohm LDVS_RTERM_117ohm LDVS_RTERM_125ohm Note: SUB_LVDS SUBLDVS_RTERM_83ohm SUBLDVS_RTERM_87ohm SUBLDVS_RTERM_92ohm SUBLDVS_RTERM_97ohm
          enumeration PortLVDSCurrentAndSwing: {LDVS_CURRENT_SWING_LEVEL0, LDVS_CURRENT_SWING_LEVEL1, LDVS_CURRENT_SWING_LEVEL2, LDVS_CURRENT_SWING_LEVEL3}, origin=ChipowerTech, post-build-variant-value=true, set at post-build, default-value=LDVS_CURRENT_SWING_LEVEL1  # Parameter identifies the PortPin Pair current and swing control. Note: RTERM Disable + LVDS mode LDVS_CURRENT_SWING_LEVEL0: Drive current and differential output voltage magnitude select is: 2.20mA_220mV LDVS_CURRENT_SWING_LEVEL1: Drive current and differential output voltage magnitude select is: 2.75mA_275mV LDVS_CURRENT_SWING_LEVEL2: Drive current and differential output voltage magnitude select is: 3.30mA_330mV LDVS_CURRENT_SWING_LEVEL3: Drive current and differential output voltage magnitude select is: 3.85mA_385mV Note: RTERM Enable + LVDS mode LDVS_CURRENT_SWING_LEVEL0: Drive current and differential output voltage magnitude select is: 4.40mA_220mV LDVS_CURRENT_SWING_LEVEL1: Drive current and differential output voltage magnitude select is: 5.50mA_275mV LDVS_CURRENT_SWING_LEVEL2: Drive current and differential output voltage magnitude select is: 6.60mA_330mV LDVS_CURRENT_SWING_LEVEL3: Drive current and differential output voltage magnitude select is: 7.70mA_385mV Note: RTERM Disable + SUB_LVDS mode LDVS_CURRENT_SWING_LEVEL0: Drive current and differential output voltage magnitude select is: 0.55mA_55mV LDVS_CURRENT_SWING_LEVEL1: Drive current and differential output voltage magnitude select is: 1.10mA_110mV LDVS_CURRENT_SWING_LEVEL2: Drive current and differential output voltage magnitude select is: 1.65mA_165mV LDVS_CURRENT_SWING_LEVEL3: Drive current and differential output voltage magnitude select is: 2.20mA_220mV Note: RTERM Enable + SUB_LVDS mode LDVS_CURRENT_SWING_LEVEL0: Drive current and differential output voltage magnitude select is: 1.10mA_55mV LDVS_CURRENT_SWING_LEVEL1: Drive current and differential output voltage magnitude select is: 2.20mA_110mV LDVS_CURRENT_SWING_LEVEL2: Drive current and differential output voltage magnitude select is: 3.30mA_165mV LDVS_CURRENT_SWING_LEVEL3: Drive current and differential output voltage magnitude select is: 4.40mA_220mV
          enumeration PortLVDSOutputCurrentRatioTrim: {LDVS_CURRENT_RATIO_NEGATIVE_8, LDVS_CURRENT_RATIO_POSITIVE_0, LDVS_CURRENT_RATIO_POSITIVE_9, LDVS_CURRENT_RATIO_POSITIVE_20}, origin=ChipowerTech, post-build-variant-value=true, set at post-build, default-value=LDVS_CURRENT_RATIO_POSITIVE_0  # Parameter identifies the PortPin Pair output current ratio trim setting. Note: LDVS_CURRENT_RATIO_NEGATIVE_8: The output current adjustment value is -8% LDVS_CURRENT_RATIO_POSITIVE_0: The output current adjustment value is +0% LDVS_CURRENT_RATIO_POSITIVE_9: The output current adjustment value is +9% LDVS_CURRENT_RATIO_POSITIVE_20: The output current adjustment value is +20%
          enumeration PortLVDSBiasVolSelect: {LDVS_BIAS_VOL_INTERNAL_SHARE, LDVS_BIAS_VOL_EXTERNAL_INPUT}, origin=ChipowerTech, post-build-variant-value=true, set at post-build, default-value=LDVS_BIAS_VOL_INTERNAL_SHARE  # Parameter identifies the PortPin Pair Bias voltage selection. LDVS_BIAS_VOL_INTERNAL_SHARE: Bias voltage comes from external input (via VBIASIN). LDVS_BIAS_VOL_EXTERNAL_INPUT: The bias voltage comes from the internal VDDIO voltage divider.(LVDS: Vbias = VDDIO *2/3; SUB_LVDS: Vbias = VDDIO *1/2
    container PortGeneral  # ECUC_Port_00117: Module wide configuration parameters of the PORT driver.
      boolean PortDevErrorDetect: set at pre-compile, default-value=false  # ECUC_Port_00123: Switches the Default Error Tracer (Det) detection and notification ON or OFF. true: enabled (ON). false: disabled (OFF).
      boolean PortSafetyErrorDetect: origin=ChipowerTech, set at pre-compile, default-value=true  # Switches the functional safety detection and notification ON or OFF.
      boolean PortSetPinDirectionApi: set at pre-compile, default-value=false  # ECUC_Port_00131: Pre-processor switch to enable / disable the use of the function Port_SetPinDirection(). true: Enabled - Function Port_SetPinDirection() is available. false: Disabled - Function Port_SetPinDirection() is notavailable.
      boolean PortSetPinModeApi: set at pre-compile, default-value=false  # ECUC_Port_00132: Pre-processor switch to enable / disable the use of the function Port_SetPinMode(). true: Enabled - Function Port_SetPinMode() is available. false: Disabled - Function Port_SetPinMode() is not available.
      boolean PortVersionInfoApi: set at pre-compile, default-value=false  # ECUC_Port_00133: Pre-processor switch to enable / disable the API to read out the modules version information. true: Version info API enabled. false: Version info API disabled.
      boolean PortLvdsEnable: origin=ChipowerTech, set at pre-compile, default-value=false  # Pre-processor switch to enable / disable the LVDS function. Enable it when LVDS function used. true: enabled LVDS function. false: disabled LVDS function.
      reference PortEcucPartitionRef [0..*]: scope=ECU, multiplicity set at pre-compile, post-build-variant-multiplicity=true, post-build-variant-value=true, set at pre-compile, destination=EcucPartition  # Maps the Port driver to zero a multiple ECUC partitions to make the modules API available in this partition. Tags: atp.Status=draft.
    container CommonPublishedInformation  # Common container, aggregated by all modules. It contains published information about vendor and versions.
      integer ArReleaseMajorVersion: 0..255, origin=ChipowerTech, set at published-information, default-value=4  # Major version number of AUTOSAR specification on which the appropriate implementation is based on.
      integer ArReleaseMinorVersion: 0..255, origin=ChipowerTech, set at published-information, default-value=4  # Minor version number of AUTOSAR specification on which the appropriate implementation is based on.
      integer ArReleaseRevisionVersion: 0..255, origin=ChipowerTech, set at published-information, default-value=0  # Revision version number of AUTOSAR specification on which the appropriate implementation is based on.
      integer SwMajorVersion: 0..255, origin=ChipowerTech, set at published-information, default-value=1  # Major version number of the vendor specific implementation of the module. The numbering is vendor specific.
      integer SwMinorVersion: 0..255, origin=ChipowerTech, set at published-information, default-value=0  # Minor version number of the vendor specific implementation of the module. The numbering is vendor specific.
      integer SwPatchVersion: 0..255, origin=ChipowerTech, set at published-information, default-value=0  # Patch level version number of the vendor specific implementation of the module. The numbering is vendor specific.
      integer VendorId: 0..255, origin=ChipowerTech, set at published-information, default-value=175  # Vendor ID of the dedicated implementation of this module according to the AUTOSAR vendor list.
      integer ModuleId: 0..255, origin=ChipowerTech, set at published-information, default-value=124  # Module ID of this module from Module List.
