AUTOSAR XML (schema 00046)
package /THA6_AS440_FuSa
  ecuc definition collection Port_EcuParameterDefinition: module=Port
  module definition Port [0..1]: post-build-variant-support=true, refined-module-def=Port, variants post-build  # Configuration of the Port module.
    container PortConfigSet  # ECUC_Port_00121: This container contains the configuration parameters and sub containers of the AUTOSAR Port module.
      container PortContainer [23..23]: requires-index=true  # ECUC_Port_00122: Container collecting the PortPins.
        integer PortNumber: 0..41, origin=ChipowerTech, set at pre-compile, default-value=0  # The number of specified Ports in this PortContainer.
        integer PortNumberOfPortPins: 1..65535, set at pre-compile, default-value=16  # ECUC_Port_00124: The number of specified PortPins in this PortContainer.
        container PortPin [1..16]: multiplicity set at pre-compile, requires-index=true  # ECUC_Port_00118: Configuration of the individual port pins.
          string PortPinSymbolicName: origin=ChipowerTech, set at pre-compile, default-value=P0.0  # Symbolic name of the Port Pin.
          boolean PortPinEnable: origin=ChipowerTech, set at pre-compile, default-value=false  # Enable configuration options under the current PortContainer. true: The current Port-Pin uses the configuration under PortContainer. false: The current Port-Pin uses the default configuration of driver. Port-Pin Default configuration: PortPinDirection = PORT_PIN_IN. PortPinPadLeve = PORT_PDR_AL_AUTOMOTIVE_LEVEL. PortPinPullMode = PORT_INPUTMODE_PULLUP. PortPinPadTriggerMode = PORT_SCHMIDT_LEVEL_MODE. RxMuxFunSelect = GPIO.
          integer PortPinId: 0..65535, set at pre-compile, symbolic-name-value=true, default-value=0  # ECUC_Port_00127: Port-Pin ID, This value will be assigned to the symbolic name derived from the port pin container short name.PortPinId = Port_Number * 16 + Pin_Number
          enumeration PortPinDirection: {PORT_PIN_IN, PORT_PIN_OUT, PORT_PIN_INOUT}, post-build-variant-value=true, set at post-build, default-value=PORT_PIN_IN  # ECUC_Port_00125: The initial direction of the pin (IN or OUT). If the direction is not changeable, the value configured here is fixed.The direction must match the pin mode. E.g. a pin used for an ADC must be configured to be an in port. Implementation Type: Port_PinDirectionType
          enumeration PortPinInitialMode: {ASI0_ATX, ASI10_ATX, ASI11_ATX, ASI12_ATX, ASI13_ATX, ASI14_ATX, ASI15_ATX, ASI16_ATX, ASI17_ATX, ASI18_ATX, ASI19_ATX, ASI1_ATX, ASI20_ATX, ASI21_ATX, ASI22_ATX, ASI23_ATX, ASI2_ATX, ASI3_ATX, ASI4_ATX, ASI5_ATX, ASI6_ATX, ASI7_ATX, ASI8_ATX, ASI9_ATX, CAN00_TXD, CAN01_TXD, CAN02_TXD, CAN10_TXD, CAN11_TXD, CAN12_TXD, CAN20_TXD, CAN21_TXD, CAN22_TXD, CAN30_TXD, CAN31_TXD, CAN32_TXD, DCDCSYNCO, DSADC_CGPWMN, DSADC_CGPWMP, ESPI0_MRST, ESPI0_MTSR, ESPI0_SCLK, ESPI0_SLSO0, ESPI0_SLSO1, ESPI0_SLSO10, ESPI0_SLSO11, ESPI0_SLSO12, ESPI0_SLSO13, ESPI0_SLSO2, ESPI0_SLSO3, ESPI0_SLSO4, ESPI0_SLSO5, ESPI0_SLSO6, ESPI0_SLSO7, ESPI0_SLSO8, ESPI0_SLSO9, ESPI1_MRST, ESPI1_MTSR, ESPI1_SCLK, ESPI1_SLSO0, ESPI1_SLSO1, ESPI1_SLSO10, ESPI1_SLSO2, ESPI1_SLSO3, ESPI1_SLSO4, ESPI1_SLSO5, ESPI1_SLSO6, ESPI1_SLSO7, ESPI1_SLSO8, ESPI1_SLSO9, ESPI2_MRST, ESPI2_MTSR, ESPI2_SCLK, ESPI2_SLSO0, ESPI2_SLSO1, ESPI2_SLSO10, ESPI2_SLSO11, ESPI2_SLSO12, ESPI2_SLSO2, ESPI2_SLSO3, ESPI2_SLSO4, ESPI2_SLSO5, ESPI2_SLSO6, ESPI2_SLSO7, ESPI2_SLSO8, ESPI2_SLSO9, ESPI3_MRST, ESPI3_MTSR, ESPI3_SCLK, ESPI3_SLSO0, ESPI3_SLSO1, ESPI3_SLSO10, ESPI3_SLSO2, ESPI3_SLSO3, ESPI3_SLSO4, ESPI3_SLSO5, ESPI3_SLSO6, ESPI3_SLSO7, ESPI3_SLSO8, ESPI3_SLSO9, ESPI4_MRST, ESPI4_MTSR, ESPI4_SCLK, ESPI4_SLSO0, ESPI4_SLSO1, ESPI4_SLSO2, ESPI4_SLSO3, ESPI4_SLSO4, ESPI4_SLSO5, ESPI4_SLSO6, ESPI4_SLSO7, ESPI5_MRST, ESPI5_MTSR, ESPI5_SCLK, ESPI5_SLSO0, ESPI5_SLSO1, ESPI5_SLSO2, ESPI5_SLSO3, ESPI5_SLSO4, ESPI5_SLSO5, ESPI5_SLSO6, ESPI6_MRST, ESPI6_MTSR, ESPI6_SCLK, ESPI6_SLSO0, ESPI6_SLSO1, ESPI6_SLSO10, ESPI6_SLSO11, ESPI6_SLSO2, ESPI6_SLSO3, ESPI6_SLSO4, ESPI6_SLSO5, ESPI6_SLSO6, ESPI6_SLSO7, ESPI6_SLSO8, ESPI6_SLSO9, ESPI7_MRST, ESPI7_MTSR, ESPI7_SCLK, ESPI7_SLSO0, ESPI7_SLSO1, ESPI7_SLSO2, ESPI7_SLSO3, ESPI7_SLSO4, ESPI7_SLSO5, ESPI7_SLSO6, ESPI7_SLSO7, ESPI8_MRST, ESPI8_MTSR, ESPI8_SCLK, ESPI8_SLSO0, ESPI8_SLSO1, FC_FC0BFLOUT, FC_FC1BFLOUT, FC_FC2BFLOUT, FC_FC3BFLOUT, GETH_MDC, GETH_MDIO, GETH_PPS, GETH_TCTL, GETH_TXCLK, GETH_TXD0, GETH_TXD1, GETH_TXD2, GETH_TXD3, GETH_TXEN, GETH_TXER, GPIO, GTM_CLK0, GTM_CLK1, GTM_CLK2, GTM_TIO1_PWM00, GTM_TIO1_PWM04, GTM_TIO1_PWM10, GTM_TIO1_PWM14, GTM_TIO2_PWM01, GTM_TIO2_PWM05, GTM_TIO2_PWM11, GTM_TIO2_PWM15, GTM_TIO3_PWM02, GTM_TIO3_PWM06, GTM_TIO3_PWM12, GTM_TIO3_PWM16, GTM_TIO4_PWM03, GTM_TIO4_PWM13, GTM_TOUT0, GTM_TOUT1, GTM_TOUT10, GTM_TOUT100, GTM_TOUT101, GTM_TOUT102, GTM_TOUT103, GTM_TOUT104, GTM_TOUT105, GTM_TOUT106, GTM_TOUT107, GTM_TOUT108, GTM_TOUT109, GTM_TOUT11, GTM_TOUT110, GTM_TOUT111, GTM_TOUT112, GTM_TOUT113, GTM_TOUT114, GTM_TOUT115, GTM_TOUT116, GTM_TOUT117, GTM_TOUT118, GTM_TOUT119, GTM_TOUT12, GTM_TOUT120, GTM_TOUT121, GTM_TOUT122, GTM_TOUT123, GTM_TOUT124, GTM_TOUT125, GTM_TOUT126, GTM_TOUT127, GTM_TOUT128, GTM_TOUT129, GTM_TOUT13, GTM_TOUT130, GTM_TOUT131, GTM_TOUT132, GTM_TOUT133, GTM_TOUT134, GTM_TOUT135, GTM_TOUT136, GTM_TOUT137, GTM_TOUT138, GTM_TOUT139, GTM_TOUT14, GTM_TOUT140, GTM_TOUT141, GTM_TOUT142, GTM_TOUT143, GTM_TOUT144, GTM_TOUT146, GTM_TOUT147, GTM_TOUT148, GTM_TOUT149, GTM_TOUT15, GTM_TOUT150, GTM_TOUT151, GTM_TOUT152, GTM_TOUT153, GTM_TOUT154, GTM_TOUT155, GTM_TOUT156, GTM_TOUT157, GTM_TOUT158, GTM_TOUT159, GTM_TOUT16, GTM_TOUT160, GTM_TOUT161, GTM_TOUT162, GTM_TOUT163, GTM_TOUT164, GTM_TOUT165, GTM_TOUT166, GTM_TOUT167, GTM_TOUT168, GTM_TOUT17, GTM_TOUT174, GTM_TOUT175, GTM_TOUT176, GTM_TOUT177, GTM_TOUT178, GTM_TOUT179, GTM_TOUT18, GTM_TOUT180, GTM_TOUT181, GTM_TOUT182, GTM_TOUT183, GTM_TOUT184, GTM_TOUT185, GTM_TOUT186, GTM_TOUT187, GTM_TOUT188, GTM_TOUT189, GTM_TOUT19, GTM_TOUT190, GTM_TOUT191, GTM_TOUT192, GTM_TOUT193, GTM_TOUT194, GTM_TOUT195, GTM_TOUT196, GTM_TOUT197, GTM_TOUT198, GTM_TOUT199, GTM_TOUT2, GTM_TOUT20, GTM_TOUT200, GTM_TOUT201, GTM_TOUT202, GTM_TOUT203, GTM_TOUT204, GTM_TOUT205, GTM_TOUT206, GTM_TOUT207, GTM_TOUT208, GTM_TOUT209, GTM_TOUT21, GTM_TOUT210, GTM_TOUT211, GTM_TOUT212, GTM_TOUT213, GTM_TOUT214, GTM_TOUT215, GTM_TOUT216, GTM_TOUT217, GTM_TOUT218, GTM_TOUT219, GTM_TOUT22, GTM_TOUT220, GTM_TOUT221, GTM_TOUT222, GTM_TOUT223, GTM_TOUT224, GTM_TOUT225, GTM_TOUT226, GTM_TOUT227, GTM_TOUT228, GTM_TOUT229, GTM_TOUT23, GTM_TOUT230, GTM_TOUT231, GTM_TOUT232, GTM_TOUT233, GTM_TOUT234, GTM_TOUT235, GTM_TOUT236, GTM_TOUT237, GTM_TOUT24, GTM_TOUT242, GTM_TOUT243, GTM_TOUT244, GTM_TOUT245, GTM_TOUT246, GTM_TOUT247, GTM_TOUT248, GTM_TOUT249, GTM_TOUT25, GTM_TOUT250, GTM_TOUT251, GTM_TOUT252, GTM_TOUT253, GTM_TOUT254, GTM_TOUT255, GTM_TOUT256, GTM_TOUT258, GTM_TOUT259, GTM_TOUT26, GTM_TOUT260, GTM_TOUT261, GTM_TOUT262, GTM_TOUT263, GTM_TOUT264, GTM_TOUT265, GTM_TOUT266, GTM_TOUT267, GTM_TOUT268, GTM_TOUT269, GTM_TOUT27, GTM_TOUT270, GTM_TOUT28, GTM_TOUT29, GTM_TOUT3, GTM_TOUT30, GTM_TOUT31, GTM_TOUT32, GTM_TOUT33, GTM_TOUT34, GTM_TOUT35, GTM_TOUT36, GTM_TOUT37, GTM_TOUT38, GTM_TOUT39, GTM_TOUT4, GTM_TOUT40, GTM_TOUT41, GTM_TOUT42, GTM_TOUT43, GTM_TOUT44, GTM_TOUT45, GTM_TOUT46, GTM_TOUT47, GTM_TOUT48, GTM_TOUT49, GTM_TOUT5, GTM_TOUT50, GTM_TOUT51, GTM_TOUT52, GTM_TOUT53, GTM_TOUT54, GTM_TOUT55, GTM_TOUT56, GTM_TOUT57, GTM_TOUT58, GTM_TOUT59, GTM_TOUT6, GTM_TOUT60, GTM_TOUT61, GTM_TOUT62, GTM_TOUT63, GTM_TOUT64, GTM_TOUT65, GTM_TOUT66, GTM_TOUT67, GTM_TOUT68, GTM_TOUT69, GTM_TOUT7, GTM_TOUT70, GTM_TOUT71, GTM_TOUT72, GTM_TOUT73, GTM_TOUT74, GTM_TOUT75, GTM_TOUT76, GTM_TOUT77, GTM_TOUT78, GTM_TOUT79, GTM_TOUT8, GTM_TOUT80, GTM_TOUT81, GTM_TOUT82, GTM_TOUT83, GTM_TOUT84, GTM_TOUT85, GTM_TOUT86, GTM_TOUT87, GTM_TOUT88, GTM_TOUT89, GTM_TOUT9, GTM_TOUT90, GTM_TOUT91, GTM_TOUT92, GTM_TOUT93, GTM_TOUT94, GTM_TOUT95, GTM_TOUT96, GTM_TOUT97, GTM_TOUT98, GTM_TOUT99, HRPWM0_0, HRPWM0_1, HRPWM0_2, HRPWM0_3, HRPWM0_4, HRPWM0_5, HRPWM0_6, HRPWM0_7, HRPWM1_0, HRPWM1_1, HRPWM1_2, HRPWM1_3, HRPWM1_4, HRPWM1_5, HRPWM1_6, HRPWM1_7, HSM_HSM1, HSM_HSM2, I2C0_IRQ, I2C0_SCL, I2C0_SDA, I2C1_IRQ, I2C1_SCL, I2C1_SDA, MSC0_EN0, MSC0_EN1, MSC0_FCL, MSC0_FCLN, MSC0_FCLP, MSC0_SO, MSC0_SON, MSC0_SOP, MSC1_EN0, MSC1_EN1, MSC1_FCLN, MSC1_FCLP, MSC1_SON, MSC1_SOP, MSC2_EN0, MSC2_EN1, MSC2_EN2, MSC2_FCLN, MSC2_FCLP, MSC2_SON, MSC2_SOP, PSI5_TX0, PSI5_TX1, PSI5_TX2, PSI5_TX3, QSPI_CLK, QSPI_CLKOUT, QSPI_D2, QSPI_D3, QSPI_MISO, QSPI_MOSI, QSPI_SSN0, QSPI_SSN1, QSPI_SSN2, QSPI_SSN3, RCC_EXTCLK0, RCC_EXTCLK1, RDC_WAVEN, RDC_WAVEP, SAC_FIP0, SAC_FIP1, SENT_SPC0, SENT_SPC1, SENT_SPC2, SENT_SPC3, SENT_SPC4, SENT_SPC5, SENT_SPC6, SENT_SPC7, SENT_SPC8, SENT_SPC9, TDO, TRACE_CLK, TRACE_CTL, TRACE_DATA0, TRACE_DATA1, TRACE_DATA10, TRACE_DATA11, TRACE_DATA12, TRACE_DATA13, TRACE_DATA14, TRACE_DATA15, TRACE_DATA2, TRACE_DATA3, TRACE_DATA4, TRACE_DATA5, TRACE_DATA6, TRACE_DATA7, TRACE_DATA8, TRACE_DATA9, TRIG_INACK, TRIG_IO, TRIG_OUT}, post-build-variant-value=true, set at post-build, default-value=GPIO  # ECUC_Port_00128: Port pin mode from mode list for use with Port_Init() function
          enumeration PortPinLevelValue: {PORT_PIN_LEVEL_LOW, PORT_PIN_LEVEL_HIGH}, post-build-variant-value=true, set at post-build, default-value=PORT_PIN_LEVEL_LOW  # ECUC_Port_00129: Port Pin Level value from Port pin list.
          enumeration PortPinOutputPushMode: {PORT_OUTPUT_OPENDRAIN, PORT_OUTPUT_PUSHPULL}, origin=ChipowerTech, post-build-variant-value=true, set at post-build, default-value=PORT_OUTPUT_PUSHPULL  # Parameter to Select if output pin is Push_full or Open_Drain
          enumeration PortPinDriverStrength: {PORT_DRIVER_STRENGTH_LOW, PORT_DRIVER_STRENGTH_HIGH}, origin=ChipowerTech, post-build-variant-value=true, set at post-build, default-value=PORT_DRIVER_STRENGTH_LOW  # Parameter to Select Driver Strength
          boolean PortPinEnableSlewRate: origin=ChipowerTech, post-build-variant-value=true, set at post-build, default-value=false  # Parameter to Select if enable slew-rate mode in output strong drive mode, The slew-rate can reduce the IO output waveform oscillation to a certain extent, and the rising and falling edges of the waveform will be slowed down at the same time. This option is available, must set (PortPinDirection = PORT_PIN_OUT) and (PortPinDriverStrength = PORT_DRIVER_STRENGTH_HIGH).
          enumeration PortPinPadLevel: {PORT_PDR_AL_AUTOMOTIVE_LEVEL, PORT_PDR_TTL_AUTOMOTIVE_LEVEL, PORT_PDR_STTL_AUTOMOTIVE_LEVEL}, origin=ChipowerTech, post-build-variant-value=true, set at post-build, default-value=PORT_PDR_AL_AUTOMOTIVE_LEVEL  # Parameter to Select Pad Voltage Level
          enumeration PortPinPullMode: {PORT_INPUTMODE_NONE, PORT_INPUTMODE_PULLUP, PORT_INPUTMODE_PULLDOWN}, origin=ChipowerTech, post-build-variant-value=true, set at post-build, default-value=PORT_INPUTMODE_PULLUP  # Parameter to Select if input pin is Pull_Down or Pull_Up
          enumeration PortPinPadTriggerMode: {PORT_CMOS_LEVEL_MODE, PORT_SCHMIDT_LEVEL_MODE}, origin=ChipowerTech, post-build-variant-value=true, set at post-build, default-value=PORT_SCHMIDT_LEVEL_MODE  # Parameter to Select Pad level trigger mode
          enumeration RxMuxFunSelect: {ASI0_ARXA, ASI0_ARXB, ASI0_ARXC, ASI0_ARXD, ASI0_ARXE, ASI10_ARXA, ASI10_ARXB, ASI10_ARXC, ASI10_ARXD, ASI11_ARXA, ASI11_ARXB, ASI11_ARXC, ASI11_ARXD, ASI11_ARXE, ASI11_ARXF, ASI12_ARXA, ASI12_ARXB, ASI13_ARXA, ASI13_ARXB, ASI14_ARXA, ASI14_ARXB, ASI15_ARXA, ASI15_ARXB, ASI16_ARXA, ASI16_ARXB, ASI17_ARXA, ASI17_ARXB, ASI18_ARXA, ASI18_ARXB, ASI19_ARXA, ASI19_ARXB, ASI1_ARXA, ASI1_ARXB, ASI1_ARXC, ASI1_ARXD, ASI1_ARXE, ASI1_ARXF, ASI1_ARXG, ASI20_ARXA, ASI20_ARXB, ASI21_ARXA, ASI21_ARXB, ASI22_ARXA, ASI22_ARXB, ASI23_ARXA, ASI23_ARXB, ASI2_ARXA, ASI2_ARXB, ASI2_ARXC, ASI2_ARXD, ASI2_ARXE, ASI2_ARXF, ASI2_ARXG, ASI3_ARXA, ASI3_ARXB, ASI3_ARXC, ASI3_ARXD, ASI3_ARXE, ASI3_ARXF, ASI3_ARXG, ASI3_ARXH, ASI3_ARXI, ASI4_ARXA, ASI4_ARXB, ASI4_ARXC, ASI4_ARXD, ASI5_ARXA, ASI5_ARXB, ASI5_ARXC, ASI5_ARXD, ASI6_ARXA, ASI6_ARXB, ASI6_ARXC, ASI6_ARXD, ASI6_ARXE, ASI6_ARXF, ASI7_ARXA, ASI7_ARXB, ASI7_ARXC, ASI7_ARXD, ASI7_ARXE, ASI7_ARXF, ASI8_ARXA, ASI8_ARXB, ASI8_ARXC, ASI8_ARXD, ASI8_ARXE, ASI9_ARXA, ASI9_ARXB, ASI9_ARXC, ASI9_ARXD, ASI9_ARXE, ASI9_ARXF, CAN00_RXDA, CAN00_RXDB, CAN00_RXDC, CAN00_RXDD, CAN00_RXDE, CAN00_RXDF, CAN00_RXDG, CAN00_RXDH, CAN01_RXDA, CAN01_RXDB, CAN01_RXDC, CAN01_RXDD, CAN01_RXDE, CAN02_RXDA, CAN02_RXDB, CAN02_RXDC, CAN02_RXDD, CAN02_RXDE, CAN0_ECTT1, CAN0_ECTT2, CAN10_RXDA, CAN10_RXDB, CAN10_RXDC, CAN10_RXDD, CAN11_RXDA, CAN11_RXDB, CAN11_RXDC, CAN11_RXDD, CAN12_RXDA, CAN12_RXDB, CAN12_RXDC, CAN12_RXDD, CAN20_RXDA, CAN20_RXDB, CAN20_RXDC, CAN20_RXDD, CAN20_RXDE, CAN20_RXDF, CAN21_RXDA, CAN21_RXDB, CAN21_RXDC, CAN21_RXDD, CAN21_RXDE, CAN21_RXDF, CAN22_RXDA, CAN22_RXDB, CAN22_RXDC, CAN22_RXDD, CAN22_RXDE, CAN30_RXDA, CAN30_RXDB, CAN30_RXDC, CAN30_RXDD, CAN30_RXDE, CAN30_RXDF, CAN31_RXDA, CAN31_RXDB, CAN31_RXDC, CAN31_RXDD, CAN32_RXDA, CAN32_RXDB, CAN32_RXDC, CAN32_RXDD, CAN32_RXDE, DSADC_ITR0E, DSADC_ITR0F, DSADC_ITR1E, DSADC_ITR1F, DSADC_ITR2E, DSADC_ITR2F, DSADC_ITR3E, DSADC_ITR3F, DSADC_ITR4E, DSADC_ITR4F, DSADC_ITR5E, DSADC_ITR5F, DSADC_ITR6E, DSADC_ITR6F, DSADC_ITR7E, DSADC_ITR7F, DSADC_ITR8E, DSADC_ITR8F, DSADC_ITR9E, DSADC_ITR9F, EMGSTOP_PORT_A, EMGSTOP_PORT_B, ESPI0_MRSTA, ESPI0_MRSTB, ESPI0_MRSTC, ESPI0_MTSRA, ESPI0_MTSRB, ESPI0_MTSRC, ESPI0_SCLKA, ESPI0_SCLKB, ESPI0_SCLKC, ESPI0_SLSIA, ESPI0_SLSIB, ESPI1_MRSTA, ESPI1_MRSTB, ESPI1_MTSRA, ESPI1_MTSRB, ESPI1_MTSRC, ESPI1_SCLKA, ESPI1_SCLKB, ESPI1_SLSIA, ESPI2_MRSTA, ESPI2_MRSTB, ESPI2_MRSTC, ESPI2_MRSTD, ESPI2_MRSTE, ESPI2_MRSTF, ESPI2_MRSTG, ESPI2_MRSTH, ESPI2_MTSRA, ESPI2_MTSRB, ESPI2_MTSRD, ESPI2_SCLKA, ESPI2_SCLKB, ESPI2_SCLKD, ESPI2_SLSIA, ESPI2_SLSIB, ESPI3_MRSTA, ESPI3_MRSTB, ESPI3_MRSTC, ESPI3_MTSRA, ESPI3_MTSRB, ESPI3_MTSRC, ESPI3_SCLKA, ESPI3_SCLKB, ESPI3_SCLKC, ESPI3_SLSIA, ESPI3_SLSIB, ESPI4_MRSTA, ESPI4_MRSTB, ESPI4_MRSTC, ESPI4_MRSTD, ESPI4_MRSTE, ESPI4_MRSTF, ESPI4_MTSRA, ESPI4_MTSRB, ESPI4_SCLKA, ESPI4_SCLKB, ESPI4_SLSIA, ESPI4_SLSIB, ESPI5_MRSTA, ESPI5_MRSTB, ESPI5_MRSTC, ESPI5_MRSTD, ESPI5_MRSTE, ESPI5_MRSTF, ESPI5_MRSTG, ESPI5_MRSTH, ESPI5_MRSTI, ESPI5_MRSTJ, ESPI5_MRSTK, ESPI5_MRSTL, ESPI5_MRSTM, ESPI5_MRSTN, ESPI5_MRSTO, ESPI5_MRSTP, ESPI5_MRSTQ, ESPI5_MRSTR, ESPI5_MRSTS, ESPI5_MRSTT, ESPI5_MTSRB, ESPI5_SCLKA, ESPI5_SLSIA, ESPI6_MRSTA, ESPI6_MRSTB, ESPI6_MRSTC, ESPI6_MRSTD, ESPI6_MRSTE, ESPI6_MRSTF, ESPI6_MRSTG, ESPI6_MRSTH, ESPI6_MRSTI, ESPI6_MRSTJ, ESPI6_MRSTK, ESPI6_MRSTL, ESPI6_MRSTM, ESPI6_MRSTN, ESPI6_MRSTO, ESPI6_MRSTP, ESPI6_MRSTQ, ESPI6_MTSRA, ESPI6_MTSRB, ESPI6_SCLKA, ESPI6_SCLKB, ESPI6_SLSIA, ESPI6_SLSIB, ESPI6_SLSIC, ESPI7_MRSTA, ESPI7_MRSTB, ESPI7_MRSTC, ESPI7_MRSTD, ESPI7_MRSTE, ESPI7_MRSTF, ESPI7_MRSTG, ESPI7_MRSTH, ESPI7_MRSTI, ESPI7_MRSTJ, ESPI7_MRSTK, ESPI7_MRSTL, ESPI7_MRSTM, ESPI7_MRSTN, ESPI7_MRSTO, ESPI7_MRSTP, ESPI7_MRSTQ, ESPI7_MRSTR, ESPI7_MRSTS, ESPI7_MRSTT, ESPI7_MRSTU, ESPI7_MRSTV, ESPI7_MTSRA, ESPI7_MTSRB, ESPI7_SCLKA, ESPI7_SLSIA, ESPI8_MRSTA, ESPI8_MRSTB, ESPI8_MRSTC, ESPI8_MRSTD, ESPI8_MRSTE, ESPI8_MRSTF, ESPI8_MRSTG, ESPI8_MRSTH, ESPI8_MRSTI, ESPI8_MTSRA, ESPI8_SCLKA, ESPI8_SLSIA, E_REQ0_0, E_REQ0_2, E_REQ1_0, E_REQ1_2, E_REQ2_0, E_REQ2_1, E_REQ2_2, E_REQ3_0, E_REQ3_1, E_REQ3_2, E_REQ4_0, E_REQ4_3, E_REQ5_0, E_REQ6_0, E_REQ6_3, E_REQ7_0, E_REQ7_2, GETH_COLA, GETH_CRSA, GETH_CRSB, GETH_CRSDVA, GETH_CRSDVB, GETH_GREFCLK, GETH_MDIOA, GETH_MDIOC, GETH_MDIOD, GETH_RCTLA, GETH_REFCLKA, GETH_RXCLKA, GETH_RXCLKB, GETH_RXCLKC, GETH_RXD0A, GETH_RXD1A, GETH_RXD2A, GETH_RXD3A, GETH_RXDVA, GETH_RXDVB, GETH_RXERA, GETH_RXERB, GETH_RXERC, GETH_TXCLKA, GETH_TXCLKB, GPIO, GTM_DTMA0_0, GTM_DTMA0_1, GTM_DTMA1_0, GTM_DTMA1_1, GTM_DTMA2_0, GTM_DTMA2_1, GTM_DTMA3_0, GTM_DTMA3_1, GTM_DTMA4_0, GTM_DTMA4_1, GTM_DTMA5_0, GTM_DTMA5_1, GTM_DTMA5_2, GTM_DTMT0_0, GTM_DTMT0_1, GTM_DTMT0_2, GTM_DTMT1_1, GTM_DTMT1_2, GTM_DTMT2_0, GTM_DTMT2_1, GTM_DTMT2_2, GTM_DTMT3_0, GTM_DTMT3_1, GTM_DTMT3_2, GTM_TIM0_IN0_1, GTM_TIM0_IN0_10, GTM_TIM0_IN0_11, GTM_TIM0_IN0_2, GTM_TIM0_IN0_3, GTM_TIM0_IN0_4, GTM_TIM0_IN0_5, GTM_TIM0_IN0_6, GTM_TIM0_IN0_7, GTM_TIM0_IN0_8, GTM_TIM0_IN0_9, GTM_TIM0_IN1_1, GTM_TIM0_IN1_10, GTM_TIM0_IN1_2, GTM_TIM0_IN1_3, GTM_TIM0_IN1_4, GTM_TIM0_IN1_5, GTM_TIM0_IN1_6, GTM_TIM0_IN1_7, GTM_TIM0_IN1_8, GTM_TIM0_IN1_9, GTM_TIM0_IN2_1, GTM_TIM0_IN2_10, GTM_TIM0_IN2_11, GTM_TIM0_IN2_2, GTM_TIM0_IN2_3, GTM_TIM0_IN2_4, GTM_TIM0_IN2_5, GTM_TIM0_IN2_6, GTM_TIM0_IN2_7, GTM_TIM0_IN2_8, GTM_TIM0_IN2_9, GTM_TIM0_IN3_1, GTM_TIM0_IN3_10, GTM_TIM0_IN3_11, GTM_TIM0_IN3_2, GTM_TIM0_IN3_3, GTM_TIM0_IN3_4, GTM_TIM0_IN3_5, GTM_TIM0_IN3_6, GTM_TIM0_IN3_7, GTM_TIM0_IN3_8, GTM_TIM0_IN3_9, GTM_TIM0_IN4_1, GTM_TIM0_IN4_2, GTM_TIM0_IN4_3, GTM_TIM0_IN4_4, GTM_TIM0_IN4_5, GTM_TIM0_IN4_6, GTM_TIM0_IN4_7, GTM_TIM0_IN4_8, GTM_TIM0_IN4_9, GTM_TIM0_IN5_1, GTM_TIM0_IN5_2, GTM_TIM0_IN5_3, GTM_TIM0_IN5_4, GTM_TIM0_IN5_5, GTM_TIM0_IN5_6, GTM_TIM0_IN5_7, GTM_TIM0_IN5_8, GTM_TIM0_IN5_9, GTM_TIM0_IN6_1, GTM_TIM0_IN6_2, GTM_TIM0_IN6_3, GTM_TIM0_IN6_4, GTM_TIM0_IN6_5, GTM_TIM0_IN6_6, GTM_TIM0_IN6_7, GTM_TIM0_IN6_8, GTM_TIM0_IN6_9, GTM_TIM0_IN7_1, GTM_TIM0_IN7_2, GTM_TIM0_IN7_3, GTM_TIM0_IN7_4, GTM_TIM0_IN7_5, GTM_TIM0_IN7_6, GTM_TIM0_IN7_7, GTM_TIM0_IN7_8, GTM_TIM1_IN0_1, GTM_TIM1_IN0_10, GTM_TIM1_IN0_2, GTM_TIM1_IN0_3, GTM_TIM1_IN0_4, GTM_TIM1_IN0_5, GTM_TIM1_IN0_6, GTM_TIM1_IN0_7, GTM_TIM1_IN0_8, GTM_TIM1_IN0_9, GTM_TIM1_IN1_1, GTM_TIM1_IN1_2, GTM_TIM1_IN1_3, GTM_TIM1_IN1_4, GTM_TIM1_IN1_5, GTM_TIM1_IN1_6, GTM_TIM1_IN1_7, GTM_TIM1_IN1_8, GTM_TIM1_IN1_9, GTM_TIM1_IN2_1, GTM_TIM1_IN2_10, GTM_TIM1_IN2_2, GTM_TIM1_IN2_3, GTM_TIM1_IN2_4, GTM_TIM1_IN2_5, GTM_TIM1_IN2_6, GTM_TIM1_IN2_7, GTM_TIM1_IN2_8, GTM_TIM1_IN2_9, GTM_TIM1_IN3_1, GTM_TIM1_IN3_10, GTM_TIM1_IN3_2, GTM_TIM1_IN3_3, GTM_TIM1_IN3_4, GTM_TIM1_IN3_5, GTM_TIM1_IN3_6, GTM_TIM1_IN3_7, GTM_TIM1_IN3_8, GTM_TIM1_IN3_9, GTM_TIM1_IN4_1, GTM_TIM1_IN4_2, GTM_TIM1_IN4_3, GTM_TIM1_IN4_4, GTM_TIM1_IN4_5, GTM_TIM1_IN4_6, GTM_TIM1_IN4_7, GTM_TIM1_IN4_8, GTM_TIM1_IN4_9, GTM_TIM1_IN5_1, GTM_TIM1_IN5_2, GTM_TIM1_IN5_3, GTM_TIM1_IN5_4, GTM_TIM1_IN5_5, GTM_TIM1_IN5_6, GTM_TIM1_IN5_7, GTM_TIM1_IN5_8, GTM_TIM1_IN6_1, GTM_TIM1_IN6_2, GTM_TIM1_IN6_3, GTM_TIM1_IN6_4, GTM_TIM1_IN6_5, GTM_TIM1_IN6_6, GTM_TIM1_IN6_7, GTM_TIM1_IN7_1, GTM_TIM1_IN7_2, GTM_TIM1_IN7_3, GTM_TIM1_IN7_4, GTM_TIM1_IN7_5, GTM_TIM1_IN7_6, GTM_TIM2_IN0_1, GTM_TIM2_IN0_13, GTM_TIM2_IN0_14, GTM_TIM2_IN0_2, GTM_TIM2_IN0_3, GTM_TIM2_IN0_4, GTM_TIM2_IN0_5, GTM_TIM2_IN0_6, GTM_TIM2_IN0_7, GTM_TIM2_IN0_8, GTM_TIM2_IN0_9, GTM_TIM2_IN1_1, GTM_TIM2_IN1_14, GTM_TIM2_IN1_2, GTM_TIM2_IN1_3, GTM_TIM2_IN1_4, GTM_TIM2_IN1_5, GTM_TIM2_IN1_6, GTM_TIM2_IN1_7, GTM_TIM2_IN1_8, GTM_TIM2_IN1_9, GTM_TIM2_IN2_1, GTM_TIM2_IN2_14, GTM_TIM2_IN2_2, GTM_TIM2_IN2_3, GTM_TIM2_IN2_4, GTM_TIM2_IN2_5, GTM_TIM2_IN2_6, GTM_TIM2_IN2_7, GTM_TIM2_IN2_8, GTM_TIM2_IN2_9, GTM_TIM2_IN3_1, GTM_TIM2_IN3_14, GTM_TIM2_IN3_2, GTM_TIM2_IN3_3, GTM_TIM2_IN3_4, GTM_TIM2_IN3_5, GTM_TIM2_IN3_6, GTM_TIM2_IN3_7, GTM_TIM2_IN3_8, GTM_TIM2_IN3_9, GTM_TIM2_IN4_1, GTM_TIM2_IN4_12, GTM_TIM2_IN4_14, GTM_TIM2_IN4_2, GTM_TIM2_IN4_3, GTM_TIM2_IN4_4, GTM_TIM2_IN4_5, GTM_TIM2_IN4_6, GTM_TIM2_IN4_7, GTM_TIM2_IN4_8, GTM_TIM2_IN4_9, GTM_TIM2_IN5_1, GTM_TIM2_IN5_12, GTM_TIM2_IN5_13, GTM_TIM2_IN5_14, GTM_TIM2_IN5_2, GTM_TIM2_IN5_3, GTM_TIM2_IN5_4, GTM_TIM2_IN5_5, GTM_TIM2_IN5_6, GTM_TIM2_IN5_7, GTM_TIM2_IN5_8, GTM_TIM2_IN5_9, GTM_TIM2_IN6_1, GTM_TIM2_IN6_12, GTM_TIM2_IN6_13, GTM_TIM2_IN6_14, GTM_TIM2_IN6_2, GTM_TIM2_IN6_3, GTM_TIM2_IN6_4, GTM_TIM2_IN6_5, GTM_TIM2_IN6_6, GTM_TIM2_IN6_7, GTM_TIM2_IN6_8, GTM_TIM2_IN6_9, GTM_TIM2_IN7_1, GTM_TIM2_IN7_12, GTM_TIM2_IN7_14, GTM_TIM2_IN7_2, GTM_TIM2_IN7_3, GTM_TIM2_IN7_4, GTM_TIM2_IN7_5, GTM_TIM2_IN7_6, GTM_TIM2_IN7_7, GTM_TIM2_IN7_8, GTM_TIM2_IN7_9, GTM_TIM3_IN0_1, GTM_TIM3_IN0_10, GTM_TIM3_IN0_11, GTM_TIM3_IN0_12, GTM_TIM3_IN0_13, GTM_TIM3_IN0_14, GTM_TIM3_IN0_2, GTM_TIM3_IN0_3, GTM_TIM3_IN0_4, GTM_TIM3_IN0_5, GTM_TIM3_IN0_6, GTM_TIM3_IN0_7, GTM_TIM3_IN0_8, GTM_TIM3_IN0_9, GTM_TIM3_IN1_1, GTM_TIM3_IN1_10, GTM_TIM3_IN1_11, GTM_TIM3_IN1_14, GTM_TIM3_IN1_15, GTM_TIM3_IN1_2, GTM_TIM3_IN1_3, GTM_TIM3_IN1_4, GTM_TIM3_IN1_5, GTM_TIM3_IN1_6, GTM_TIM3_IN1_7, GTM_TIM3_IN1_8, GTM_TIM3_IN1_9, GTM_TIM3_IN2_1, GTM_TIM3_IN2_10, GTM_TIM3_IN2_11, GTM_TIM3_IN2_14, GTM_TIM3_IN2_2, GTM_TIM3_IN2_3, GTM_TIM3_IN2_4, GTM_TIM3_IN2_5, GTM_TIM3_IN2_6, GTM_TIM3_IN2_7, GTM_TIM3_IN2_8, GTM_TIM3_IN2_9, GTM_TIM3_IN3_1, GTM_TIM3_IN3_10, GTM_TIM3_IN3_11, GTM_TIM3_IN3_12, GTM_TIM3_IN3_15, GTM_TIM3_IN3_2, GTM_TIM3_IN3_3, GTM_TIM3_IN3_4, GTM_TIM3_IN3_5, GTM_TIM3_IN3_6, GTM_TIM3_IN3_7, GTM_TIM3_IN3_8, GTM_TIM3_IN3_9, GTM_TIM3_IN4_1, GTM_TIM3_IN4_10, GTM_TIM3_IN4_11, GTM_TIM3_IN4_12, GTM_TIM3_IN4_2, GTM_TIM3_IN4_3, GTM_TIM3_IN4_4, GTM_TIM3_IN4_5, GTM_TIM3_IN4_6, GTM_TIM3_IN4_7, GTM_TIM3_IN4_8, GTM_TIM3_IN4_9, GTM_TIM3_IN5_1, GTM_TIM3_IN5_10, GTM_TIM3_IN5_11, GTM_TIM3_IN5_12, GTM_TIM3_IN5_13, GTM_TIM3_IN5_2, GTM_TIM3_IN5_3, GTM_TIM3_IN5_4, GTM_TIM3_IN5_5, GTM_TIM3_IN5_6, GTM_TIM3_IN5_7, GTM_TIM3_IN5_8, GTM_TIM3_IN5_9, GTM_TIM3_IN6_1, GTM_TIM3_IN6_10, GTM_TIM3_IN6_11, GTM_TIM3_IN6_12, GTM_TIM3_IN6_13, GTM_TIM3_IN6_14, GTM_TIM3_IN6_2, GTM_TIM3_IN6_3, GTM_TIM3_IN6_4, GTM_TIM3_IN6_5, GTM_TIM3_IN6_6, GTM_TIM3_IN6_7, GTM_TIM3_IN6_8, GTM_TIM3_IN6_9, GTM_TIM3_IN7_1, GTM_TIM3_IN7_10, GTM_TIM3_IN7_11, GTM_TIM3_IN7_12, GTM_TIM3_IN7_2, GTM_TIM3_IN7_3, GTM_TIM3_IN7_4, GTM_TIM3_IN7_5, GTM_TIM3_IN7_6, GTM_TIM3_IN7_7, GTM_TIM3_IN7_8, GTM_TIM3_IN7_9, GTM_TIM4_IN0_1, GTM_TIM4_IN0_10, GTM_TIM4_IN0_11, GTM_TIM4_IN0_12, GTM_TIM4_IN0_13, GTM_TIM4_IN0_15, GTM_TIM4_IN0_2, GTM_TIM4_IN0_3, GTM_TIM4_IN0_4, GTM_TIM4_IN0_5, GTM_TIM4_IN0_6, GTM_TIM4_IN0_7, GTM_TIM4_IN0_8, GTM_TIM4_IN0_9, GTM_TIM4_IN1_1, GTM_TIM4_IN1_10, GTM_TIM4_IN1_11, GTM_TIM4_IN1_13, GTM_TIM4_IN1_14, GTM_TIM4_IN1_2, GTM_TIM4_IN1_3, GTM_TIM4_IN1_4, GTM_TIM4_IN1_5, GTM_TIM4_IN1_6, GTM_TIM4_IN1_7, GTM_TIM4_IN1_8, GTM_TIM4_IN1_9, GTM_TIM4_IN2_1, GTM_TIM4_IN2_10, GTM_TIM4_IN2_11, GTM_TIM4_IN2_12, GTM_TIM4_IN2_13, GTM_TIM4_IN2_2, GTM_TIM4_IN2_3, GTM_TIM4_IN2_4, GTM_TIM4_IN2_5, GTM_TIM4_IN2_6, GTM_TIM4_IN2_7, GTM_TIM4_IN2_8, GTM_TIM4_IN2_9, GTM_TIM4_IN3_1, GTM_TIM4_IN3_10, GTM_TIM4_IN3_11, GTM_TIM4_IN3_12, GTM_TIM4_IN3_13, GTM_TIM4_IN3_2, GTM_TIM4_IN3_3, GTM_TIM4_IN3_4, GTM_TIM4_IN3_5, GTM_TIM4_IN3_6, GTM_TIM4_IN3_7, GTM_TIM4_IN3_8, GTM_TIM4_IN3_9, GTM_TIM4_IN4_1, GTM_TIM4_IN4_10, GTM_TIM4_IN4_11, GTM_TIM4_IN4_12, GTM_TIM4_IN4_14, GTM_TIM4_IN4_15, GTM_TIM4_IN4_2, GTM_TIM4_IN4_3, GTM_TIM4_IN4_4, GTM_TIM4_IN4_5, GTM_TIM4_IN4_6, GTM_TIM4_IN4_7, GTM_TIM4_IN4_8, GTM_TIM4_IN4_9, GTM_TIM4_IN5_1, GTM_TIM4_IN5_10, GTM_TIM4_IN5_11, GTM_TIM4_IN5_12, GTM_TIM4_IN5_14, GTM_TIM4_IN5_2, GTM_TIM4_IN5_3, GTM_TIM4_IN5_4, GTM_TIM4_IN5_5, GTM_TIM4_IN5_6, GTM_TIM4_IN5_7, GTM_TIM4_IN5_8, GTM_TIM4_IN5_9, GTM_TIM4_IN6_1, GTM_TIM4_IN6_10, GTM_TIM4_IN6_12, GTM_TIM4_IN6_2, GTM_TIM4_IN6_3, GTM_TIM4_IN6_4, GTM_TIM4_IN6_5, GTM_TIM4_IN6_6, GTM_TIM4_IN6_7, GTM_TIM4_IN6_8, GTM_TIM4_IN6_9, GTM_TIM4_IN7_1, GTM_TIM4_IN7_10, GTM_TIM4_IN7_12, GTM_TIM4_IN7_2, GTM_TIM4_IN7_3, GTM_TIM4_IN7_4, GTM_TIM4_IN7_5, GTM_TIM4_IN7_6, GTM_TIM4_IN7_7, GTM_TIM4_IN7_8, GTM_TIM4_IN7_9, GTM_TIM5_IN0_1, GTM_TIM5_IN0_10, GTM_TIM5_IN0_2, GTM_TIM5_IN0_3, GTM_TIM5_IN0_4, GTM_TIM5_IN0_5, GTM_TIM5_IN0_6, GTM_TIM5_IN0_7, GTM_TIM5_IN0_8, GTM_TIM5_IN0_9, GTM_TIM5_IN1_1, GTM_TIM5_IN1_10, GTM_TIM5_IN1_11, GTM_TIM5_IN1_2, GTM_TIM5_IN1_3, GTM_TIM5_IN1_4, GTM_TIM5_IN1_5, GTM_TIM5_IN1_6, GTM_TIM5_IN1_7, GTM_TIM5_IN1_8, GTM_TIM5_IN1_9, GTM_TIM5_IN2_1, GTM_TIM5_IN2_2, GTM_TIM5_IN2_3, GTM_TIM5_IN2_4, GTM_TIM5_IN2_5, GTM_TIM5_IN2_6, GTM_TIM5_IN2_7, GTM_TIM5_IN2_8, GTM_TIM5_IN2_9, GTM_TIM5_IN3_1, GTM_TIM5_IN3_10, GTM_TIM5_IN3_11, GTM_TIM5_IN3_2, GTM_TIM5_IN3_3, GTM_TIM5_IN3_4, GTM_TIM5_IN3_5, GTM_TIM5_IN3_6, GTM_TIM5_IN3_7, GTM_TIM5_IN3_8, GTM_TIM5_IN3_9, GTM_TIM5_IN4_1, GTM_TIM5_IN4_10, GTM_TIM5_IN4_11, GTM_TIM5_IN4_2, GTM_TIM5_IN4_4, GTM_TIM5_IN4_5, GTM_TIM5_IN4_6, GTM_TIM5_IN4_7, GTM_TIM5_IN4_8, GTM_TIM5_IN4_9, GTM_TIM5_IN5_1, GTM_TIM5_IN5_10, GTM_TIM5_IN5_11, GTM_TIM5_IN5_12, GTM_TIM5_IN5_2, GTM_TIM5_IN5_3, GTM_TIM5_IN5_4, GTM_TIM5_IN5_5, GTM_TIM5_IN5_6, GTM_TIM5_IN5_7, GTM_TIM5_IN5_8, GTM_TIM5_IN5_9, GTM_TIM5_IN6_1, GTM_TIM5_IN6_10, GTM_TIM5_IN6_11, GTM_TIM5_IN6_12, GTM_TIM5_IN6_2, GTM_TIM5_IN6_3, GTM_TIM5_IN6_4, GTM_TIM5_IN6_5, GTM_TIM5_IN6_6, GTM_TIM5_IN6_7, GTM_TIM5_IN6_8, GTM_TIM5_IN6_9, GTM_TIM5_IN7_1, GTM_TIM5_IN7_10, GTM_TIM5_IN7_11, GTM_TIM5_IN7_2, GTM_TIM5_IN7_3, GTM_TIM5_IN7_4, GTM_TIM5_IN7_5, GTM_TIM5_IN7_6, GTM_TIM5_IN7_7, GTM_TIM5_IN7_8, GTM_TIM5_IN7_9, GTM_TIM6_IN0_1, GTM_TIM6_IN0_2, GTM_TIM6_IN0_3, GTM_TIM6_IN0_4, GTM_TIM6_IN0_5, GTM_TIM6_IN0_6, GTM_TIM6_IN0_7, GTM_TIM6_IN0_8, GTM_TIM6_IN0_9, GTM_TIM6_IN1_1, GTM_TIM6_IN1_2, GTM_TIM6_IN1_3, GTM_TIM6_IN1_4, GTM_TIM6_IN1_5, GTM_TIM6_IN1_6, GTM_TIM6_IN1_7, GTM_TIM6_IN1_8, GTM_TIM6_IN1_9, GTM_TIM6_IN2_1, GTM_TIM6_IN2_2, GTM_TIM6_IN2_3, GTM_TIM6_IN2_4, GTM_TIM6_IN2_5, GTM_TIM6_IN2_6, GTM_TIM6_IN2_7, GTM_TIM6_IN2_8, GTM_TIM6_IN2_9, GTM_TIM6_IN3_1, GTM_TIM6_IN3_2, GTM_TIM6_IN3_3, GTM_TIM6_IN3_4, GTM_TIM6_IN3_5, GTM_TIM6_IN3_6, GTM_TIM6_IN3_7, GTM_TIM6_IN3_8, GTM_TIM6_IN3_9, GTM_TIM6_IN4_1, GTM_TIM6_IN4_2, GTM_TIM6_IN4_3, GTM_TIM6_IN4_4, GTM_TIM6_IN4_5, GTM_TIM6_IN4_6, GTM_TIM6_IN4_7, GTM_TIM6_IN4_8, GTM_TIM6_IN5_1, GTM_TIM6_IN5_2, GTM_TIM6_IN5_3, GTM_TIM6_IN5_4, GTM_TIM6_IN5_5, GTM_TIM6_IN5_6, GTM_TIM6_IN5_7, GTM_TIM6_IN5_8, GTM_TIM6_IN6_1, GTM_TIM6_IN6_2, GTM_TIM6_IN6_3, GTM_TIM6_IN6_4, GTM_TIM6_IN6_5, GTM_TIM6_IN6_6, GTM_TIM6_IN6_7, GTM_TIM6_IN6_8, GTM_TIM6_IN6_9, GTM_TIM6_IN7_1, GTM_TIM6_IN7_2, GTM_TIM6_IN7_3, GTM_TIM6_IN7_4, GTM_TIM6_IN7_5, GTM_TIM6_IN7_6, GTM_TIM6_IN7_7, GTM_TIM6_IN7_8, GTM_TIM7_IN0_1, GTM_TIM7_IN0_2, GTM_TIM7_IN0_3, GTM_TIM7_IN0_4, GTM_TIM7_IN0_5, GTM_TIM7_IN0_6, GTM_TIM7_IN0_7, GTM_TIM7_IN0_8, GTM_TIM7_IN1_1, GTM_TIM7_IN1_2, GTM_TIM7_IN1_3, GTM_TIM7_IN1_4, GTM_TIM7_IN1_5, GTM_TIM7_IN1_6, GTM_TIM7_IN1_7, GTM_TIM7_IN1_8, GTM_TIM7_IN2_1, GTM_TIM7_IN2_2, GTM_TIM7_IN2_3, GTM_TIM7_IN2_4, GTM_TIM7_IN2_5, GTM_TIM7_IN2_6, GTM_TIM7_IN2_7, GTM_TIM7_IN3_1, GTM_TIM7_IN3_2, GTM_TIM7_IN3_3, GTM_TIM7_IN3_4, GTM_TIM7_IN3_5, GTM_TIM7_IN3_6, GTM_TIM7_IN3_7, GTM_TIM7_IN4_1, GTM_TIM7_IN4_2, GTM_TIM7_IN4_3, GTM_TIM7_IN4_4, GTM_TIM7_IN4_5, GTM_TIM7_IN4_6, GTM_TIM7_IN5_1, GTM_TIM7_IN5_2, GTM_TIM7_IN5_3, GTM_TIM7_IN5_4, GTM_TIM7_IN5_5, GTM_TIM7_IN5_6, GTM_TIM7_IN6_1, GTM_TIM7_IN6_2, GTM_TIM7_IN6_3, GTM_TIM7_IN6_4, GTM_TIM7_IN6_5, GTM_TIM7_IN6_6, GTM_TIM7_IN7_1, GTM_TIM7_IN7_2, GTM_TIM7_IN7_3, GTM_TIM7_IN7_4, GTM_TIM7_IN7_5, HWCFG1IN, HWCFG2IN, HWCFG3IN, HWCFG4IN, HWCFG5IN, HWCFG6IN, I2C0_SCLA, I2C0_SCLB, I2C0_SCLC, I2C0_SDAA, I2C0_SDAB, I2C0_SDAC, I2C1_SCLA, I2C1_SCLB, I2C1_SDAA, I2C1_SDAB, IOM_PIN_0, IOM_PIN_1, IOM_PIN_10, IOM_PIN_11, IOM_PIN_12, IOM_PIN_13, IOM_PIN_14, IOM_PIN_15, IOM_PIN_2, IOM_PIN_3, IOM_PIN_4, IOM_PIN_5, IOM_PIN_6, IOM_PIN_7, IOM_PIN_8, IOM_PIN_9, MSC0_INJ0, MSC0_INJ1, MSC0_SDI0, MSC0_SDI1, MSC0_SDI2, MSC0_SDI3, MSC1_INJ0, MSC1_INJ1, MSC1_SDI0, MSC1_SDI1, MSC1_SDI2, MSC2_INJ0, MSC2_INJ1, MSC2_SDI0, MSC2_SDI1, P33_00_WKP, P33_01_WKP, P33_02_WKP, P33_03_WKP, P33_04_WKP, P33_05_WKP, P33_06_WKP, P33_07_WKP, P33_08_WKP, P33_09_WKP, P33_10_WKP, P33_11_WKP, P33_12_WKP, P33_13_WKP, P33_14_WKP, P33_15_WKP, P34_01_WKP, P34_02_WKP, P34_03_WKP, P34_04_WKP, P34_05_WKP, PINAWKP, PINBWKP, PSI5_RX0A, PSI5_RX0B, PSI5_RX0C, PSI5_RX1A, PSI5_RX1B, PSI5_RX1C, PSI5_RX2A, PSI5_RX2B, PSI5_RX2C, PSI5_RX3A, PSI5_RX3B, PSI5_RX3C, QSPI_CLKINA, QSPI_CLKINB, QSPI_D2A, QSPI_D2B, QSPI_D3A, QSPI_D3B, QSPI_MISOA, QSPI_MISOB, QSPI_MOSIA, QSPI_MOSIB, SAC_FIP0, SAC_FIP1, SENT_SENT0A, SENT_SENT0B, SENT_SENT0C, SENT_SENT10A, SENT_SENT10B, SENT_SENT10C, SENT_SENT10D, SENT_SENT11A, SENT_SENT11B, SENT_SENT11C, SENT_SENT11D, SENT_SENT12A, SENT_SENT12B, SENT_SENT12C, SENT_SENT13A, SENT_SENT13B, SENT_SENT13C, SENT_SENT14A, SENT_SENT14B, SENT_SENT14C, SENT_SENT15A, SENT_SENT15B, SENT_SENT15C, SENT_SENT16A, SENT_SENT16B, SENT_SENT16C, SENT_SENT17A, SENT_SENT17B, SENT_SENT17C, SENT_SENT17D, SENT_SENT18A, SENT_SENT18B, SENT_SENT18C, SENT_SENT18D, SENT_SENT19A, SENT_SENT19B, SENT_SENT19C, SENT_SENT1A, SENT_SENT1B, SENT_SENT1C, SENT_SENT20A, SENT_SENT20B, SENT_SENT20C, SENT_SENT21A, SENT_SENT21B, SENT_SENT21C, SENT_SENT22A, SENT_SENT22B, SENT_SENT22C, SENT_SENT23A, SENT_SENT23B, SENT_SENT23C, SENT_SENT24A, SENT_SENT24B, SENT_SENT24C, SENT_SENT2A, SENT_SENT2B, SENT_SENT2C, SENT_SENT3A, SENT_SENT3B, SENT_SENT3C, SENT_SENT4A, SENT_SENT4B, SENT_SENT4C, SENT_SENT5A, SENT_SENT5B, SENT_SENT5C, SENT_SENT6A, SENT_SENT6B, SENT_SENT6C, SENT_SENT7A, SENT_SENT7B, SENT_SENT7C, SENT_SENT8A, SENT_SENT8B, SENT_SENT8C, SENT_SENT9A, SENT_SENT9B, SENT_SENT9C, TDI, TRIG_IN, TRIG_IO}, origin=ChipowerTech, post-build-variant-value=true, set at post-build, default-value=GPIO  # SeLect Pin Input mode for CAN/SPI/ADC/LIN/...
          enumeration PortPinMode: {PORT_PIN_MODE_ALL}, post-build-variant-value=true, set at post-build, default-value=PORT_PIN_MODE_ALL  # ECUC_Port_00130: Port pin mode from mode list.
          boolean PortPinDirectionChangeable: post-build-variant-value=true, set at post-build, default-value=false  # ECUC_Port_00126: Parameter to indicate if the direction is changeable on a Port-Pin during runtime. true: Port Pin direction changeable enabled. false: Port Pin direction changeable disabled.
          boolean PortPinModeChangeable: post-build-variant-value=true, set at post-build, default-value=false  # ECUC_Port_00134: Parameter to indicate if the mode is changeable on a Port-Pin during runtime. true: Port Pin mode changeable allowed. false: Port Pin mode changeable not permitted.
          boolean PortPinAnalogInputEnable: origin=ChipowerTech, post-build-variant-value=true, set at post-build, default-value=false  # Parameter to enable Pin's Analog Input(AI) function. This will also disable Pin's Digital function and Peripheral Control Function. e.g. Pin is multiplex as SARADC and its direction should controlled by ADC device at runtime.
          reference PortPinEcucPartitionRef [0..*]: scope=ECU, multiplicity set at pre-compile, post-build-variant-multiplicity=true, post-build-variant-value=true, set at pre-compile, destination=EcucPartition  # Maps the Port pin to zero a multiple ECUC partitions. The ECUC partitions referenced are a subset of the ECUC partitions where the Port driver is mapped to. Tags: atp.Status=draft.
        container PortLVDS [0..6]: multiplicity set at pre-compile  # Configure the LVDS function of the Port-Pin.
          enumeration PortLVDSPinPair: {PAIR_PIN_0_1, PAIR_PIN_2_3, PAIR_PIN_4_5, PAIR_PIN_6_7}, origin=ChipowerTech, set at post-build, default-value=PAIR_PIN_0_1  # Parameter identifies the PortPin Pair supporting the LVDS feature.
          integer PortLVDSPairId: 0..671, origin=ChipowerTech, post-build-variant-value=true, set at post-build, default-value=0  # LVDS Pair Id. This value will be assigned to the symbolic name derived from the PortLVDS container short name.
          enumeration PortLVDSMode: {LVDS, SUB_LVDS}, origin=ChipowerTech, post-build-variant-value=true, set at post-build, default-value=LVDS  # Parameters define the mode of LVDS. LVDS: The common mode voltage in this mode is 1.2V. SUB_LVDS: The common mode voltage in this mode is 0.9V
          enumeration PortLVDSTerminationResistorEnable: {LVDS_RTERM_ENABLE, LVDS_RTERM_DISABLE}, origin=ChipowerTech, post-build-variant-value=true, set at post-build, default-value=LVDS_RTERM_DISABLE  # Parameter identifies the PortPin Pair internal termination resistor RTERM enable.
          enumeration PortLVDSTerminationResistorVal: {SUBLDVS_RTERM_83ohm, SUBLDVS_RTERM_87ohm, SUBLDVS_RTERM_92ohm, SUBLDVS_RTERM_97ohm, LDVS_RTERM_103ohm, LDVS_RTERM_109ohm, LDVS_RTERM_117ohm, LDVS_RTERM_125ohm}, origin=ChipowerTech, post-build-variant-value=true, set at post-build, default-value=LDVS_RTERM_103ohm  # Parameter identifies the PortPin Pair terminal resistance value. Note: LVDS LDVS_RTERM_103ohm LDVS_RTERM_109ohm LDVS_RTERM_117ohm LDVS_RTERM_125ohm Note: SUB_LVDS SUBLDVS_RTERM_83ohm SUBLDVS_RTERM_87ohm SUBLDVS_RTERM_92ohm SUBLDVS_RTERM_97ohm
          enumeration PortLVDSCurrentAndSwing: {LDVS_CURRENT_SWING_LEVEL0, LDVS_CURRENT_SWING_LEVEL1, LDVS_CURRENT_SWING_LEVEL2, LDVS_CURRENT_SWING_LEVEL3}, origin=ChipowerTech, post-build-variant-value=true, set at post-build, default-value=LDVS_CURRENT_SWING_LEVEL1  # Parameter identifies the PortPin Pair current and swing control. Note: RTERM Disable + LVDS mode LDVS_CURRENT_SWING_LEVEL0: Drive current and differential output voltage magnitude select is: 2.20mA_220mV LDVS_CURRENT_SWING_LEVEL1: Drive current and differential output voltage magnitude select is: 2.75mA_275mV LDVS_CURRENT_SWING_LEVEL2: Drive current and differential output voltage magnitude select is: 3.30mA_330mV LDVS_CURRENT_SWING_LEVEL3: Drive current and differential output voltage magnitude select is: 3.85mA_385mV Note: RTERM Enable + LVDS mode LDVS_CURRENT_SWING_LEVEL0: Drive current and differential output voltage magnitude select is: 4.40mA_220mV LDVS_CURRENT_SWING_LEVEL1: Drive current and differential output voltage magnitude select is: 5.50mA_275mV LDVS_CURRENT_SWING_LEVEL2: Drive current and differential output voltage magnitude select is: 6.60mA_330mV LDVS_CURRENT_SWING_LEVEL3: Drive current and differential output voltage magnitude select is: 7.70mA_385mV Note: RTERM Disable + SUB_LVDS mode LDVS_CURRENT_SWING_LEVEL0: Drive current and differential output voltage magnitude select is: 0.55mA_55mV LDVS_CURRENT_SWING_LEVEL1: Drive current and differential output voltage magnitude select is: 1.10mA_110mV LDVS_CURRENT_SWING_LEVEL2: Drive current and differential output voltage magnitude select is: 1.65mA_165mV LDVS_CURRENT_SWING_LEVEL3: Drive current and differential output voltage magnitude select is: 2.20mA_220mV Note: RTERM Enable + SUB_LVDS mode LDVS_CURRENT_SWING_LEVEL0: Drive current and differential output voltage magnitude select is: 1.10mA_55mV LDVS_CURRENT_SWING_LEVEL1: Drive current and differential output voltage magnitude select is: 2.20mA_110mV LDVS_CURRENT_SWING_LEVEL2: Drive current and differential output voltage magnitude select is: 3.30mA_165mV LDVS_CURRENT_SWING_LEVEL3: Drive current and differential output voltage magnitude select is: 4.40mA_220mV
          enumeration PortLVDSOutputCurrentRatioTrim: {LDVS_CURRENT_RATIO_NEGATIVE_8, LDVS_CURRENT_RATIO_POSITIVE_0, LDVS_CURRENT_RATIO_POSITIVE_9, LDVS_CURRENT_RATIO_POSITIVE_20}, origin=ChipowerTech, post-build-variant-value=true, set at post-build, default-value=LDVS_CURRENT_RATIO_POSITIVE_0  # Parameter identifies the PortPin Pair output current ratio trim setting. Note: LDVS_CURRENT_RATIO_NEGATIVE_8: The output current adjustment value is -8% LDVS_CURRENT_RATIO_POSITIVE_0: The output current adjustment value is +0% LDVS_CURRENT_RATIO_POSITIVE_9: The output current adjustment value is +9% LDVS_CURRENT_RATIO_POSITIVE_20: The output current adjustment value is +20%
          enumeration PortLVDSBiasVolSelect: {LDVS_BIAS_VOL_INTERNAL_SHARE, LDVS_BIAS_VOL_EXTERNAL_INPUT}, origin=ChipowerTech, post-build-variant-value=true, set at post-build, default-value=LDVS_BIAS_VOL_INTERNAL_SHARE  # Parameter identifies the PortPin Pair Bias voltage selection. LDVS_BIAS_VOL_INTERNAL_SHARE: Bias voltage comes from external input (via VBIASIN). LDVS_BIAS_VOL_EXTERNAL_INPUT: The bias voltage comes from the internal VDDIO voltage divider.(LVDS: Vbias = VDDIO *2/3; SUB_LVDS: Vbias = VDDIO *1/2
    container PortGeneral  # ECUC_Port_00117: Module wide configuration parameters of the PORT driver.
      boolean PortDevErrorDetect: set at pre-compile, default-value=false  # ECUC_Port_00123: Switches the Default Error Tracer (Det) detection and notification ON or OFF. true: enabled (ON). false: disabled (OFF).
      boolean PortSafetyErrorDetect: origin=ChipowerTech, set at pre-compile, default-value=true  # Switches the functional safety detection and notification ON or OFF.
      boolean PortSetPinDirectionApi: set at pre-compile, default-value=false  # ECUC_Port_00131: Pre-processor switch to enable / disable the use of the function Port_SetPinDirection(). true: Enabled - Function Port_SetPinDirection() is available. false: Disabled - Function Port_SetPinDirection() is notavailable.
      boolean PortSetPinModeApi: set at pre-compile, default-value=false  # ECUC_Port_00132: Pre-processor switch to enable / disable the use of the function Port_SetPinMode(). true: Enabled - Function Port_SetPinMode() is available. false: Disabled - Function Port_SetPinMode() is not available.
      boolean PortVersionInfoApi: set at pre-compile, default-value=false  # ECUC_Port_00133: Pre-processor switch to enable / disable the API to read out the modules version information. true: Version info API enabled. false: Version info API disabled.
      boolean PortLvdsEnable: origin=ChipowerTech, set at pre-compile, default-value=false  # Pre-processor switch to enable / disable the LVDS function. Enable it when LVDS function used. true: enabled LVDS function. false: disabled LVDS function.
      reference PortEcucPartitionRef [0..*]: scope=ECU, multiplicity set at pre-compile, post-build-variant-multiplicity=true, post-build-variant-value=true, set at pre-compile, destination=EcucPartition  # Maps the Port driver to zero a multiple ECUC partitions to make the modules API available in this partition. Tags: atp.Status=draft.
    container CommonPublishedInformation  # Common container, aggregated by all modules. It contains published information about vendor and versions.
      integer ArReleaseMajorVersion: 0..255, origin=ChipowerTech, set at published-information, default-value=4  # Major version number of AUTOSAR specification on which the appropriate implementation is based on.
      integer ArReleaseMinorVersion: 0..255, origin=ChipowerTech, set at published-information, default-value=4  # Minor version number of AUTOSAR specification on which the appropriate implementation is based on.
      integer ArReleaseRevisionVersion: 0..255, origin=ChipowerTech, set at published-information, default-value=0  # Revision version number of AUTOSAR specification on which the appropriate implementation is based on.
      integer SwMajorVersion: 0..255, origin=ChipowerTech, set at published-information, default-value=1  # Major version number of the vendor specific implementation of the module. The numbering is vendor specific.
      integer SwMinorVersion: 0..255, origin=ChipowerTech, set at published-information, default-value=0  # Minor version number of the vendor specific implementation of the module. The numbering is vendor specific.
      integer SwPatchVersion: 0..255, origin=ChipowerTech, set at published-information, default-value=0  # Patch level version number of the vendor specific implementation of the module. The numbering is vendor specific.
      integer VendorId: 0..255, origin=ChipowerTech, set at published-information, default-value=175  # Vendor ID of the dedicated implementation of this module according to the AUTOSAR vendor list.
      integer ModuleId: 0..255, origin=ChipowerTech, set at published-information, default-value=124  # Module ID of this module from Module List.
