AUTOSAR XML (schema 00046)
package /THA6_AS440_FuSa
  ecuc definition collection Wdg_EcuParameterDefinition: module=Wdg
  module definition Wdg [0..*]: post-build-variant-support=true, refined-module-def=Wdg, variants post-build  # Configuration of the Wdg (Watchdog driver) module.
    container WdgDemEventParameterRefs [0..1]: multiplicity set at pre-compile  # Container for the references to DemEventParameter elements which shall be invoked using the API Dem_ReportErrorStatus in case the corresponding error occurs. The EventId is taken from the referenced DemEventParameter's DemEventId value.
      reference WDG_E_DISABLE_REJECTED [0..1]: multiplicity set at pre-compile, set at pre-compile, requires-symbolic-name-value=true, destination=DemEventParameter  # Reference to the DemEventParameter which shall be issued when the error "Initialization or mode switch failed because it would disable the watchdog" has occurred.
      reference WDG_E_MODE_FAILED [0..1]: multiplicity set at pre-compile, set at pre-compile, requires-symbolic-name-value=true, destination=DemEventParameter  # Reference to the DemEventParameter which shall be issued when the error "Setting a watchdog mode failed (during initialization or mode switch)" has occurred.
    container WdgGeneral  # All general parameters of the watchdog driver are collected here.
      boolean WdgDevErrorDetect: set at pre-compile, default-value=false  # Switches the Default Error Tracer (Det) detection and notification ON or OFF.
      boolean WdgSafetyErrorDetect: origin=ChipowerTech, set at pre-compile, default-value=true  # Switches the safety error detection ON or OFF.
      boolean WdgDisableAllowed: set at pre-compile, default-value=false  # Compile switch to allow / forbid disabling the watchdog driver during runtime.
      boolean WdgVersionInfoApi: set at pre-compile, default-value=false  # Compile switch to enable / disable the version information API.
      enumeration WdgOverflowAction: {WDG_OVERFLOW_ACTION_RESET, WDG_OVERFLOW_ACTION_NONE}, origin=ChipowerTech, set at pre-compile, default-value=WDG_OVERFLOW_ACTION_RESET  # This parameter is used to configure the sac action when watchdog is overflow. WDG_OVERFLOW_ACTION_NONE: No action. WDG_OVERFLOW_ACTION_RESET: Send a reset request.
      integer WdgIndex: 0..255, set at pre-compile, symbolic-name-value=true, default-value=0  # Represents the watchdog driver's ID so that it can be referenced by the watchdog interface.
      float WdgInitialTimeout: 0.0..65.535, set at pre-compile, default-value=2.0  # This parameter is disabled. The initial timeout (sec) for the trigger condition to be initialized during Init function. It shall be not larger than WdgMaxTimeout.
      float WdgMaxTimeout: 0.0..65.535, set at pre-compile, default-value=10.0  # This parameter is disabled. The maximum timeout (sec) to which the watchdog trigger condition can be initialized.
      enumeration WdgRunArea: {RAM, ROM}, set at pre-compile, default-value=ROM  # Represents the watchdog driver execution area is either from ROM(Flash) or RAM as required with the particular microcontroller.
      function name WdgTriggerLocation: set at pre-compile, default-value=NULL_PTR  # Location (memory address) of the watchdog trigger routine.
      reference WdgEcucPartitionRef [0..1]: scope=ECU, multiplicity set at pre-compile, post-build-variant-multiplicity=true, post-build-variant-value=true, set at pre-compile, destination=EcucPartition  # Maps the Wdg driver to zero or one ECUC partitions to make the modules API available in this partition. Tags: atp.Status=draft.
      reference WdgClockReference: origin=ChipowerTech, set at pre-compile, destination=McuClockReferencePoint  # Reference to a container of the type McuClockReferencePoint, to select an input clock.
    container WdgSettingsConfig [1..2]: multiplicity set at pre-compile, requires-index=true  # The parameters of different watchdog devices are collected here.
      integer WdgDeviceID: 0..1, origin=ChipowerTech, set at pre-compile, default-value=0  # This parameter refers to Device ID to which the watchdog settings belong.
      boolean WdgDeviceDisableAllowed: origin=ChipowerTech, post-build-variant-value=true, set at post-build, default-value=false  # Compile switch to allow / forbid disabling the watchdog driver during runtime.
      float WdgDeviceMaxTimeout: 0.0..65.535, origin=ChipowerTech, post-build-variant-value=true, set at post-build, default-value=10.0  # The maximum timeout (sec) to which the watchdog trigger condition can be initialized for the device.
      float WdgDeviceInitialTimeout: 0.0..65.535, origin=ChipowerTech, post-build-variant-value=true, set at post-build, default-value=2.0  # The default timeout time for the current device. It shall be not larger than WdgDeviceMaxTimeout.
      function name WdgNotification [0..1]: multiplicity set at post-build, origin=ChipowerTech, post-build-variant-multiplicity=true, post-build-variant-value=true, set at post-build, default-value=Wdg_Notification  # When the watchdog count reaches the set time (Reset time - WdgProcessTimeBeforeReset), the notification function will be called. This function mapped to the notification routine provided by some upper layer module.When the notification function is not required, close the node.
      float WdgProcessTimeBeforeReset: 0.001..42.949, origin=ChipowerTech, post-build-variant-value=true, set at post-build, default-value=0.01  # This node sets the time (in seconds) between the time of notification function call and the occurrence of reset. It should not be greater than WdgDeviceMaxTimeout.
      enumeration WdgDefaultMode: {WDGIF_SLOW_MODE, WDGIF_FAST_MODE}, post-build-variant-value=true, set at post-build, default-value=WDGIF_FAST_MODE  # Default mode for watchdog driver initialization.ImplementationType: WdgIf_ModeType
      container WdgExternalConfiguration [0..1]: multiplicity set at pre-compile, post-build-variant-multiplicity=true, requires-index=true  # Configuration items for an external watchdog hardware
        choice reference WdgExternalContainerRef [0..1]: multiplicity set at post-build, post-build-variant-multiplicity=true, post-build-variant-value=true, set at post-build, destination=[DioChannelGroup, SpiSequence]  # Reference to either
      container WdgSettingsFast  # Hardware dependent settings for the watchdog driver's 'fast' mode.
        float WdgRefreshTime: 0.0..42.949, origin=ChipowerTech, post-build-variant-value=true, set at post-build, default-value=0.01  # Timeout value (sec) for Refresh Timer. Wdg driver serve the watchdog hardware by refresh timer.
      container WdgSettingsSlow  # Hardware dependent settings for the watchdog driver's 'slow' mode.
        float WdgRefreshTime: 0.0..42.949, origin=ChipowerTech, post-build-variant-value=true, set at post-build, default-value=0.02  # Timeout value (sec) for Refresh Timer. Wdg driver serve the watchdog hardware by refresh timer.
      container WdgSettingsOff  # Hardware dependent settings for the watchdog driver's 'off' mode.
    container WdgPublishedInformation  # Container holding all Wdg specific published information parameters
      enumeration WdgTriggerMode: {WDG_BOTH, WDG_TOGGLE, WDG_WINDOW}, set at published-information, default-value=WDG_TOGGLE  # Watchdog trigger mode (toggle/window/both)
    container CommonPublishedInformation  # Common container, aggregated by all modules. It contains published information about vendor and versions.
      integer ArReleaseMajorVersion: 0..255, origin=ChipowerTech, set at published-information, default-value=4  # Major version number of AUTOSAR specification on which the appropriate implementation is based on.
      integer ArReleaseMinorVersion: 0..255, origin=ChipowerTech, set at published-information, default-value=4  # Minor version number of AUTOSAR specification on which the appropriate implementation is based on.
      integer ArReleaseRevisionVersion: 0..255, origin=ChipowerTech, set at published-information, default-value=0  # Patch level version number of AUTOSAR specification on which the appropriate implementation is based on.
      integer ModuleId: 0..255, origin=ChipowerTech, set at published-information, default-value=102  # Module ID of this module from Module List
      integer SwMajorVersion: 0..255, origin=ChipowerTech, set at published-information, default-value=1  # Major version number of the vendor specific implementation of the module. The numbering is vendor specific.
      integer SwMinorVersion: 0..255, origin=ChipowerTech, set at published-information, default-value=0  # Minor version number of the vendor specific implementation of the module. The numbering is vendor specific.
      integer SwPatchVersion: 0..255, origin=ChipowerTech, set at published-information, default-value=0  # Patch level version number of the vendor specific implementation of the module. The numbering is vendor specific.
      integer VendorId: 175..175, origin=ChipowerTech, set at published-information, default-value=175  # Vendor ID of the dedicated implementation of this module according to the AUTOSAR vendor list
