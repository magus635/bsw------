AUTOSAR XML (schema 00046)
package /Dio
  module config Dio: implementation-config-variant=VARIANT-PRE-COMPILE
    CommonPublishedInformation:
      ArReleaseMajorVersion = 4
      ArReleaseMinorVersion = 4
      ArReleaseRevisionVersion = 0
      ModuleId = 120
      SwMajorVersion = 1
      SwMinorVersion = 2
      SwPatchVersion = 0
      VendorId = 175
    DioConfig
      3 x DioPort:
        DioPort_14: index=0, DioPortId=14
          7 x DioChannel:
            DIO_TEST_OUT1: index=0, DioChannelId=3
            DIO_TEST_OUT2: index=1, DioChannelId=4
            DIO_TEST_OUT3: index=2, DioChannelId=5
            DIO_TEST_IN1: index=3, DioChannelId=6
            DIO_TEST_IN2: index=4, DioChannelId=7
            DIO_TEST_IN3: index=5, DioChannelId=8
            ESPI2_SLSO: index=6, DioChannelId=9
          DioChannelGroup_0 (DioChannelGroup): index=0, DioChannelGroupIdentification=DIO_GROUP_TEST_OUT, DioPortMask=48, DioPortOffset=0
          DioChannelGroup_1 (DioChannelGroup): index=1, DioChannelGroupIdentification=DIO_GROUP_TEST_IN, DioPortMask=56, DioPortOffset=0
        DioPort_0: index=1, DioPortId=0
          OCU_TEST (DioChannel): index=0, DioChannelId=2
          GPT_TEST (DioChannel): index=1, DioChannelId=10
        DioPort_1: index=2, DioPortId=1
    DioGeneral: DioDevErrorDetect=1, DioFlipChannelApi=1, DioMaskedWritePortApi=0, DioVersionInfoApi=1
