AUTOSAR XML (schema 00046)
package /AUTOSAR/EcucDefs
  module definition Arti [0..1]: post-build-variant-support=true, variants link-time/post-build/pre-compile  # The Arti Module serves as a superordinate container collecting all information and parameters concerning ARTI.
    container ArtiGeneric [0..1]: multiplicity set at pre-compile  # The ArtiGeneric container contains definitions for generic objects, i.e. not belonging to a standard AUTOSAR module.
      container ArtiGenericComponentClass [0..*]: multiplicity set at pre-compile  # The class definition describes the layout of the object (similar to a "class" definition in C++).
        string ArtiGenericComponentClassName: scope=ECU, set at pre-compile  # Name of the class.
        container ArtiGenericComponentClassParameter [0..*]: multiplicity set at pre-compile  # Parameter definition of a class.
          string ArtiGenericComponentClassParameterName: scope=ECU, set at pre-compile  # Name of the parameter.
          reference ArtiGenericComponentClassParameterTypeMapRef [0..1]: scope=ECU, set at pre-compile, destination=ArtiParameterTypeMap  # Refers to a parameter type to interpret the parameter value.
      container ArtiGenericComponentInstance [0..*]: multiplicity set at pre-compile  # The instance definition describes a specific instantiated object.
        string ArtiGenericComponentInstanceName: scope=ECU, set at pre-compile  # Name of the instance.
        reference ArtiGenericComponentInstanceClassRef: scope=ECU, set at pre-compile, destination=ArtiGenericComponentClass  # Refers to a ArtGenericClass of which this object is instantiated.
        container ArtiGenericComponentInstanceParameter [0..*]: multiplicity set at pre-compile  # Parameter definition of an instance.
          reference ArtiGenericComponentInstanceParameterClassParameterRef [0..*]: scope=ECU, set at pre-compile, destination=ArtiGenericComponentClassParameter  # Refers to an ArtiGenericComponentClassParameter that defines this parameter.
          reference ArtiGenericComponentInstanceParameterConstantRef [0..1]: scope=ECU, set at pre-compile, destination=ArtiConstant  # Refers to an ArtiConstant that represents the value of this parameter.
          reference ArtiGenericComponentInstanceParameterExpressionRef [0..1]: scope=ECU, set at pre-compile, destination=ArtiExpression  # Refers to an ArtiExpression that evaluates the value of this parameter.
          reference ArtiGenericComponentInstanceParameterHookRef [0..1]: scope=ECU, set at pre-compile, destination=ArtiHook  # Refers to a hook that records this parameter.
    container ArtiValues [0..*]: multiplicity set at pre-compile  # The ArtiValues container collects all parameter values for ARTI that are filled by the generators (OS, RTE, ...)
      container ArtiConstant [0..*]: multiplicity set at pre-compile  # This container holds a constant value.
        string ArtiConstantString: scope=ECU, set at pre-compile  # This is the constant value for a specific parameter.
      container ArtiExpression [0..*]: multiplicity set at pre-compile  # This container holds a C like expression that a debugger can evaluate. This is similar to what is already done in ORTI.
        string ArtiExpressionString: scope=ECU, set at pre-compile  # This string represents a C like expression that a debugger can evaluate.
      container ArtiHook [0..*]: multiplicity set at pre-compile  # This container represents an ARTI hook that is present in the module.
        function name ArtiHookAssociatedFunction [0..1]: set at pre-compile  # Name of the C function that is associated with this hook.
        string ArtiHookClass: scope=ECU, set at pre-compile  # Name of the (schedule) class of macros. Classes can be one of the predefined classes or user defined.
        string ArtiHookContext: scope=ECU, set at pre-compile  # Name of the execution context. One of NOSUSP, SPRVSR, or USER. See also chapter "ARTI Tracing Macro".
        string ArtiHookEventName: scope=ECU, set at pre-compile  # The name of the event as defined for a particular class, or an arbitrary name for generic classes.
        string ArtiHookFileName [0..1]: scope=ECU, set at pre-compile  # File name (possibly with path) where this ArtiHook is implemented.
        string ArtiHookInstance: scope=ECU, set at pre-compile  # Name of an instance of the (schedule) class.
        foreign reference ArtiHookEntryRef [0..1]: set at pre-compile, destination-type=BSW-MODULE-ENTRY  # Reference to the BswModuleEntry that describes the parameters of this hook.
        reference ArtiHookEventParameterTypeRef [0..1]: scope=ECU, set at pre-compile, destination=ArtiParameterTypeMap  # Refers to a parameter type to interpret the hook event number.
        reference ArtiHookInstanceParameterTypeRef [0..1]: scope=ECU, set at pre-compile, destination=ArtiParameterTypeMap  # Refers to a parameter type to interpret the hook instance number.
      container ArtiObjectClassParameter [0..*]: multiplicity set at pre-compile  # This container represents a parameter of an Arti object class definition.
        reference ArtiObjectClassParameterTypeMapRef [0..1]: scope=ECU, set at pre-compile, destination=ArtiParameterTypeMap  # Refers to a parameter type to interpret the instance parameter value.
      container ArtiObjectInstanceParameter [0..*]: multiplicity set at pre-compile  # This container represents a parameter of an Arti object instance.
        reference ArtiObjectInstanceParameterConstantRef [0..1]: scope=ECU, set at pre-compile, destination=ArtiConstant  # Refers to a constant representing the value of this parameter.
        reference ArtiObjectInstanceParameterExpressionRef [0..1]: scope=ECU, set at pre-compile, destination=ArtiExpression  # Refers to an expression that evaluates the value of this parameter.
        reference ArtiObjectInstanceParameterHookRef [0..1]: scope=ECU, set at pre-compile, destination=ArtiHook  # Refers to a hook that records this parameter.
      container ArtiParameterTypeMap [0..*]: multiplicity set at pre-compile  # A map of key/value pairs to map a parameter value to a display string and/or an Arti or EcuC object.
        container ArtiParameterTypeMapPair [1..*]: multiplicity set at pre-compile  # A key/value pair to map a parameter value to a display string and/or an Arti or EcuC object.
          integer ArtiParameterTypeMapPairInput [0..1]: 0..18446744073709551615, scope=ECU, set at pre-compile  # The numerical value given by a parameter to translate. When used with ArtiHooks, this parameter is mandatory (multiplicity 1) and its value is limited to the range of 0..65535. This parameter may be used to map the values given by "instanceParameter" and/or the "eventParameter" of the ARTI_TRACE macro.
          string ArtiParameterTypeMapPairOutput [0..1]: scope=ECU, set at pre-compile  # The string to display for the Input value.
          reference ArtiParameterTypeMapPairInputExpressionRef [0..1]: scope=ECU, set at pre-compile, destination=ArtiExpression  # Refers to an expression that evaluates to a numerical value to translate.
          choice reference ArtiParameterTypeMapPairOutputRef [0..1]: scope=ECU, set at pre-compile, destination=[ArtiStatesScheduleTableState, ArtiStatesSpinlockOwnerType, ArtiStatesSpinlockState, ArtiStatesTaskState]  # Choice Reference to ArtiOsTaskInstance, ArtiOsIsrInstance, ArtiStatesTaskState, OsAppMode, ArtiOsContextInstance, or ArtiOsStackInstance.
      container ArtiStates [0..*]: multiplicity set at pre-compile  # This container contains all states of tasks, isrs... that the EcuC uses.
        boolean ArtiStatesTaskEnhanced: set at pre-compile  # Set to true, if the OS provides an "enhanced" state model with "READY" split to "Activated", "Preempted", "Released".
        container ArtiStatesScheduleTableState [0..*]: multiplicity set at pre-compile  # Each state used by the OsScheduleTable has to be listed as ArtiStatesScheduleTableState parameter with a choice of the states.
          enumeration ArtiStatesScheduleTableStateEnum: {ArtiScheduleTableStateNext, ArtiScheduleTableStateRunning, ArtiScheduleTableStateRunningAndSynchronous, ArtiScheduleTableStateStopped, ArtiScheduleTableStateWaiting}, set at pre-compile  # ArtiStatesScheduleTableState choice of the states.
        container ArtiStatesSpinlockOwnerType [0..*]: multiplicity set at pre-compile  # Each owner type used by the OsSpinlock has to be listed as ArtiStatesSpinlockOwnerType parameter with a choice of the states.
          enumeration ArtiStatesSpinlockOwnerTypeEnum: {ArtiSpinlockOwnerTypeIsr2, ArtiSpinlockOwnerTypeTask}, set at pre-compile  # ArtiStatesSpinlockOwnerType choice of the states.
        container ArtiStatesSpinlockState [0..*]: multiplicity set at pre-compile  # Each state used by the OsSpinlock has to be listed as ArtiStatesSpinlockState parameter with a choice of the states.
          enumeration ArtiStatesSpinlockStateEnum: {ArtiSpinlockStateLocked, ArtiSpinlockStateUnlocked}, set at pre-compile  # ArtiStatesSpinlockState choice of the states.
        container ArtiStatesTaskState [0..*]: multiplicity set at pre-compile  # Each state used by the OS has to be listed as ArtiStatesTaskState Parameter with a choice of the states.
          enumeration ArtiStatesTaskStateEnum: {ArtiTaskStateActivated, ArtiTaskStatePreempted, ArtiTaskStateReady, ArtiTaskStateReleased, ArtiTaskStateRunning, ArtiTaskStateSuspended, ArtiTaskStateWaiting}, set at pre-compile  # ArtiStatesTaskState choice of the states.
